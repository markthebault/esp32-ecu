// Generated by scripts/embed_web.py. Edit web/ and config/ sources.
#pragma once
namespace ecu::web::assets {
inline constexpr char engine_defaults[]=R"ECU_ASSET({
  "schema_version": 9,
  "revision": 1,
  "strategy": "batch_wasted_4cyl",
  "physical_outputs": "inhibited",
  "engine": {
    "cylinders": 4,
    "displacement_cc": 2000,
    "injector_cc_min": 300,
    "fuel_density_g_cc": 0.745,
    "stoich_afr": 14.7
  },
  "settings": {
    "cranking_rpm": 450,
    "crank_advance_deg": 5,
    "rpm_limit": 6500,
    "rpm_hysteresis": 200,
    "soft_limit_band": 300,
    "max_duty": 0.8,
    "max_injection_ms": 15,
    "max_dwell_ms": 3.5,
    "tooth1_btdc_deg": 90,
    "afterstart_pct": 15,
    "afterstart_s": 20,
    "accel_threshold_pct_s": 40,
    "accel_gain": 0.002,
    "accel_decay_s": 0.4,
    "ego_enabled": false,
    "ego_kp": 0.15,
    "ego_ki": 0.08,
    "ego_limit": 0.1,
    "ego_min_clt": 70,
    "dfco_enabled": true,
    "dfco_rpm": 2000,
    "dfco_hysteresis": 300,
    "dfco_tps": 1,
    "dfco_delay_s": 0.5,
    "idle_enabled": false,
    "idle_target_rpm": 900,
    "idle_kp": 0.03,
    "idle_ki": 0.02,
    "fan_on_c": 95,
    "fan_off_c": 90,
    "pump_prime_s": 2
  },
  "curves": {
    "coolant_c": [
      -40,
      0,
      20,
      40,
      70,
      110
    ],
    "warmup_pct": [
      180,
      150,
      130,
      115,
      100,
      100
    ],
    "crank_pct": [
      250,
      210,
      180,
      160,
      140,
      130
    ],
    "battery_v": [
      8,
      10,
      12,
      14,
      16
    ],
    "deadtime_ms": [
      2,
      1.5,
      1.15,
      0.9,
      0.7
    ],
    "dwell_ms": [
      3.5,
      3.3,
      3,
      2.8,
      2.5
    ]
  },
  "maps": {
    "ve": {
      "rpm": [
        80,
        200,
        400,
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        6000,
        8000
      ],
      "load": [
        10,
        15,
        20,
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        100,
        110
      ],
      "cells": [
        85,
        85,
        85,
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        85,
        85
      ]
    },
    "spark": {
      "rpm": [
        80,
        200,
        400,
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        6000,
        8000
      ],
      "load": [
        10,
        15,
        20,
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        100,
        110
      ],
      "cells": [
        15,
        15,
        15,
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        15,
        15
      ]
    },
    "lambda": {
      "rpm": [
        80,
        200,
        400,
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        6000,
        8000
      ],
      "load": [
        10,
        15,
        20,
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        100,
        110
      ],
      "cells": [
        1,
        1,
        1,
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        1,
        1
      ]
    }
  },
  "timing": {
    "firing_order": [
      1,
      3,
      4,
      2
    ],
    "injection_end_deg": 540,
    "cam_sync_deg": 450,
    "cam_window_deg": 20
  },
  "cylinder_trims": {
    "enabled": false,
    "spark_deg": [
      0,
      0,
      0,
      0
    ],
    "fuel_maps": [
      {
        "rpm": [
          80,
          800,
          1600,
          3000,
          5000,
          8000
        ],
        "load": [
          10,
          30,
          50,
          70,
          90,
          110
        ],
        "cells": [
          100,
          100,
          100,
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          100,
          100
        ]
      },
      {
        "rpm": [
          80,
          800,
          1600,
          3000,
          5000,
          8000
        ],
        "load": [
          10,
          30,
          50,
          70,
          90,
          110
        ],
        "cells": [
          100,
          100,
          100,
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          100,
          100
        ]
      },
      {
        "rpm": [
          80,
          800,
          1600,
          3000,
          5000,
          8000
        ],
        "load": [
          10,
          30,
          50,
          70,
          90,
          110
        ],
        "cells": [
          100,
          100,
          100,
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          100,
          100
        ]
      },
      {
        "rpm": [
          80,
          800,
          1600,
          3000,
          5000,
          8000
        ],
        "load": [
          10,
          30,
          50,
          70,
          90,
          110
        ],
        "cells": [
          100,
          100,
          100,
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          100,
          100
        ]
      }
    ]
  },
  "idle_control": {
    "algorithm": "closed_loop",
    "frequency_hz": 100,
    "control_period_ms": 100,
    "min_pct": 0,
    "max_pct": 100,
    "tps_closed_pct": 2,
    "tps_hysteresis_pct": 0.5,
    "entry_rpm_above": 300,
    "exit_rpm_above": 500,
    "entry_delay_s": 0.25,
    "afterstart_taper_s": 2,
    "dashpot_pct": 8,
    "dashpot_decay_pct_s": 10,
    "slew_pct_s": 200,
    "integral_limit_pct": 40,
    "kd": 0,
    "derivative_filter_s": 0.1,
    "fast_idle_temp_c": 50,
    "fast_idle_hysteresis_c": 5,
    "coolant_c": [
      -40,
      0,
      20,
      40,
      70,
      110
    ],
    "run_pct": [
      65,
      50,
      38,
      30,
      20,
      20
    ],
    "crank_pct": [
      75,
      65,
      55,
      45,
      35,
      35
    ],
    "target_add_rpm": [
      400,
      300,
      200,
      100,
      0,
      0
    ]
  },
  "transient_enrichment": {
    "mode": "legacy_tps",
    "apply": "multiply",
    "sample_period_ms": 20,
    "tps_threshold_pct_s": 40,
    "map_threshold_kpa_s": 40,
    "tps_min_change_pct": 0.5,
    "map_min_change_kpa": 0.5,
    "duration_ms": 200,
    "max_enrichment_pct": 100,
    "decel_fuel_pct": 100,
    "rpm_taper_start": 3000,
    "rpm_taper_end": 6000,
    "cold_multiplier_pct": 100,
    "cold_taper_start_c": 0,
    "cold_taper_end_c": 70,
    "tps_rates": [
      0,
      100,
      500,
      1500
    ],
    "tps_added_pct": [
      0,
      10,
      30,
      50
    ],
    "map_rates": [
      0,
      100,
      500,
      1500
    ],
    "map_added_pct": [
      0,
      10,
      30,
      50
    ]
  },
  "load_model": {
    "fuel_source": "map",
    "spark_source": "map",
    "lambda_source": "follow_fuel",
    "trim_source": "follow_fuel",
    "pressure": "map_100kpa",
    "aux_role": "postcat_monitor",
    "baro_source": "fixed",
    "ve_axis": "map_kpa",
    "spark_axis": "map_kpa",
    "lambda_axis": "map_kpa",
    "trim_axis": "map_kpa",
    "afr": "target",
    "fixed_baro_kpa": 100,
    "afr_delay_s": 10
  },
  "secondary_tables": {
    "fuel": {
      "mode": "off",
      "source": "map",
      "axis": "map_kpa",
      "cells": "absolute",
      "condition": "rpm",
      "threshold": 3000,
      "debounce_ms": 20,
      "input_channel": 0,
      "active_high": true,
      "map": {
        "rpm": [
          80,
          200,
          400,
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          6000,
          8000
        ],
        "load": [
          10,
          15,
          20,
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          100,
          110
        ],
        "cells": [
          85,
          85,
          85,
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          85,
          85
        ]
      }
    },
    "spark": {
      "mode": "off",
      "source": "map",
      "axis": "map_kpa",
      "cells": "absolute",
      "condition": "rpm",
      "threshold": 3000,
      "debounce_ms": 20,
      "input_channel": 1,
      "active_high": true,
      "map": {
        "rpm": [
          80,
          200,
          400,
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          6000,
          8000
        ],
        "load": [
          10,
          15,
          20,
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          100,
          110
        ],
        "cells": [
          15,
          15,
          15,
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          15,
          15
        ]
      }
    }
  },
  "flex_fuel": {
    "input_confirmed": false,
    "capture": {
      "low_hz": 50,
      "high_hz": 150,
      "fault_hz": 170,
      "tolerance_hz": 1,
      "stale_ms": 250,
      "filter_ms": 0,
      "cycles": 8
    },
    "correction": {
      "enabled": false,
      "temperature_enabled": false,
      "ethanol_bins": [
        0,
        20,
        40,
        60,
        80,
        100
      ],
      "fuel_pct": [
        100,
        100,
        100,
        100,
        100,
        100
      ],
      "spark_deg": [
        0,
        0,
        0,
        0,
        0,
        0
      ],
      "temperature_c": [
        -40,
        0,
        20,
        40,
        80,
        125
      ],
      "temperature_pct": [
        100,
        100,
        100,
        100,
        100,
        100
      ]
    }
  }
}
)ECU_ASSET";
inline constexpr char defaults[]=R"ECU_ASSET({
  "schema_version": 1,
  "revision": 1,
  "name": "ECU bench profile",
  "adc_reference_v": 3.3,
  "ui_poll_ms": 500,
  "trigger": {
    "slots": 60,
    "missing": 2,
    "max_rpm": 8000
  },
  "sensors": [
    {
      "id": "map",
      "label": "MAP / manifold pressure",
      "mode": "voltage",
      "unit": "V",
      "confirmed": false,
      "fault_low_v": 0.02,
      "fault_high_v": 5.15,
      "filter_ms": 100,
      "v0": 0.5,
      "y0": 0,
      "v1": 4.5,
      "y1": 100,
      "points": [
        {
          "v": 0.5,
          "value": 0
        },
        {
          "v": 4.5,
          "value": 100
        }
      ],
      "ntc_r0_ohm": 10000,
      "ntc_t0_c": 25,
      "ntc_beta_k": 3950,
      "pullup_ohm": 2490,
      "pullup_fitted": false
    },
    {
      "id": "tps",
      "label": "TPS / throttle position",
      "mode": "voltage",
      "unit": "V",
      "confirmed": false,
      "fault_low_v": 0.02,
      "fault_high_v": 5.15,
      "filter_ms": 100,
      "v0": 0.5,
      "y0": 0,
      "v1": 4.5,
      "y1": 100,
      "points": [
        {
          "v": 0.5,
          "value": 0
        },
        {
          "v": 4.5,
          "value": 100
        }
      ],
      "ntc_r0_ohm": 10000,
      "ntc_t0_c": 25,
      "ntc_beta_k": 3950,
      "pullup_ohm": 2490,
      "pullup_fitted": false
    },
    {
      "id": "clt",
      "label": "Coolant temperature",
      "mode": "voltage",
      "unit": "V",
      "confirmed": false,
      "fault_low_v": 0.02,
      "fault_high_v": 5.15,
      "filter_ms": 100,
      "v0": 0.5,
      "y0": 0,
      "v1": 4.5,
      "y1": 100,
      "points": [
        {
          "v": 0.5,
          "value": 0
        },
        {
          "v": 4.5,
          "value": 100
        }
      ],
      "ntc_r0_ohm": 10000,
      "ntc_t0_c": 25,
      "ntc_beta_k": 3950,
      "pullup_ohm": 2490,
      "pullup_fitted": false
    },
    {
      "id": "iat",
      "label": "Intake-air temperature",
      "mode": "voltage",
      "unit": "V",
      "confirmed": false,
      "fault_low_v": 0.02,
      "fault_high_v": 5.15,
      "filter_ms": 100,
      "v0": 0.5,
      "y0": 0,
      "v1": 4.5,
      "y1": 100,
      "points": [
        {
          "v": 0.5,
          "value": 0
        },
        {
          "v": 4.5,
          "value": 100
        }
      ],
      "ntc_r0_ohm": 10000,
      "ntc_t0_c": 25,
      "ntc_beta_k": 3950,
      "pullup_ohm": 2490,
      "pullup_fitted": false
    },
    {
      "id": "wideband",
      "label": "Wideband controller output",
      "mode": "voltage",
      "unit": "V",
      "confirmed": false,
      "fault_low_v": 0.02,
      "fault_high_v": 5.15,
      "filter_ms": 100,
      "v0": 0.5,
      "y0": 0,
      "v1": 4.5,
      "y1": 100,
      "points": [
        {
          "v": 0.5,
          "value": 0
        },
        {
          "v": 4.5,
          "value": 100
        }
      ],
      "ntc_r0_ohm": 10000,
      "ntc_t0_c": 25,
      "ntc_beta_k": 3950,
      "pullup_ohm": 2490,
      "pullup_fitted": false
    },
    {
      "id": "postcat",
      "label": "Buffered post-catalyst signa",
      "mode": "voltage",
      "unit": "V",
      "confirmed": false,
      "fault_low_v": 0.02,
      "fault_high_v": 5.15,
      "filter_ms": 100,
      "v0": 0.5,
      "y0": 0,
      "v1": 4.5,
      "y1": 100,
      "points": [
        {
          "v": 0.5,
          "value": 0
        },
        {
          "v": 4.5,
          "value": 100
        }
      ],
      "ntc_r0_ohm": 10000,
      "ntc_t0_c": 25,
      "ntc_beta_k": 3950,
      "pullup_ohm": 2490,
      "pullup_fitted": false
    }
  ]
})ECU_ASSET";
inline constexpr char guide[]=R"ECU_ASSET({
  "schema_version": 1,
  "guide_version": "1.6",
  "hardware_revision": "A3-120",
  "scope": "Bench configuration and diagnostics. Physical engine outputs remain inhibited; no vehicle qualification.",
  "general": [
    "Board pin numbers refer to the PCB top view; pin 1 is the square pad. The mating plug view can be mirrored. Verify the actual harness with continuity tests.",
    "Disconnect power before resistance/continuity tests. Do not measure resistance on a live vehicle bus or use a megohmmeter on electronics.",
    "Keep J3 open and all actuator harnesses disconnected during sensor commissioning. This firmware keeps ARM off.",
    "Use the actual sensor or controller manufacturer pinout, transfer curve, mounting torque and air gap. There is no universal vehicle-side pinout.",
    "Measure signal voltage against that sensor connector pin 1, not an arbitrary chassis bolt. Never use a test lamp on a sensor or MCU pin."
  ],
  "sources": [
    {
      "title": "Espressif S3 DevKitC v1.1 pins and power methods",
      "url": "https://docs.espressif.com/projects/esp-dev-kits/en/latest/esp32s3/esp32-s3-devkitc-1/user_guide_v1.1.html"
    },
    {
      "title": "Microchip MCP3208 ADC",
      "url": "https://www.microchip.com/en-us/product/mcp3208"
    },
    {
      "title": "Microchip MCP2562 CAN transceiver",
      "url": "https://ww1.microchip.com/downloads/en/DeviceDoc/25167A.pdf"
    },
    {
      "title": "Bosch LSU 4.9 requires a dedicated controller",
      "url": "https://www.bosch-motorsport.com/products/sensors/lambda/lambda-sensor-mini-lsu-4-9/"
    },
    {
      "title": "Kvaser CAN termination checks",
      "url": "https://kvaser.com/developer-blog/how-to-test-your-can-termination-works-correctly/"
    },
    {
      "title": "ST protected low-side driver",
      "url": "https://www.st.com/resource/en/datasheet/vnp35n07-e.pdf"
    },
    {
      "title": "Vishay 6N137 optical input/detector data",
      "url": "https://www.vishay.com/docs/84732/6n137_vo2601_vo2611.pdf"
    },
    {
      "title": "TI UCC27524 gate-driver data and layout guidance",
      "url": "https://www.ti.com/lit/ds/symlink/ucc27524.pdf"
    },
    {
      "title": "Microchip MCP100 supply supervisor",
      "url": "https://ww1.microchip.com/downloads/aemDocuments/documents/APID/ProductDocuments/DataSheets/11187f.pdf"
    }
  ],
  "sensors": [
    {
      "id": "map",
      "name": "MAP / manifold pressure",
      "connector": "J11",
      "signal": "MAP",
      "adc_channel": 0,
      "pins": [
        "1 GND",
        "2 SENSOR_5V",
        "3 MAP"
      ],
      "mount": [
        "Retain the OEM pressure port or use a suitable sealed manifold-pressure takeoff after the throttle. Keep the hose short and secure, and follow the sensor maker's fluid/orientation limits.",
        "Route away from hot exhaust and ignition wiring. Leak-check any added hose before running an engine."
      ],
      "checks": [
        "Confirm the sensor uses 5 V and identify its actual supply, ground and signal wires from its datasheet.",
        "With power off, check each harness conductor end-to-end and for unintended shorts, with both ends unplugged.",
        "Power the board, check pin 2 near 5 V, then connect the sensor and measure pin 3 versus pin 1.",
        "Use a regulated hand vacuum/pressure source within the sensor rating, compare the web voltage with a meter, then enter the manufacturer transfer curve or measured reference points."
      ],
      "expected": [
        "Key-on / engine-off pressure should agree with a trusted local absolute-pressure reference after calibration. It is not always 100 kPa.",
        "A steady applied pressure should produce a steady voltage and calibrated value."
      ],
      "faults": [
        "Flat near 0 V: inspect power, ground, signal short and sensor pin order.",
        "Flat high: inspect a short to supply, wrong curve, or a saturated sensor.",
        "Pressure wrong but voltage agrees with the meter: check absolute versus gauge units, curve and pressure reference.",
        "Noisy or slow: inspect hose leaks/restriction, ground offset, shield routing and configured filtering."
      ],
      "circuit": "R20 22k series, R21 33k to ground, C20 10nF; U6 channel 0.",
      "optional_pullup": null,
      "units_hint": "kPa"
    },
    {
      "id": "tps",
      "name": "TPS / throttle position",
      "connector": "J12",
      "signal": "TPS",
      "adc_channel": 1,
      "pins": [
        "1 GND",
        "2 SENSOR_5V",
        "3 TPS"
      ],
      "mount": [
        "Use the OEM TPS mounting and its correct shaft coupling. A single analog input does not replace an electronic throttle system or its redundant safety channels.",
        "Turn the throttle only with the vehicle made safe; do not force an electronic throttle plate or alter mechanical stops."
      ],
      "checks": [
        "Identify whether the TPS is a 3-wire potentiometer or another sensor. Do not connect throttle-motor wires to J12.",
        "Verify pin 2 supply and pin 1 ground, then observe signal voltage while moving the permitted mechanism slowly.",
        "Record closed and fully open reference voltages, enter those as 0% and 100%, and mark calibration confirmed only after checking the whole travel."
      ],
      "expected": [
        "The voltage should sweep smoothly without dropouts. Some sensors have a decreasing transfer curve; configure the corresponding endpoint values."
      ],
      "faults": [
        "Jumps at one position: inspect sensor track/coupling or a broken harness conductor.",
        "Direction reversed: swap calibration endpoint values, not supply and ground wires.",
        "Does not reach 0%/100%: recheck mechanical travel and measured endpoints.",
        "Two TPS tracks or a throttle motor are present: this hardware does not implement OEM DBW control."
      ],
      "circuit": "R22 22k series, R23 33k to ground, C21 10nF; U6 channel 1.",
      "optional_pullup": null,
      "units_hint": "%"
    },
    {
      "id": "clt",
      "name": "Coolant temperature",
      "connector": "J13",
      "signal": "CLT",
      "adc_channel": 2,
      "pins": [
        "1 GND",
        "2 SENSOR_5V",
        "3 CLT"
      ],
      "mount": [
        "Use the OEM coolant sensor and mounting boss, with the engine cold and cooling system depressurized. Follow the specified seal and torque.",
        "Keep the original vehicle sensor if required by other systems; verify loading before sharing any signal."
      ],
      "checks": [
        "For a passive two-wire NTC, use pins 1 and 3 only. Leave pin 2 empty in the mating housing.",
        "Fit R32 only if this is a passive NTC requiring the board pull-up. Check its actual resistance; the design value is 2.49 kohm.",
        "Measure sensor resistance while disconnected and compare at known temperatures with its datasheet. Prefer several reference points.",
        "Enter beta parameters or a voltage table. In NTC mode, confirm the physical pull-up is fitted; the UI cannot install a resistor."
      ],
      "expected": [
        "A common NTC resistance falls as temperature rises, and its signal voltage falls with this pull-up topology.",
        "The conversion accounts for the board's 55 kohm divider load and measured sensor supply."
      ],
      "faults": [
        "Near 0 V: sensor/loom short to ground or very low resistance.",
        "High signal / open-model fault: unplugged sensor, broken ground/signal or missing/wrong pull-up.",
        "Plausible voltage but wrong temperature: wrong NTC curve, pull-up value, supply reading or units.",
        "Do not assume a floating/unexcited input will read maximum voltage: R32 is DNP by default."
      ],
      "circuit": "R24 22k series, R25 33k to ground, C22 10nF; U6 channel 2.",
      "optional_pullup": "R32",
      "units_hint": "deg C"
    },
    {
      "id": "iat",
      "name": "Intake-air temperature",
      "connector": "J14",
      "signal": "IAT",
      "adc_channel": 3,
      "pins": [
        "1 GND",
        "2 SENSOR_5V",
        "3 IAT"
      ],
      "mount": [
        "Use a suitable intake-air boss and the sensor maker's orientation. Avoid placing the sensing element against the intake wall or at an unrepresentative heat source.",
        "Follow the original mechanical arrangement; secure any aftermarket sensor so it cannot enter the intake."
      ],
      "checks": [
        "A passive two-wire NTC connects to pins 1 and 3; pin 2 remains empty.",
        "R33 is the optional board pull-up, normally 2.49 kohm. Confirm it is physically fitted before using NTC conversion.",
        "Compare disconnected resistance and stabilized readings with a reference thermometer at several temperatures. Enter the actual sensor curve."
      ],
      "expected": [
        "After a long cold soak, intake and coolant temperature should be reasonably consistent with their actual surroundings. Heat soak can produce real differences."
      ],
      "faults": [
        "Use the same open/short/pull-up checks as CLT, but inspect intake heat soak and airflow before blaming calibration.",
        "Fast spikes suggest intermittent wires or electrical interference. A slow heat-soak drift may be physical."
      ],
      "circuit": "R26 22k series, R27 33k to ground, C23 10nF; U6 channel 3.",
      "optional_pullup": "R33",
      "units_hint": "deg C"
    },
    {
      "id": "wideband",
      "name": "Wideband controller output",
      "connector": "J15",
      "signal": "LAMBDA_WB",
      "adc_channel": 4,
      "pins": [
        "1 GND",
        "2 SENSOR_5V",
        "3 LAMBDA_WB"
      ],
      "mount": [
        "Install the exhaust sensor according to the sensor/controller maker's rules for bung angle, temperature and condensation. The ECU board does not heat or drive a raw wideband sensor.",
        "Mount the external controller away from hot exhaust and splash paths; use its specified fused power and grounds."
      ],
      "checks": [
        "Connect controller analog signal to pin 3 and its specified analog reference to pin 1.",
        "Leave pin 2 unpopulated; the board sensor supply must not power the controller or heater.",
        "Enter the controller's actual 0-5 V mapping and units. Lambda and AFR are not interchangeable without the correct fuel stoichiometry.",
        "Use the controller's documented analog-output test mode or a known voltage source before interpreting exhaust readings."
      ],
      "expected": [
        "Web voltage and a meter should agree; converted lambda should agree with the controller when both use the same mapping and ground reference."
      ],
      "faults": [
        "Controller display correct but ECU wrong: inspect mapping, analog-reference offset and output mode.",
        "Fixed fault voltage: read the external controller's error codes before treating it as mixture.",
        "No output until heated: verify controller state and heater supply.",
        "A raw LSU sensor cannot be connected directly; do not invent a direct 5-wire/6-wire pin mapping."
      ],
      "circuit": "R28 22k series, R29 33k to ground, C24 10nF; U6 channel 4.",
      "optional_pullup": null,
      "units_hint": "lambda"
    },
    {
      "id": "postcat",
      "name": "Buffered post-catalyst signal",
      "connector": "J16",
      "signal": "POSTCAT_BUF",
      "adc_channel": 5,
      "pins": [
        "1 GND",
        "2 SENSOR_5V",
        "3 POSTCAT_BUF"
      ],
      "mount": [
        "Retain the catalyst and rear oxygen sensor in their proper locations. This input is for measurement, not catalyst emulation or bypass.",
        "Use a suitable external high-input-impedance conditioner/buffer where needed. The board input presents about 55 kohm to the sensor signal."
      ],
      "checks": [
        "Connect only the buffer's conditioned 0-5 V output to pin 3 and its analog reference to pin 1. Leave pin 2 empty unless the buffer specifically permits this supply within the shared current budget.",
        "Do not connect heater wires, a raw wideband sensor, or assume every raw narrowband output can tolerate this load.",
        "Compare the buffer output with a meter; enter its transfer curve or retain voltage display.",
        "Optional engine EMAP or baro role: disconnect the postcat buffer and assign J16 in Engine development. Connect one suitable absolute-pressure sensor: pin 1 ground, pin 2 protected 5 V only if its supply specification permits, pin 3 conditioned 0-5 V output. Do not parallel two signals.",
        "Calibrate the postcat channel in exact unit kPa using a measured linear or table conversion, then confirm it. EMAP requires20..500 kPa absolute; baro requires50..110 kPa absolute. The about55 kohm input load and shared supply/current budget still apply. A voltage reading with a kPa label is not a pressure calibration."
      ],
      "expected": [
        "Voltage is the directly supported diagnostic. This firmware does not implement catalyst-efficiency monitoring, emissions readiness or OEM rear-sensor diagnostics.",
        "The default engine role is postcat_monitor. An explicit EMAP or live baro assignment reuses this existing protected ADC channel, with no extra simultaneous channel. EMAP plus live baro requires an additional input path that is not implemented. No zero-RPM ambient capture is inferred.",
        "Keep an exhaust-pressure transducer within its temperature rating with appropriate remote tubing. Pressure/thermal installation remains unqualified. Engine status, recorded logs and own008 tuning diagnostics identify the selected source, pressure normalization and unknown readings. Physical outputs remain inhibited."
      ],
      "faults": [
        "Signal changes when shared with OEM ECU: stop and review input loading and the buffer interface.",
        "Zero or clipped output: inspect buffer supply/reference and output limits.",
        "A stable rear reading alone does not prove catalyst health."
      ],
      "circuit": "R30 22k series, R31 33k to ground, C25 10nF; U6 channel 5.",
      "optional_pullup": null,
      "units_hint": "V"
    }
  ],
  "triggers": [
    {
      "id": "crank",
      "name": "Crank Hall input",
      "connector": "J17",
      "pins": [
        "1 GND",
        "2 SENSOR_5V",
        "3 CRANK_RAW"
      ],
      "mount": [
        "Use the original rigid bracket/target-wheel relationship and the exact manufacturer air gap, polarity, supply rating and torque. There is no universal trigger gap.",
        "This input accepts a compatible 5 V Hall interface. A two-wire variable-reluctance sensor needs an external conditioner."
      ],
      "checks": [
        "Verify supply and ground before connecting. Determine whether the Hall output is push-pull or open-collector.",
        "For an open-collector output without another suitable pull-up, fit the specified optional pull-up and verify the current/voltage requirements.",
        "Use an oscilloscope to compare connector pin 3 with the conditioned MCU input. A multimeter can miss missing pulses and noise.",
        "With ignition/injection disabled, turn the target safely or use an isolated bench signal generator. Do not connect a generator in parallel with an energized sensor."
      ],
      "expected": [
        "The decoder uses rising edges. Trigger logging records both polarities on separate diagnostic capture channels. Both Hall paths use two Schmitt inversions, preserving the input polarity.",
        "Crank sync requires the selected missing-tooth geometry and repeated valid gaps. Batch/wasted and semi-sequential use crank only. Full sequential requires one rising cam pulse per720 degrees and two repeatable observations; phase loss after acquisition cuts and latches until a supervised stop. Confirm mechanical cylinder1 compression reference independently."
      ],
      "faults": [
        "No edges: inspect supply, missing pull-up, wrong sensor type, target gap, signal/ground pin order and U7 conditioning.",
        "Edges but no sync: inspect total slots/missing teeth, speed range, signal quality and electrical noise. A simple square wave is not a valid missing-tooth wheel.",
        "False RPM / overflow: inspect ringing, shield/return routing, gap and pull-up; power-cycle after a latched capture overflow."
      ],
      "circuit": "R40 33k series, C30 100pF, optional R41 2.2k pull-up; U7 -> GPIO8.",
      "optional_pullup": "R41"
    },
    {
      "id": "cam",
      "name": "Cam Hall input",
      "connector": "J18",
      "pins": [
        "1 GND",
        "2 SENSOR_5V",
        "3 CAM_RAW"
      ],
      "mount": [
        "Use the original rigid bracket/target-wheel relationship and the exact manufacturer air gap, polarity, supply rating and torque. There is no universal trigger gap.",
        "This input accepts a compatible 5 V Hall interface. A two-wire variable-reluctance sensor needs an external conditioner."
      ],
      "checks": [
        "Verify supply and ground before connecting. Determine whether the Hall output is push-pull or open-collector.",
        "For an open-collector output without another suitable pull-up, fit the specified optional pull-up and verify the current/voltage requirements.",
        "Use an oscilloscope to compare connector pin 3 with the conditioned MCU input. A multimeter can miss missing pulses and noise.",
        "With ignition/injection disabled, turn the target safely or use an isolated bench signal generator. Do not connect a generator in parallel with an energized sensor."
      ],
      "expected": [
        "The decoder uses rising edges. Trigger logging records both polarities on separate diagnostic capture channels. Both Hall paths use two Schmitt inversions, preserving the input polarity.",
        "Crank sync requires the selected missing-tooth geometry and repeated valid gaps. Batch/wasted and semi-sequential use crank only. Full sequential requires one rising cam pulse per720 degrees and two repeatable observations; phase loss after acquisition cuts and latches until a supervised stop. Confirm mechanical cylinder1 compression reference independently."
      ],
      "faults": [
        "No edges: inspect supply, missing pull-up, wrong sensor type, target gap, signal/ground pin order and U7 conditioning.",
        "Edges but no sync: inspect total slots/missing teeth, speed range, signal quality and electrical noise. A simple square wave is not a valid missing-tooth wheel.",
        "False RPM / overflow: inspect ringing, shield/return routing, gap and pull-up; power-cycle after a latched capture overflow."
      ],
      "circuit": "R42 33k series, C31 100pF, optional R43 2.2k pull-up; U7 -> GPIO9.",
      "optional_pullup": "R43"
    }
  ],
  "services": [
    {
      "connector": "J1",
      "title": "Logic power",
      "checks": [
        "Pin 1 is externally fused key-on 12 V; pin 2 is ground. Use the specified external 1 A source fuse.",
        "For first bench checks, unplug every sensor and actuator, keep J3 open, use a 12 V current-limited supply, and check polarity before enabling it.",
        "Measure TP2 VIN_PROT, TP3 5 V, TP4 3V3, then each sensor pin 2. TP2 is after the reverse diode and before the input filter.",
        "Repeated resets can be undervoltage/current limit, a short, wrong part orientation, regulator instability or watchdog timeout. Disconnect external loads one at a time."
      ]
    },
    {
      "connector": "J2",
      "title": "UART / boot / reset",
      "checks": [
        "Pins: 1 ground, 2 ECU TX -> adapter RX, 3 ECU RX <- adapter TX, 4 EN, 5 BOOT_N. Use 3.3 V logic, 115200 baud, 8-N-1.",
        "Do not connect an adapter power wire or a powered DevKit USB cable while the carrier supplies the module. For USB programming, remove the module from the carrier.",
        "If silent, check supply and EN, cross TX/RX correctly, verify the A3 build and chosen serial port, then capture the boot log. The existing console tag can still say ecu_a0.",
        "For ROM download mode, hold BOOT_N low during an EN reset, then release it. Do not short EN or BOOT_N to 12 V."
      ]
    },
    {
      "connector": "J3",
      "title": "Physical interlock",
      "checks": [
        "Pin 1 is 3V3 and pin 2 is INTERLOCK. Open is the normal state during commissioning.",
        "lock=0 with the contact open is expected. Closing it can allow hardware run gating; do not close it with vehicle actuators connected.",
        "The configuration firmware keeps ARM=0 regardless. Never bypass SAFE_N to make a fault disappear."
      ]
    },
    {
      "connector": "J4",
      "title": "Internal expansion",
      "checks": [
        "Pins: ground / 3V3 / SDA / SCL / SAFE_N. This is an internal 3.3 V service bus, not a 12 V sensor connector.",
        "Check pull-ups and idle SDA/SCL near 3V3. A stuck-low line suggests a short, wrong device voltage or a device holding the bus.",
        "No generic external I2C scanner or expansion actuator control is implemented by this release."
      ]
    },
    {
      "connector": "J7 / JP1 / JP2",
      "title": "CAN and termination",
      "checks": [
        "J7: CANH / CANL / ground / CHASSIS. Keep the pair twisted and verify the network bitrate. Firmware reception is 500 kbit/s listen-only; no OEM decoding is provided.",
        "JP1 open leaves MCP2562 in standby, so ordinary frames will not be received. Close it only on the appropriate supervised bus for normal transceiver reception. Firmware remains listen-only.",
        "JP2 adds onboard 120 ohm termination when closed. Leave it open on an already terminated vehicle network.",
        "With the complete network unpowered, two 120 ohm end terminations normally measure about 60 ohm between CANH and CANL. A removed/unpowered interface alone need not read 60 ohm.",
        "No frames: inspect JP1, bitrate, polarity, grounds, bus activity and termination. A standalone two-node listen-only bench cannot supply missing ACKs for a lone transmitter."
      ]
    },
    {
      "connector": "J8",
      "title": "External relay coils",
      "checks": [
        "Pins: MAIN low side / PUMP low side / FAN low side / ground. External fused relay supplies and correctly oriented flyback diodes are required.",
        "Target coil current is at most 150 mA per channel, pending physical tests. Do not connect a fan motor or pump motor directly.",
        "The configuration firmware commands all channels OFF. An inactive relay is expected, not a reason to bypass the inhibit.",
        "With a coil connected to a safe test supply, OFF low-side voltage can be near the external supply, not zero. Driver/tab is electrically live. Actuation tests require a separate qualified dummy-load procedure."
      ]
    },
    {
      "connector": "J9 / J19",
      "title": "Injector outputs and power return",
      "checks": [
        "J9 pins 1-4 are injector low sides 1-4; pins 5-8 are ground. J19 both pins are the dedicated power return.",
        "Only saturated high-impedance PFI injectors are in scope; 1.2 A/channel is a design target pending tests. No GDI or peak-and-hold driver is provided.",
        "Actuator 12 V is external, fused and relay switched. Never use the sensor ground harness as the injector current return.",
        "All outputs remain OFF in this firmware. Check resistance/continuity only disconnected; do not pulse a fueled engine to troubleshoot wiring.",
        "A high OFF output with an externally powered load is normal. Persistent current with ARM off indicates wrong wiring, a shorted driver or a board fault: disconnect power."
      ]
    },
    {
      "connector": "J10",
      "title": "Smart-coil logic only",
      "checks": [
        "Pins 1-4 are active-high 5 V smart-coil commands; pin 5 is ground. They are not ignition-coil primary outputs.",
        "Use only a compatible low-current logic input (design target at most 4 mA). Coil power and power-ground wiring remain external.",
        "The configuration firmware keeps dwell commands OFF. Do not use a test lamp, an ordinary LED without its resistor, or a coil primary as a logic test load.",
        "Changing or interrupting dwell on a real coil can produce a spark. Keep real ignition hardware disconnected during bench configuration."
      ]
    },
    {
      "connector": "J20 / H5",
      "title": "Shield and enclosure bond",
      "checks": [
        "J20 pins and plated lug H5 are CHASSIS, not normal sensor/actuator current returns. Bond them to the internal lining using the assembly guide.",
        "Check lining/braid continuity with power off. The CHASSIS-to-GND 1 Mohm bleed and 4.7 nF RF capacitor are intentional, not a hard DC ground link.",
        "Keep all bonds inside the water seal and route any external reference conductor through a sealed gland. Do not drill an unsealed shield-stud hole."
      ]
    },
    {
      "connector": "TP1-TP6",
      "title": "Test points",
      "checks": [
        "TP1 ground; TP2 VIN_PROT; TP3 5 V; TP4 3V3; TP5 SAFE_N; TP6 RUN_5V.",
        "With J3 open and monitor firmware, RUN_5V should be low even when supplies are healthy. SAFE_N is an open-drain supervised net, normally pulled near 3V3 when released.",
        "If SAFE_N repeatedly drops, scope it with the supply rails and WDI. Do not defeat the MAX1232 or 3V3 supervisor.",
        "Use a properly referenced or isolated scope arrangement; do not clip an earth-referenced scope ground to an arbitrary live output."
      ]
    },
    {
      "connector": "A5 J21 / IAC-DRAFT2",
      "title": "Isolated idle PWM",
      "checks": [
        "Engine development contains idle modes, gains, coolant curves and source/age diagnostics. All shipped builds keep physical idle GPIO writes disabled. A3/A4 and the old manual/ZIP do not contain this new carrier connector.",
        "A5 J21 PH4 maps pin 1 GPIO3/IDLE_CMD, pin 2 RUN_5V, pin 3 carrier 5V, pin 4 carrier GND to IAC-DRAFT2 J1 XH4 pins1 through 4. R154 is the permanent 2.2 kohm carrier bias and stays present with the harness unplugged. Verify the keyed mating view and continuity with power removed.",
        "Two input-side transistor buffers and 6N137 optocouplers separate carrier power/return from actuator logic. Do not bridge these domains with wires, case foil, heatsinks or scope ground clips. This is low-voltage return separation, not certified isolation.",
        "Accessory J2 fixed screw terminal: pin 1 separate externally protected, fused, relay-switched 9-16 V; pin 2 dedicated return. J3 VH2: pin 1 valve positive, pin 2 IAC_LS. Use an actual <=2 A normally closed two-wire continuous-PWM valve; carrier J1 and sensor rails cannot supply it.",
        "IRLZ44NPBF has no current/thermal shutdown or valve feedback. A drain-source short can energize a normal-current coil without clearing a fuse. Provide an independently operable actuator-branch disconnect. Q1 drain tab and U6 regulator-output tab are live at different voltages.",
        "C1-C5, C10, R13 and R14 mount on the back. C4/C10 bypass the driver locally; LOGIC_GND joins ACT_GND only at NT1/Q1 source. Do not add a second return strap. Actual passive parts, trimmed leads, finished TO220 holes, underside height and case clearance require assembly acceptance.",
        "Keep this draft unpowered pending release of the protected branch, exact PDIP driver guarantee, loaded GPIO/RUN/opto timing, minimum 1 us pulse, supervisor brownout, temperature and mounting checks. MCP100 assertion 10 us is typical with no specified maximum. Read actual GPIO3/JTAG eFuses without burns; N16R8 socket/antenna fit remains provisional. The RUN source also feeds carrier R47/R50/R53, Q7 and HCT inputs; measure loaded RUN and MAIN_IN with both boards attached. The Q7 500 uA figure at 10 V/25 C is not a 5 V/full-temperature/fault bound.",
        "Use a current-limited resistor fixture first with proper isolated/differential probes and an independent cutoff. Observe local rail, supervisor, ENA, gate/source, drain and both return currents during startup, reset, RUN/command loss, disconnected inputs and opened returns. Preserve scope protective earth.",
        "Compare proposed duty with separate cycle-latched PWM high time and fault. Synthetic current/opening are model estimates; no physical valve feedback exists. Command0% does not prove valve closure."
      ]
    },
    {
      "connector": "J9 / J10 semi-sequential",
      "title": "Semi-sequential fuel and wasted COP",
      "checks": [
        "This is a software development strategy. Selected web builds keep physical engine outputs OFF. The separate dummy-load bench build has no web service and is not installed here. Keep J3 open and real injector/ignition harnesses disconnected. The unchanged carrier needs four independent injector drivers and four smart-coil logic channels; no extra pair wiring is required.",
        "J9 pins1-4 remain physical injector cylinders1-4; pins5-8 are return. J19 is the dedicated power return. J10 pins1-4 remain physical smart-coil commands1-4, pin5 ground. Check each harness by continuity with both ends unplugged. Never bridge low-side outputs or move two injectors onto one driver.",
        "For firing order1-3-4-2 the scheduled fuel pairs are cylinders1+4 and3+2. Other valid four-cylinder orders derive pairs from order slots1+3 and2+4. Each injector opens once per crank revolution, giving two half-effective-fuel openings per720 degrees. Dead time is added to each opening.",
        "Semi-sequential needs crank synchronization from J17, without compression phase from J18. Its closing reference repeats modulo360 degrees:540 means180 each revolution. The two groups are180 degrees apart. Full sequential alone uses the720-degree cam reference and individual trims; enabled trims must be disabled explicitly before saving a paired mode. Stored trim maps are retained.",
        "After saving, check active strategy separately from unsaved editor settings. Compare executed rising/falling timestamps for both members of each pair, full electrical width, duty, fault cause, revision and source age. Injector low deadlines stay fixed after opening, so changing RPM can move the actual closing angle. A missing cam is expected in this mode; a missing crank must cut. Old latched faults still require stopped/quiet recovery.",
        "Pairs can overlap above50 percent duty. Do not assume lower peak supply/return current. Existing1.2A injector and4mA smart-coil targets remain unqualified; saturated high-impedance PFI only. Actual flow/deadtime, current/flyback, loaded supply/gates, timing/jitter, temperature and engine phase need physical dummy-load/HIL acceptance.",
        "The host reduced and research plants have fixed physical1-3-4-2 geometry. Changing the tune order does not change that engine. Coupled comparison uses a neutral test tune, not a vehicle calibration. Screen engine schema2 is required for this mode; schema1 peers fall back to sensors and show upgrade needed."
      ]
    },
    {
      "connector": "J11 / J12 transient fueling",
      "title": "MAP/TPS transient acquisition and dose",
      "checks": [
        "Use Engine development > Transient fueling. Older tunes retain Legacy TPS decay; Off, TPS rate table and MAP rate table are explicit choices. Selected web images inhibit physical outputs. No new connector or PCB route is required.",
        "J11 is protected MAP and J12 is protected TPS. Reference each signal to its connector pin1 ground and verify the actual sensor supply, mating pinout and calibrated kPa or percent. Do not infer wiring from the sensor body color.",
        "New modes use nominal5ms fast calibrated acquisitions and the scan-start timestamp, independently of display smoothing. Compare raw voltage, calibrated values, window length, source rate, threshold/minimum-change gates and phase/reason. Bad wiring and noise can trigger enrichment.",
        "Extra curve values are percentages. Multiply scales effective current fuel. Add reference fuel uses per-cylinder720-degree mass at100kPa,25C,100%VE and lambda1, independent of current MAP/VE/warmup. Trims scale the complete dose; opening count and deadtime follow.",
        "Deceleration is fuel remaining:100% neutral,0% stops new injector starts after scheduler acceptance while spark continues unless another cut applies. Existing active closing edges finish normally. Dose/pulse/duty limits still inhibit the whole command.",
        "First observation and recovery after stop/crank/fault/DFCO clear history. Rate-valid differs from observation available. Check source age: hold remaining is measured at the observation time. Completed host runs are synthetic and retained logs are historical.",
        "Use engine MSL004 or JSON for detailed transient rates, phase and dose. Fixed ESP-NOW schema2 retains the existing effective accel ratio only. No physical measurement or vehicle base tune is implied."
      ]
    }
  ],
  "config_help": [
    "Voltage mode shows the reconstructed connector voltage; it does not require a sensor transfer curve.",
    "Linear mode uses two measured input voltages and two physical values. Set the actual units and validate a third reference point.",
    "Table mode interpolates between 2-16 ascending voltage/value pairs. Values outside the table range are faults, not extrapolated measurements.",
    "NTC beta mode is for CLT/IAT only and requires the physical pull-up. It uses the measured sensor supply and compensates the 55 kohm divider load. A voltage table is preferable when the real curve is available.",
    "Filtering is for readout smoothing, not a substitute for fixing wiring/noise. Electrical fault checks use the instantaneous input.",
    "Saved calibration feeds readouts and shadow engine calculations. Physical engine outputs remain inhibited. DBW, catalyst diagnostics and OEM protocols are not implemented.",
    "Saving trigger geometry or engine timing fences virtual output plans and requires fresh synchronization. Batch and semi-sequential use crank-only360-degree synchronization; full sequential uses two repeatable cam observations for720-degree phase. Capture age, overflow and stopped/quiet recovery still apply."
  ]
})ECU_ASSET";
inline constexpr char index[]=R"ECU_ASSET(<!doctype html>
<html lang="en"><head><meta charset="utf-8"><meta name="viewport" content="width=device-width,initial-scale=1"><title>ECU Studio | Configuration & diagnostics</title>
<style>
:root{color-scheme:dark;--bg:#101315;--panel:#181d20;--panel2:#1d2327;--line:#30383d;--text:#e9eeed;--sub:#97a4a8;--green:#b8ee83;--amber:#edc579;--red:#ff8e88;--mono:ui-monospace,SFMono-Regular,Consolas,monospace;font-family:Inter,system-ui,-apple-system,BlinkMacSystemFont,"Segoe UI",sans-serif;font-size:14px}
*{box-sizing:border-box}body{margin:0;background:var(--bg);color:var(--text)}button,input,select,textarea{font:inherit}button,a,select,input[type=checkbox]{cursor:pointer}button{border:1px solid var(--line);background:var(--panel2);color:var(--text);padding:10px 14px;border-radius:7px;font-weight:600}button:hover{border-color:#67775c}button:disabled{opacity:.4;cursor:default}.primary{background:var(--green);border-color:var(--green);color:#172013}.small{padding:7px 10px;font-size:12px}.ghost{background:transparent}.shell{display:grid;grid-template-columns:232px 1fr;min-height:100vh}.sidebar{background:#15191b;border-right:1px solid var(--line);padding:28px 18px;position:fixed;inset:0 auto 0 0;width:232px;display:flex;flex-direction:column;gap:28px}.brand{display:flex;align-items:center;gap:11px;padding:0 10px}.brand svg{color:var(--green)}.brand strong{font-size:20px;letter-spacing:-.7px}.brand small{display:block;color:var(--sub);font:10px var(--mono);letter-spacing:1.4px;margin-top:4px}.navlabel{font:10px var(--mono);color:#728186;letter-spacing:1.6px;margin:0 12px 12px}.nav{display:grid;gap:6px}.nav button{text-align:left;border-color:transparent;background:transparent;color:var(--sub);display:flex;align-items:center;gap:12px;padding:12px}.nav button.active{color:var(--green);background:#263025;border-color:#3d4c32}.nav svg{width:18px;height:18px}.sidebottom{margin-top:auto;padding:16px 12px 0;border-top:1px solid var(--line);font-size:12px;color:var(--sub);line-height:1.8}.statusdot{display:inline-block;width:7px;height:7px;border-radius:50%;background:var(--green);margin-right:6px}.workspace{grid-column:2;min-width:0}.topbar{height:72px;border-bottom:1px solid var(--line);padding:0 32px;display:flex;align-items:center;justify-content:space-between}.crumb{font-size:12px;color:var(--sub)}.crumb span{color:var(--text);margin-left:10px}.topright{display:flex;gap:12px;align-items:center}.tag{font:10px var(--mono);letter-spacing:.8px;border:1px solid #5f5135;border-radius:4px;color:var(--amber);padding:5px 7px;white-space:nowrap}.tag.green{color:var(--green);border-color:#486238}.content{max-width:1510px;margin:auto;padding:30px 32px 40px}.heading{display:flex;align-items:flex-start;justify-content:space-between;gap:16px;margin-bottom:24px}h1{font-size:27px;font-weight:600;letter-spacing:-.8px;margin:0 0 7px}h2{font-size:16px;font-weight:600;margin:0}h3{font-size:13px;margin:0 0 12px}.subtitle,.muted{color:var(--sub)}.subtitle{font-size:13px;line-height:1.5;margin:0}.mono{font-family:var(--mono)}.eyebrow{font:10px var(--mono);letter-spacing:1.2px;color:var(--sub);text-transform:uppercase}.banner{display:flex;gap:11px;align-items:flex-start;padding:12px 15px;background:#27261e;border:1px solid #47422e;border-radius:7px;color:#ddcfad;font-size:12px;line-height:1.6;margin-bottom:20px}.banner b{color:var(--amber)}.banner svg{width:17px;height:17px;flex:none;margin-top:2px}.metrics{display:grid;grid-template-columns:repeat(4,1fr);gap:14px;margin:20px 0}.metric{background:var(--panel);border:1px solid var(--line);border-radius:9px;padding:18px}.metric .value{font:26px var(--mono);letter-spacing:-1px;margin:10px 0 8px}.metric .value small{font:12px var(--mono);color:var(--sub);letter-spacing:0}.metric .foot{font-size:11px;color:var(--sub)}.good{color:var(--green)}.warn{color:var(--amber)}.bad{color:var(--red)}.panel{border:1px solid var(--line);border-radius:9px;background:var(--panel);overflow:hidden}.panelhead{display:flex;align-items:center;justify-content:space-between;padding:18px 20px;border-bottom:1px solid var(--line);gap:12px}.panelbody{padding:20px}.grid{display:grid;grid-template-columns:minmax(0,1.55fr) minmax(300px,1fr);gap:20px;align-items:start}.stack{display:grid;gap:18px}.row{display:flex;align-items:center;gap:10px;flex-wrap:wrap}.between{justify-content:space-between}.sensor-tabs{display:flex;gap:6px;flex-wrap:wrap;margin-bottom:20px}.sensor-tabs button{font:12px var(--mono);padding:9px 14px;background:transparent}.sensor-tabs button.active{color:var(--green);border-color:#6c8c51;background:#252e23}.connector{display:inline-flex;align-items:center;gap:7px;font:11px var(--mono);color:var(--sub)}.connector b{color:var(--green);background:#283124;border:1px solid #425235;padding:4px 6px;border-radius:4px}.formgrid{display:grid;grid-template-columns:1fr 1fr;gap:16px}.field{display:grid;gap:8px}.field.wide{grid-column:1/-1}label{font-size:12px;color:#c9d2d2}.field small{color:var(--sub);font-size:11px;line-height:1.5}input,select,textarea{background:#111619;color:var(--text);border:1px solid #364147;border-radius:6px;padding:10px 11px;width:100%;outline:none}input:focus,select:focus,textarea:focus{border-color:var(--green);box-shadow:0 0 0 2px #b8ee8312}input[type=checkbox]{width:16px;height:16px;accent-color:var(--green)}.divider{height:1px;background:var(--line);margin:20px 0}.sectiontitle{font:10px var(--mono);letter-spacing:1.2px;color:var(--sub);margin:0 0 15px}.check{display:flex;align-items:flex-start;gap:10px;font-size:12px;line-height:1.7}.check input{flex:none;margin-top:3px}.hint{font-size:11px;color:var(--sub);line-height:1.6;margin:14px 0 0}.live-number{font:40px var(--mono);letter-spacing:-2px;margin:12px 0 3px}.live-number small{font:15px var(--mono);color:var(--sub);letter-spacing:0}.chart{width:100%;height:116px;display:block;margin-top:12px}.keyline{display:flex;justify-content:space-between;padding:10px 0;border-bottom:1px solid #293237;font-size:12px}.keyline:last-child{border:0}.keyline span{color:var(--sub)}.keyline strong{font:12px var(--mono)}.pinmap{display:flex;border:1px solid var(--line);border-radius:6px;overflow:hidden;margin:12px 0 14px}.pinmap div{flex:1;padding:12px 6px;text-align:center;border-right:1px solid var(--line);font:10px var(--mono);line-height:1.9}.pinmap div:last-child{border:0}.pinmap b{font-size:15px;color:var(--green);display:block}.guide-list{list-style:none;padding:0;margin:0;counter-reset:steps}.guide-list li{counter-increment:steps;display:flex;gap:10px;font-size:12px;line-height:1.7;padding:7px 0;color:#c2cdcd}.guide-list li:before{content:counter(steps,decimal-leading-zero);font:10px var(--mono);color:var(--green);padding-top:4px;flex:none}.tip{border-left:2px solid var(--green);padding:2px 0 2px 12px;color:var(--sub);font-size:11px;line-height:1.7;margin-top:14px}.footerbar{margin-top:20px;display:flex;align-items:center;justify-content:space-between;color:var(--sub);font-size:11px}.pill{font:10px var(--mono);padding:4px 7px;border-radius:20px;background:#263025;color:var(--green)}.pill.fault{background:#382724;color:var(--red)}.pill.unset{background:#332e21;color:var(--amber)}.sensorgrid{display:grid;grid-template-columns:repeat(3,1fr);gap:14px}.sensorcard{padding:18px;cursor:pointer}.sensorcard:hover{border-color:#667a53}.sensorcard .reading{font:29px var(--mono);margin:22px 0 10px}.sensorcard .reading small{font-size:12px;color:var(--sub)}table{width:100%;border-collapse:collapse;font-size:12px}th{text-align:left;font:10px var(--mono);color:var(--sub);padding:12px;border-bottom:1px solid var(--line)}td{padding:12px;border-bottom:1px solid #293237}td input{padding:7px}.tablewrap{overflow:auto}details{border-top:1px solid var(--line);padding:14px 0}summary{cursor:pointer;font-size:13px;font-weight:600}details p,details li{font-size:12px;line-height:1.7;color:#becaca}details ul{padding-left:18px}.guideselect{max-width:360px;margin-bottom:20px}.debuggrid{display:grid;grid-template-columns:1fr 1fr;gap:20px}.notice{background:#1f2a26;border:1px solid #3f5145;padding:12px;border-radius:6px;font-size:12px;line-height:1.7}.toast{position:fixed;right:24px;bottom:24px;max-width:480px;padding:15px 20px;background:#2c3c2a;color:var(--green);border:1px solid #668753;border-radius:8px;z-index:10;box-shadow:0 8px 40px #0005}.toast.error{background:#3e2926;border-color:#8c514c;color:#ffd2ce}.hidden{display:none!important}.mobilebrand{display:none}.offline{color:var(--red)}a{color:var(--green);text-underline-offset:3px}.log{font:11px/1.8 var(--mono);color:#b4c5c3;background:#111619;padding:14px;border-radius:6px;max-height:190px;overflow:auto;white-space:pre-wrap}.transfer{width:100%;height:160px;display:block}.mode-note{color:var(--sub);font-size:11px;line-height:1.7;margin-top:10px}.actions{display:flex;gap:8px;flex-wrap:wrap}.fine{font-size:11px;color:var(--sub);line-height:1.7}
@media(min-width:1500px){.content{padding-top:38px}.chart{height:150px}}
@media(max-width:1050px){.shell{grid-template-columns:190px 1fr}.sidebar{width:190px;padding:24px 10px}.content{padding:24px 20px}.topbar{padding:0 20px}.grid{grid-template-columns:1fr}.sensorgrid{grid-template-columns:repeat(2,1fr)}.metrics{grid-template-columns:repeat(2,1fr)}.grid>.stack{grid-template-columns:1fr 1fr;align-items:start}.debuggrid{grid-template-columns:1fr}}
@media(max-width:680px){.shell{display:block}.workspace{display:block}.sidebar{position:static;width:auto;display:block;padding:14px;border-right:0;border-bottom:1px solid var(--line)}.brand{padding:0 4px;margin-bottom:16px}.brand small{display:none}.navlabel,.sidebottom{display:none}.nav{display:flex;overflow:auto;gap:3px}.nav button{white-space:nowrap;font-size:11px;padding:9px}.nav svg{display:none}.topbar{height:60px;padding:0 16px}.topright .tag{display:none}.content{padding:22px 16px}.heading{display:block}.heading .actions{margin-top:14px}h1{font-size:24px}.metrics{gap:10px}.metric{padding:14px}.metric .value{font-size:23px}.grid>.stack{grid-template-columns:1fr}.formgrid{gap:14px}.panelbody{padding:16px}.panelhead{padding:16px}.sensorgrid{grid-template-columns:1fr}.debuggrid{grid-template-columns:1fr}.footerbar{display:block;line-height:2}.toast{left:16px;right:16px;bottom:16px}.crumb{font-size:10px}}
@media(max-width:640px){.secondary-fields{grid-template-columns:1fr}}
</style></head><body>
<div class="shell"><aside class="sidebar"><div class="brand"><svg width="31" height="34" viewBox="0 0 32 34" fill="none" stroke="currentColor" stroke-width="2"><path d="M5 7h22v20H5zM11 1v6m10-6v6M11 27v6m10-6v6M0 13h5m-5 8h5m22-8h5m-5 8h5"/><path d="M11 13h10v8H11z"/></svg><div><strong>ECU Studio<span style="color:var(--green)">.</span></strong><small>ESP32-S3 / SERVICE</small></div></div><div><p class="navlabel">WORKSPACE</p><nav class="nav" id="nav"></nav></div><div class="sidebottom"><div><span class="statusdot" id="connection-dot"></span><span id="connection">Connecting...</span></div><div class="mono" id="side-revision">Profile revision --</div><div style="margin-top:12px">Bench configuration monitor<br>All actuator outputs inhibited</div></div></aside>
<div class="workspace"><header class="topbar"><div class="crumb">Device workspace <span>/ <b id="breadcrumb">Sensor calibration</b></span></div><div class="topright"><span class="tag" id="environment">CONNECTING</span><button class="primary small" id="save" disabled>Save to device</button></div></header><main class="content"><div class="heading"><div><h1 id="title">Sensor calibration</h1><p class="subtitle" id="subtitle">Configure the electrical signal. Verify it against a known reference.</p></div><div class="actions"><button class="ghost small" id="export">Export profile</button><button class="ghost small" id="import">Import profile</button><input id="import-file" type="file" accept=".json,application/json" class="hidden"></div></div><div class="banner" id="scope"><svg viewBox="0 0 24 24" fill="none" stroke="currentColor" stroke-width="1.7"><path d="m12 3 10 18H2L12 3Z"/><path d="M12 9v5m0 3v1"/></svg><div><b>Bench service mode.</b> J3 open, actuator harnesses disconnected. Sensor settings change diagnostic readouts. Physical engine outputs remain inhibited.</div></div><div id="page"><div class="panel panelbody">Loading device profile and connection guides...</div></div><div class="footerbar"><span id="save-state">Waiting for device</span><span class="mono" id="last-sample">LIVE / --</span></div></main></div></div><div id="toast" class="toast hidden" role="status"></div>
<script src="/trigger_logger.js"></script>
<script src="/load_model.js"></script>
<script src="/secondary_tables.js"></script>
<script src="/flex_fuel.js"></script>
<script src="/engine_logger.js"></script>
<script src="/cylinder_tuning.js"></script>
<script src="/tuning_diagnostics.js"></script>
<script src="/idle_control.js"></script>
<script src="/transient_enrichment.js"></script>
<script>
'use strict';
const $=s=>document.querySelector(s),esc=s=>String(s??'').replace(/[&<>"']/g,c=>({'&':'&amp;','<':'&lt;','>':'&gt;','"':'&quot;',"'":'&#39;'}[c]));
const icons={overview:'<rect x="3" y="3" width="7" height="7"/><rect x="14" y="3" width="7" height="7"/><rect x="3" y="14" width="7" height="7"/><rect x="14" y="14" width="7" height="7"/>',calibration:'<path d="M4 7h16M4 17h16M8 3v8m8 2v8"/>',guides:'<path d="M3 4h7l2 2 2-2h7v16h-7l-2 2-2-2H3V4Zm9 2v16"/>',diagnostics:'<path d="M2 13h4l3-8 5 15 3-7h5"/>',device:'<path d="M4 6h16M4 12h16M4 18h16"/><circle cx="8" cy="6" r="2"/><circle cx="16" cy="12" r="2"/><circle cx="10" cy="18" r="2"/>'};
const pages={overview:['Live overview','Check signal health before entering calibration data.'],calibration:['Sensor calibration','Configure the electrical signal. Verify it against a known reference.'],guides:['Connection guides','Sensor wiring and checks. Open Trigger logging to inspect crank/cam edge captures.'],diagnostics:['Diagnostics','Inspect raw measurements and connection state without actuating outputs.'],triggers:['Trigger logging','Record crank/cam edges and inspect tooth intervals.'],engine:['Engine development','Configure engine maps and inspect timing execution. Physical outputs remain inhibited.'],screens:['Paired screens','Pair screens over ESP-NOW and manage saved receivers.'],device:['Device & profile','Configure the measurement reference and bench trigger decoder.']};
icons.triggers=icons.diagnostics;
icons.engine='<path d="M3 8h4V5h10v3h4v10h-4v3H7v-3H3zM10 10h4v6h-4z"/>';
icons.screens='<rect x="3" y="4" width="18" height="13" rx="2"/><path d="M8 21h8M12 17v4"/>';
let radioState,radioTimer;
let profile,savedProfile,guide,status,session,dirty=false,current='calibration',selected='map',guideSelected='map',online=false,busy=false,history={},events=[],lastFaults={},pollTimer,lastReceived=0;
function toast(s,error=false){const t=$('#toast');t.textContent=s;t.className='toast'+(error?' error':'');clearTimeout(toast.timer);toast.timer=setTimeout(()=>t.classList.add('hidden'),6500)}
async function api(path,options={}){const r=await fetch(path,{cache:'no-store',signal:AbortSignal.timeout(5000),...options,headers:{'Content-Type':'application/json',...(session?{'X-ECU-Token':session.token}:{}),...options.headers}});const j=await r.json();if(!r.ok)throw Error(j.error||`HTTP ${r.status}`);return j}
function markDirty(){dirty=true;$('#save').disabled=false;$('#save-state').textContent='Unsaved changes - measurements use the saved profile';$('#save-state').className='warn'}
function field(key,label,type='number',opts=''){let s=profile.sensors.find(x=>x.id===selected);return `<div class="field"><label for="f-${key}">${label}</label><input id="f-${key}" data-key="${key}" type="${type}" value="${esc(s[key])}" ${type==='number'?'step="any"':''} ${opts}></div>`}
function list(items){return `<ol class="guide-list">${items.map(s=>`<li>${esc(s)}</li>`).join('')}</ol>`}
function pins(g){return `<div class="pinmap">${g.pins.map(p=>`<div><b>${esc(p.split(' ')[0])}</b>${esc(p.slice(2))}</div>`).join('')}</div>`}
function selectedReading(){return status?.sensors.find(s=>s.id===selected)}
function nav(page){if(current==='triggers'&&page!=='triggers')leaveTriggers();if(current==='engine'&&page!=='engine')window.EcuEngineLogger?.detach();current=page;location.hash=page;$('#title').textContent=pages[page][0];$('#breadcrumb').textContent=pages[page][0];$('#subtitle').textContent=pages[page][1];document.querySelectorAll('[data-page]').forEach(b=>b.classList.toggle('active',b.dataset.page===page));render()}
function render(){if(!profile||!guide)return;const p=$('#page');if(current==='calibration')renderCalibration(p);if(current==='overview')renderOverview(p);if(current==='guides')renderGuides(p);if(current==='diagnostics')renderDiagnostics(p);if(current==='device')renderDevice(p);if(current==='screens')renderScreens(p);if(current==='engine')renderEngine(p);if(current==='triggers')renderTriggers(p);updateLive();}
function renderCalibration(p){const s=profile.sensors.find(x=>x.id===selected),g=guide.sensors.find(x=>x.id===selected);
 p.innerHTML=`<div class="sensor-tabs">${guide.sensors.map(x=>`<button data-sensor="${x.id}" class="${x.id===selected?'active':''}">${x.connector} / ${x.id.toUpperCase()}</button>`).join('')}</div><div class="grid"><section class="panel"><div class="panelhead"><div><h2>${esc(g.name)}</h2><div class="connector" style="margin-top:8px"><b>${g.connector}</b> ADC CH${g.adc_channel} <span>•</span> 0-5 V input</div></div><span class="pill unset" id="calbadge">UNCONFIRMED</span></div><div class="panelbody"><div class="formgrid">${field('label','Display name','text','maxlength="63"')}<div class="field"><label for="mode">Conversion method</label><select id="mode">${[['voltage','Voltage only'],['linear','Linear / two points'],['table','Voltage lookup table'],...(s.id==='clt'||s.id==='iat'?[['ntc_beta','NTC / beta curve']]:[])].map(([v,l])=>`<option value="${v}" ${s.mode===v?'selected':''}>${l}</option>`).join('')}</select></div>${field('unit','Physical unit','text','maxlength="15"')}${field('filter_ms','Readout filter (ms)','number','min="0" max="2000"')}</div><div class="divider"></div><p class="sectiontitle">TRANSFER FUNCTION</p><div id="conversion"></div><p class="mode-note" id="mode-note"></p><div class="divider"></div><p class="sectiontitle">INPUT FAULT LIMITS</p><div class="formgrid">${field('fault_low_v','Minimum signal (V)','number','min="0" max="5.3"')}${field('fault_high_v','Maximum signal (V)','number','min="0" max="5.3"')}</div><p class="hint">Limits use the instantaneous connector voltage. Filtering does not hide an electrical fault.</p><div class="divider"></div><label class="check"><input id="confirmed" type="checkbox" ${s.confirmed?'checked':''}><span>I verified the pinout and conversion against an independent reference. This does not qualify engine operation.</span></label></div></section><div class="stack"><section class="panel"><div class="panelhead"><h2>Live signal</h2><span class="eyebrow" id="live-label">WAITING</span></div><div class="panelbody"><span class="eyebrow">CONNECTOR VOLTAGE</span><div class="live-number"><span id="live-v">--</span> <small>V</small></div><div class="row between fine"><span>Last 60 samples</span><span>0-5.5 V</span></div><canvas class="chart" id="signal-chart"></canvas><div class="keyline"><span>Converted value</span><strong id="converted">--</strong></div><div class="keyline"><span>ADC raw / pin voltage</span><strong id="raw-value">--</strong></div><div class="keyline"><span>Input diagnosis</span><strong id="input-fault">--</strong></div></div></section><section class="panel"><div class="panelhead"><h2>Connection quick guide</h2><button class="small ghost" id="full-guide">Open guide ↗</button></div><div class="panelbody">${pins(g)}<p class="fine">Top view of PCB. Pin 1 is the square pad. Verify the mating plug orientation.</p>${list(g.checks.slice(0,2))}<div class="tip">${esc(g.circuit)}${g.optional_pullup?` ${g.optional_pullup} is optional and DNP by default.`:''}</div></div></section></div></div>`;
 document.querySelectorAll('[data-sensor]').forEach(b=>b.onclick=()=>{selected=b.dataset.sensor;render()});bindSensorFields();$('#mode').onchange=e=>{s.mode=e.target.value;if(s.mode==='voltage')s.unit='V';if(s.mode==='ntc_beta')s.unit='°C';markDirty();render()};$('#confirmed').onchange=e=>{s.confirmed=e.target.checked;markDirty()};$('#full-guide').onclick=()=>{guideSelected=selected;nav('guides')};renderConversion();}
function bindSensorFields(){document.querySelectorAll('[data-key]').forEach(input=>input.oninput=()=>{const s=profile.sensors.find(x=>x.id===selected);s[input.dataset.key]=input.type==='number'?input.value===''?null:Number(input.value):input.value;markDirty()})}
function renderConversion(){const s=profile.sensors.find(x=>x.id===selected),c=$('#conversion');const notes={voltage:'Shows the measured input voltage. No pressure, temperature or lambda curve is assumed.',linear:'Enter two voltage/value pairs from the actual sensor datasheet or measured references. Values outside these endpoints are reported as faults.',table:'Add 2-16 points in ascending voltage order. Interpolation is linear between adjacent points, with no extrapolation.',ntc_beta:'For a passive NTC on pins 1 and 3. The conversion uses the measured sensor supply and corrects the board input load of 55 kohm.'};$('#mode-note').textContent=notes[s.mode];
 if(s.mode==='voltage'){c.innerHTML='<div class="notice mono">V<sub>signal</sub> = ADC / 4095 × V<sub>ref</sub> / 0.6</div>';return}
 if(s.mode==='linear'){c.innerHTML=`<div class="formgrid">${field('v0','Point 1 / input (V)','number','min="0" max="5.3"')}${field('y0',`Point 1 / value (${esc(s.unit)})`)}${field('v1','Point 2 / input (V)','number','min="0" max="5.3"')}${field('y1',`Point 2 / value (${esc(s.unit)})`)}</div><div class="row" style="margin-top:12px"><button class="small" data-capture="v0">Use live V for point 1</button><button class="small" data-capture="v1">Use live V for point 2</button></div>`;c.querySelectorAll('[data-capture]').forEach(b=>b.onclick=()=>{const r=selectedReading();if(!online||!status?.fresh||!status.adc_ok||!Number.isFinite(r?.sensor_v))return toast('No fresh valid ADC sample.',true);s[b.dataset.capture]=Number(r.sensor_v.toFixed(4));markDirty();renderConversion()});}
 if(s.mode==='table'){c.innerHTML=`<table><thead><tr><th>INPUT / V</th><th>VALUE / ${esc(s.unit)}</th><th></th></tr></thead><tbody>${s.points.map((x,i)=>`<tr><td><input aria-label="Point ${i+1} volts" data-point="${i}" data-axis="v" type="number" step="any" value="${x.v}"></td><td><input aria-label="Point ${i+1} value" data-point="${i}" data-axis="value" type="number" step="any" value="${x.value}"></td><td><button class="small" data-remove="${i}" ${s.points.length<=2?'disabled':''}>×</button></td></tr>`).join('')}</tbody></table><button class="small" id="add-point" ${s.points.length>=16?'disabled':''} style="margin-top:12px">+ Add reference point</button>`;c.querySelectorAll('[data-point]').forEach(e=>e.oninput=()=>{s.points[Number(e.dataset.point)][e.dataset.axis]=e.value===''?null:Number(e.value);markDirty()});c.querySelectorAll('[data-remove]').forEach(e=>e.onclick=()=>{s.points.splice(Number(e.dataset.remove),1);markDirty();renderConversion()});$('#add-point').onclick=()=>{let last=s.points.at(-1);s.points.push({v:Math.min(5.3,Number(last.v)+.1),value:last.value});markDirty();renderConversion()};}
 if(s.mode==='ntc_beta'){c.innerHTML=`<div class="formgrid">${field('ntc_r0_ohm','Nominal resistance (ohm)')}${field('ntc_t0_c','Reference temperature (°C)')}${field('ntc_beta_k','Beta coefficient (K)')}${field('pullup_ohm','Measured pull-up (ohm)')}</div><label class="check" style="margin-top:16px"><input id="pullup" type="checkbox" ${s.pullup_fitted?'checked':''}><span>I physically fitted and measured ${s.id==='clt'?'R32':'R33'}. This checkbox does not install a resistor.</span></label>`;$('#pullup').onchange=e=>{s.pullup_fitted=e.target.checked;markDirty()};}
 bindSensorFields();}
function metric(label,id,unit,foot){return `<div class="metric"><div class="eyebrow">${label}</div><div class="value"><span id="${id}">--</span> <small>${unit}</small></div><div class="foot">${foot}</div></div>`}
function renderOverview(p){p.innerHTML=`<div class="metrics">${metric('Battery / protected input','m-battery','V','ADC CH6 / after reverse diode')}${metric('Sensor supply','m-rail','V','ADC CH7 / measured shared rail')}${metric('Crank speed','m-rpm','RPM','Missing-tooth bench decoder')}${metric('Actuator state','m-arm','','Hardware commands remain OFF')}</div><div class="row between" style="margin:24px 0 16px"><h2>Analog inputs</h2><span class="eyebrow">SELECT A SENSOR TO CALIBRATE</span></div><div class="sensorgrid">${guide.sensors.map(g=>`<section class="panel sensorcard" data-card="${g.id}"><div class="row between"><span class="connector"><b>${g.connector}</b> ${g.id.toUpperCase()}</span><span id="badge-${g.id}" class="pill unset">UNCONFIRMED</span></div><div class="reading" id="reading-${g.id}">--</div><div class="row between fine"><span id="volts-${g.id}">-- V</span><span>CH${g.adc_channel} →</span></div></section>`).join('')}</div><div class="notice" style="margin-top:20px">The six analog inputs share a protected 5 V supply. A short on one harness can disturb several readings. Check the rail before changing sensor curves.</div>`;document.querySelectorAll('[data-card]').forEach(c=>c.onclick=()=>{selected=c.dataset.card;nav('calibration')});}
function renderGuides(p){const all=[...guide.sensors,...guide.triggers,...guide.services.map(g=>({...g,id:g.connector,name:g.title}))];let g=all.find(x=>x.id===guideSelected)||all[0];p.innerHTML=`<div class="row between" style="margin-bottom:16px"><span class="fine">Connection guides include current firmware behavior. The build manual documents the archived hardware release.</span><button class="small" id="manual-reader">Full build & debug manual ↗</button></div><div class="field guideselect"><label for="guide-select">Choose a connection</label><select id="guide-select">${all.map(x=>`<option value="${esc(x.id)}" ${x.id===g.id?'selected':''}>${esc(x.connector)} / ${esc(x.name)}</option>`).join('')}</select></div><div class="grid"><section class="panel"><div class="panelhead"><h2>${esc(g.name)}</h2><span class="tag green">${esc(g.connector)}</span></div><div class="panelbody">${g.pins?pins(g):''}${g.mount?`<h3>Mounting & routing</h3>${list(g.mount)}<div class="divider"></div>`:''}<h3>Connect & verify</h3>${list(g.checks)}${g.expected?`<div class="divider"></div><h3>Expected behavior</h3>${list(g.expected)}`:''}${g.circuit?`<div class="tip">${esc(g.circuit)}</div>`:''}</div></section><div class="stack">${g.faults?`<section class="panel"><div class="panelhead"><h2>Fault tracing</h2><span class="eyebrow">CHECK IN ORDER</span></div><div class="panelbody">${list(g.faults)}</div></section>`:''}<section class="panel"><div class="panelhead"><h2>Before touching the harness</h2></div><div class="panelbody">${list(guide.general)}</div></section></div></div><section class="panel" style="margin-top:20px"><div class="panelhead"><h2>Calibration reference</h2><span class="eyebrow">BUNDLED CONNECTION GUIDE</span></div><div class="panelbody">${list(guide.config_help)}</div></section>`;$('#guide-select').onchange=e=>{guideSelected=e.target.value;render()};$('#manual-reader').onclick=readManual;}
async function readManual(){try{const manual=await api('/api/manual');$('#page').innerHTML=`<div class="row between" style="margin-bottom:20px"><button id="back-guides" class="small">← Connection guides</button><span class="tag green">${esc(manual.revision)} / SAME TEXT AS PDF</span></div><section class="panel"><div class="panelhead"><h2>Complete build & debug manual</h2></div><div class="panelbody"><div class="field"><label for="manual-page">Choose a chapter / page</label><select id="manual-page">${manual.pages.map((p,i)=>`<option value="${i}">${p.page}. ${esc(p.title)}</option>`).join('')}</select></div><p class="fine">Full instructions from the bundled PDF, including assembly, power checks, mounting, splash sealing and qualification records. Illustrations and printable templates are included in the release PDF/files.</p><div id="manual-text" style="white-space:pre-line;max-width:80ch;font-size:13px;line-height:1.9;border-top:1px solid var(--line);padding-top:20px"></div></div></section>`;const show=()=>{$('#manual-text').textContent=manual.pages[Number($('#manual-page').value)].text};$('#manual-page').onchange=show;$('#back-guides').onclick=render;show();window.scrollTo(0,0)}catch(e){toast(e.message,true)}}
function renderDiagnostics(p){p.innerHTML=`<div class="metrics">${metric('ADC interface','d-adc','','SPI / MCP3208')}${metric('Watchdog / SAFE_N','d-safe','','Released high when healthy')}${metric('Physical interlock','d-lock','','J3 open is expected for service')}${metric('Capture queue','d-overflow','','Overflow is latched until reboot')}</div><div class="debuggrid"><section class="panel"><div class="panelhead"><h2>Raw analog channels</h2><button class="small ghost" id="snapshot">Export diagnostic report</button></div><div class="tablewrap"><table><thead><tr><th>CH / CONNECTION</th><th>RAW / 4095</th><th>ADC PIN</th><th>CONNECTOR</th></tr></thead><tbody id="adc-rows"></tbody></table></div></section><div class="stack"><section class="panel"><div class="panelhead"><h2>Trigger & CAN reception</h2><span class="pill">LISTEN ONLY</span></div><div class="panelbody" id="digital-status"></div></section><section class="panel"><div class="panelhead"><h2>Connection events</h2><span class="eyebrow">THIS BROWSER SESSION</span></div><div class="panelbody"><div class="log" id="event-log">Waiting for measurements</div></div></section></div></div><section class="panel hidden" id="sim-controls" style="margin-top:20px"><div class="panelhead"><h2>Simulator fault injection</h2><span class="tag">NO HARDWARE CONNECTED</span></div><div class="panelbody"><div class="row"><select id="sim-sensor" style="width:auto">${guide.sensors.map(g=>`<option value="${g.id}">${g.connector} / ${g.id.toUpperCase()}</option>`).join('')}</select><button data-fault="normal">Normal</button><button data-fault="short">Short to ground</button><button data-fault="high">High signal</button><button data-fault="noise">Noisy signal</button><button data-fault="rail">5 V rail fault</button></div><p class="hint">These controls exist only in the desktop simulator. They never appear as ECU actuator controls.</p></div></section><p class="fine" style="margin-top:18px">CAN frame count is raw reception at 500 kbit/s, not decoded vehicle data. Engine controls show separate crank synchronization and 720° cam phase. Only the supported sequential mode uses the cam input for phase. There are no injector, ignition or relay actuation buttons.</p>`;$('#snapshot').onclick=()=>download('ecu-diagnostics.json',{exported_at:new Date().toISOString(),profile,status,events});if(session?.simulator){$('#sim-controls').classList.remove('hidden');document.querySelectorAll('[data-fault]').forEach(b=>b.onclick=async()=>{try{await api('/api/simulate',{method:'POST',body:JSON.stringify({sensor:$('#sim-sensor').value,fault:b.dataset.fault})});toast('Simulator condition updated');poll()}catch(e){toast(e.message,true)}});}}



const LEGACY_ENGINE_SIGNATURE='ESP32ECU SIL 001 INHIBITED',SEQUENTIAL_ENGINE_SIGNATURE='ESP32ECU SIL 002 INHIBITED',CYLINDER_ENGINE_SIGNATURE='ESP32ECU SIL 003 INHIBITED',WHOLE_ENGINE_SIGNATURE='ESP32ECU DEV 004 INHIBITED',IDLE_ENGINE_SIGNATURE='ESP32ECU DEV 005 INHIBITED',SEMI_ENGINE_SIGNATURE='ESP32ECU DEV 006 INHIBITED',TRANSIENT_ENGINE_SIGNATURE='ESP32ECU DEV 007 INHIBITED',LOAD_ENGINE_SIGNATURE='ESP32ECU DEV 008 INHIBITED',SECONDARY_ENGINE_SIGNATURE='ESP32ECU DEV 009 INHIBITED',ENGINE_SIGNATURE='ESP32ECU DEV 010 INHIBITED',MSQ_NS='http://www.msefi.com/:msq';
function engineCapabilities(signature){const index=[LEGACY_ENGINE_SIGNATURE,SEQUENTIAL_ENGINE_SIGNATURE,CYLINDER_ENGINE_SIGNATURE,WHOLE_ENGINE_SIGNATURE,IDLE_ENGINE_SIGNATURE,SEMI_ENGINE_SIGNATURE,TRANSIENT_ENGINE_SIGNATURE,LOAD_ENGINE_SIGNATURE,SECONDARY_ENGINE_SIGNATURE,ENGINE_SIGNATURE].indexOf(signature);return {known:index>=0,legacy:index===0,sequential:index===1,whole:index>=3,idle:index>=4,semi:index>=5,transient:index>=6,model:index>=7,secondary:index>=8,flex:index>=9,pages:index<2?'4':index===2?'5':'1'};}
const ENGINE_STRATEGIES=['batch_wasted_4cyl','sequential_4cyl','semi_sequential_4cyl'],ENGINE_STRATEGY_LABELS=['Batch / wasted','Sequential','Semi-sequential'];
function engineStrategyCode(strategy){const n=ENGINE_STRATEGIES.indexOf(strategy);if(n<0)throw Error('Unknown engine strategy.');return n;}
function engineTimingDefaults(){return {firing_order:[1,3,4,2],injection_end_deg:540,cam_sync_deg:450,cam_window_deg:20};}
function engineConstants(t,legacy=false,sequential=false,whole=true,idle=true,transient=true,model=true,secondary=true,flex=true){
 const values=[{page:0,name:'baseRevision',value:t.revision}];
 for(const group of ['engine','settings'])for(const [name,value] of Object.entries(t[group]))values.push({page:0,name,value,flag:typeof value==='boolean',group});
 if(!legacy){values.push({page:0,name:'engineStrategy',value:engineStrategyCode(t.strategy),strategy:true});for(const key of ['injection_end_deg','cam_sync_deg','cam_window_deg'])values.push({page:0,name:key,value:t.timing[key],group:'timing'});t.timing.firing_order.forEach((value,i)=>values.push({page:0,name:'fireOrder'+(i+1),value,order:i}));}
 for(const [name,value] of Object.entries(t.curves))values.push({page:0,name,value,curve:true});
 for(const [i,key] of ['ve','spark','lambda'].entries())for(const [suffix,field] of [['Rpm','rpm'],['Load','load'],['Table','cells']])values.push({page:i+1,name:key+suffix,value:t.maps[key][field],map:key,field});
 if(!legacy&&!sequential)values.push(...window.EcuCylinderTuning.constants(t));
 if(idle&&whole&&!legacy&&!sequential)values.push(...window.EcuIdleControl.constants(t));
 if(transient&&whole&&!legacy&&!sequential)values.push(...window.EcuTransientEnrichment.constants(t));
 if(model&&whole&&!legacy&&!sequential)values.push(...window.EcuLoadModel.constants(t));
 if(secondary&&whole&&!legacy&&!sequential)values.push(...window.EcuSecondaryTables.constants(t));
 if(flex&&whole&&!legacy&&!sequential)values.push(...window.EcuFlexFuel.constants(t));
 return whole&&!legacy&&!sequential?values.map(x=>({...x,page:0})):values;
}
function engineFieldUnits(name){
 const special={idle_kp:'%/RPM',idle_ki:'%/(RPM*s)',displacement_cc:'cc',injector_cc_min:'cc/min',fuel_density_g_cc:'g/cc',stoich_afr:'AFR',soft_limit_band:'RPM',rpm_hysteresis:'RPM',dfco_hysteresis:'RPM',dfco_tps:'%',afterstart_pct:'%',accel_threshold_pct_s:'%/s',accel_gain:'s/%',ego_min_clt:'C',max_duty:'ratio',ego_limit:'ratio'};
 return special[name]??(name.includes('rpm')?'RPM':name.endsWith('_ms')?'ms':name.includes('deg')?'deg':name.endsWith('_s')?'s':name.endsWith('_c')?'C':'');
}
function engineToMsq(t){
 window.EcuLoadModel.validateTune(t);window.EcuSecondaryTables.validateTune(t);window.EcuFlexFuel.validateTune(t);
 const doc=document.implementation.createDocument(MSQ_NS,'msq'),root=doc.documentElement;
 function add(parent,name,attrs){const e=doc.createElementNS(MSQ_NS,name);for(const [k,v]of Object.entries(attrs))e.setAttribute(k,v);parent.appendChild(e);return e;}
 add(root,'bibliography',{author:'ESP32ECU',tuneComment:'SHADOW ONLY; physical outputs inhibited; illustrative development tune'});
 add(root,'versionInfo',{fileFormat:'5.0',nPages:'1',signature:ENGINE_SIGNATURE});
 const ps=[8192].map((size,i)=>add(root,'page',{number:i,size}));
 for(const item of engineConstants(t)){
  const units=item.unit??(item.group?engineFieldUnits(item.name):item.field==='rpm'?'RPM':item.field==='load'?'source_units':item.field==='cells'?{ve:'%',spark:'deg',lambda:'lambda'}[item.map]:'');
  const attrs={name:item.name,units};if(Array.isArray(item.value)){attrs.rows=item.field==='cells'?(item.bins||16):item.value.length;attrs.cols=item.field==='cells'?(item.bins||16):1;}
  const e=add(ps[item.page],'constant',attrs);
  e.textContent=item.secEnum?window.EcuSecondaryTables.enumText(item.secKey,item.value):item.secPolarity?(item.value?'"Active high"':'"Active low"'):item.loadEnum?window.EcuLoadModel.enumText(item.loadKey,item.value):item.aeMode?'"'+window.EcuTransientEnrichment.modeLabels[item.value]+'"':item.aeApply?'"'+window.EcuTransientEnrichment.applyLabels[item.value]+'"':item.idleAlgorithm?'"'+item.value+'"':item.strategy?'"'+ENGINE_STRATEGY_LABELS[item.value]+'"':item.flag?(item.value?'"On"':'"Off"'):Array.isArray(item.value)?'\n'+Array.from({length:attrs.rows},(_,i)=>item.value.slice(i*attrs.cols,(i+1)*attrs.cols).join(' ')).join('\n')+'\n':String(item.value);
 }
 return '<?xml version="1.0" encoding="UTF-8"?>\n'+new XMLSerializer().serializeToString(doc)+'\n';
}
function engineFromMsq(text,template){
 if(/<!DOCTYPE|<!ENTITY/i.test(text)||text.includes('\0'))throw Error('MSQ XML declarations rejected.');
 const doc=new DOMParser().parseFromString(text,'application/xml'),root=doc.documentElement,info=doc.getElementsByTagNameNS(MSQ_NS,'versionInfo')[0];
 const caps=engineCapabilities(info?.getAttribute('signature'));
 if(doc.getElementsByTagName('parsererror').length||root.localName!=='msq'||root.namespaceURI!==MSQ_NS||!info||!caps.known||info.getAttribute('nPages')!==caps.pages)throw Error('Use an MSQ for this ESP32ECU definition. Other ECU tunes are incompatible.');
 const legacy=caps.legacy,sequential=caps.sequential,ownCurrent=caps.secondary,hasFlex=caps.flex,hasLoad=caps.model,hasTransient=caps.transient,hasSemi=caps.semi,hasIdle=caps.idle,ownWhole=caps.whole,result=structuredClone(template);result.schema_version=9;result.flex_fuel=window.EcuFlexFuel.defaults();result.secondary_tables=window.EcuSecondaryTables.defaults();result.load_model=window.EcuLoadModel.defaults();result.transient_enrichment=window.EcuTransientEnrichment.defaults();result.idle_control=window.EcuIdleControl.defaults();if(legacy||sequential)result.cylinder_trims=window.EcuCylinderTuning.defaults();if(legacy){result.strategy='batch_wasted_4cyl';result.timing=engineTimingDefaults();}
 const expected=new Map(engineConstants(result,legacy,sequential,ownWhole,hasIdle,hasTransient,hasLoad,ownCurrent,hasFlex).map(x=>[x.name,x])),seen=new Set();
 for(const e of doc.getElementsByTagNameNS(MSQ_NS,'constant')){
  const item=expected.get(e.getAttribute('name'));if(!item||seen.has(item.name)||e.parentNode.localName!=='page'||e.parentNode.getAttribute('number')!==String(item.page))throw Error('Unknown, duplicate or misplaced MSQ constant.');
  seen.add(item.name);const raw=e.textContent.trim();let value;
  if(item.secEnum)value=window.EcuSecondaryTables.parseEnum(item.secKey,raw);
  else if(item.secPolarity){if(!['"Active high"','"Active low"','0','1'].includes(raw))throw Error('Invalid secondary polarity.');value=['"Active high"','1'].includes(raw);}
  else if(item.loadEnum)value=window.EcuLoadModel.parseEnum(item.loadKey,raw);
  else if(item.aeMode||item.aeApply){const labels=item.aeMode?window.EcuTransientEnrichment.modeLabels:window.EcuTransientEnrichment.applyLabels;const quoted=labels.map(x=>'"'+x+'"');value=quoted.includes(raw)?quoted.indexOf(raw):labels.map((_,i)=>String(i)).includes(raw)?Number(raw):-1;if(value<0)throw Error('Invalid transient selection.');}
  else if(item.idleAlgorithm){const a=window.EcuIdleControl.algorithms;value=['0','1','2'].includes(raw)?a[Number(raw)]:a.find(x=>'"'+x+'"'===raw);if(!value)throw Error('Invalid idle algorithm.');}
  else if(item.strategy){const labels=hasSemi?ENGINE_STRATEGY_LABELS:ENGINE_STRATEGY_LABELS.slice(0,2),quoted=labels.map(x=>'"'+x+'"');value=quoted.includes(raw)?quoted.indexOf(raw):labels.map((_,i)=>String(i)).includes(raw)?Number(raw):-1;if(value<0)throw Error('Invalid MSQ strategy for its identity.');}
  else if(item.flag){if(!['"On"','"Off"','0','1'].includes(raw))throw Error('Invalid MSQ flag.');value=['"On"','1'].includes(raw);}
  else{const list=raw?raw.split(/\s+/).map(Number):[];if(list.some(x=>!Number.isFinite(x))||list.length!==(Array.isArray(item.value)?item.value.length:1))throw Error('MSQ value count or number invalid.');value=Array.isArray(item.value)?list:list[0];}
  if(item.flexKey)window.EcuFlexFuel.apply(result,item,value);else if(item.secKind){if(item.secMap)result.secondary_tables[item.secKind].map[item.field]=value;else result.secondary_tables[item.secKind][item.secKey]=value;}else if(item.loadKey)result.load_model[item.loadKey]=value;else if(item.aeMode)result.transient_enrichment.mode=window.EcuTransientEnrichment.modes[value];else if(item.aeApply)result.transient_enrichment.apply=window.EcuTransientEnrichment.applies[value];else if(item.aeKey)result.transient_enrichment[item.aeKey]=value;else if(item.idleKey)result.idle_control[item.idleKey]=value;else if(item.trimFlag||item.trimSpark!==undefined||item.trimCylinder!==undefined)window.EcuCylinderTuning.apply(result,item,value);else if(item.name==='baseRevision')result.revision=value;else if(item.strategy)result.strategy=ENGINE_STRATEGIES[value];else if(item.order!==undefined)result.timing.firing_order[item.order]=value;else if(item.group)result[item.group][item.name]=value;else if(item.curve)result.curves[item.name]=value;else result.maps[item.map][item.field]=value;
 }
 if(ownWhole&&!seen.has('baseRevision'))seen.add('baseRevision');
 if(seen.size!==expected.size)throw Error('Incomplete MSQ tune.');
 if(!hasIdle)result.settings.idle_enabled=false;
 if(!hasLoad)legacyEngineFuelBounds(result);
 return result;
}
function engineImportShape(value,template,path=""){
 if(path==='schema_version'&&value!==template)throw Error('Unsupported engine schema version.');
 if(typeof template==='number'){if(typeof value!=='number'||!Number.isFinite(value))throw Error('Engine import contains an invalid number.');return;}
 if(typeof template==='boolean'){if(typeof value!=='boolean')throw Error('Engine import contains an invalid flag.');return;}
 if(typeof template==='string'){if(path.startsWith('secondary_tables.')){const choices=window.EcuSecondaryTables.enums[path.split('.')[2]];if(!choices?.includes(value))throw Error('Unknown secondary selection.');return;}if(path.startsWith('load_model.')){const choices=window.EcuLoadModel.enums[path.slice(11)];if(!choices?.includes(value))throw Error('Unknown load-model selection.');return;}if(path==='idle_control.algorithm'){if(!window.EcuIdleControl.algorithms.includes(value))throw Error('Unknown idle algorithm.');return;}if(path==='transient_enrichment.mode'){if(!window.EcuTransientEnrichment.modes.includes(value))throw Error('Unknown transient mode.');return;}if(path==='transient_enrichment.apply'){if(!window.EcuTransientEnrichment.applies.includes(value))throw Error('Unknown transient application.');return;}if(path==='strategy'){if(!ENGINE_STRATEGIES.includes(value))throw Error('Unknown engine strategy.');return;}if(value!==template)throw Error('Engine tune identity or output inhibition changed.');return;}
 if(!value||typeof value!=='object'||Array.isArray(value)!==Array.isArray(template)||Object.keys(value).sort().join('|')!==Object.keys(template).sort().join('|'))throw Error('Engine tune schema or array size does not match.');
 for(const k of Object.keys(template))engineImportShape(value[k],template[k],path?path+'.'+k:k);
}
function legacyEngineFuelBounds(value){if(value.maps.ve.cells.some(v=>!Number.isFinite(v)||Math.fround(v)<20||Math.fround(v)>120))throw Error('Historical tune retains20..120 F32 fuel-coefficient bounds.');}
function upgradeLegacyEngine(value,template){
 if(![1,2,3,4,5,6,7,8].includes(value?.schema_version))return value;
 if(!(value.schema_version>=5?ENGINE_STRATEGIES:['batch_wasted_4cyl','sequential_4cyl']).includes(value.strategy))throw Error('Legacy schema cannot represent semi-sequential mode.');
 const old=structuredClone(template);delete old.flex_fuel;if(value.schema_version<8)delete old.secondary_tables;if(value.schema_version<7)delete old.load_model;if(value.schema_version<6)delete old.transient_enrichment;if(value.schema_version<4)delete old.idle_control;old.schema_version=value.schema_version;
 if(value.schema_version<3)delete old.cylinder_trims;
 if(value.schema_version===1){delete old.timing;old.strategy='batch_wasted_4cyl';}
 engineImportShape(value,old);if(value.schema_version===1&&value.strategy!=='batch_wasted_4cyl')throw Error('Legacy tune must use batch / wasted.');
 if(value.schema_version<7)legacyEngineFuelBounds(value);
 return {...value,schema_version:9,flex_fuel:window.EcuFlexFuel.defaults(),secondary_tables:value.schema_version<8?window.EcuSecondaryTables.defaults():value.secondary_tables,load_model:value.schema_version<7?window.EcuLoadModel.defaults():value.load_model,transient_enrichment:value.schema_version<6?window.EcuTransientEnrichment.defaults():value.transient_enrichment,settings:value.schema_version<4?{...value.settings,idle_enabled:false}:value.settings,timing:value.schema_version===1?engineTimingDefaults():value.timing,cylinder_trims:value.schema_version<3?window.EcuCylinderTuning.defaults():value.cylinder_trims,idle_control:value.schema_version<4?window.EcuIdleControl.defaults():value.idle_control};
}
function engineCycleSummary(t){
 const node=$('#engine-cycle-summary');if(!node)return;
 const order=t.timing.firing_order,valid=Array.isArray(order)&&order.length===4&&order[0]===1&&new Set(order).size===4&&order.every(x=>Number.isInteger(x)&&x>=1&&x<=4);
 if(!valid){node.innerHTML='<p class="hint bad">Enter a valid firing order to derive the editor timing contract. Save performs native validation.</p>';return;}
 const semi=t.strategy==='semi_sequential_4cyl',seq=t.strategy==='sequential_4cyl',angle=Number(t.timing.injection_end_deg),normalized=((angle%360)+360)%360;
 const label=document.querySelector('label[for=eng-injection_end_deg]');if(label)label.textContent=semi?'Pair closing reference, °after pair TDC; repeats every360°':seq?'Injector closing angle, °ATDC of each cylinder compression TDC':'Stored closing reference; batch uses its fixed opening phase';
 const pairs=[[order[0],order[2]],[order[1],order[3]]];
 node.innerHTML=`<p class="hint"><b>Timing from editor settings:</b> ${seq?'One full-fuel opening per cylinder per720°, with cam phase required.':semi?'Two half-fuel openings per cylinder per720°, one every360°. Cam phase is not required.':'Two half-fuel openings per cylinder per720°, all injectors starting together at the fixed batch phase. Cam phase is not required.'} Dead time is added once per opening. ${semi?`Closing reference ${esc(angle)}° repeats at ${esc(Number(normalized.toFixed(3)))}° each revolution.`:''} ${t.cylinder_trims.enabled&&!seq?'Individual trims are enabled: choose full sequential or disable trims before saving.':''}</p>${semi?`<div class="tablewrap"><table><thead><tr><th>Logical pair</th><th>Physical cylinders / J9 channels</th><th>Pair TDC spacing</th></tr></thead><tbody>${pairs.map((pair,i)=>`<tr><td>${i+1}</td><td>${pair.join(' + ')}</td><td>360°; groups separated180°</td></tr>`).join('')}</tbody></table></div><p class="hint">Keep each injector on its own J9 low-side driver. Do not bridge outputs or double the load on one driver. Pairing is scheduled in software. The closing reference repeats on both strokes; it does not identify compression. Compare executed rise/fall edges and digital pulse widths after saving.</p>`:''}`;
}
function engineFile(name,text,type){const a=document.createElement('a');a.href=URL.createObjectURL(new Blob([text],{type}));a.download=name;a.click();setTimeout(()=>URL.revokeObjectURL(a.href),1000);}

let engineTune,engineDirty=false,engineStatusTimer,engineRun,engineImportOrigin=undefined;
async function renderEngine(p){
 if(current!=='engine')return;
 clearTimeout(engineStatusTimer);
 p.innerHTML='<section class="panel panelbody"><p>Loading engine development tools...</p></section>';
 try{if(!engineTune)engineTune=await api('/api/engine/config');if(current!=='engine')return;
 const t=engineTune;
 p.innerHTML=`<div class="banner"><b>SHADOW / SIL ONLY</b><span>Four-cylinder batch, semi-sequential or cam-synchronized sequential proposals. This page cannot enable physical outputs. Defaults are illustrative, not an engine tune. The regression plant is unvalidated.</span></div><div class="actions" style="margin-bottom:18px"><button class="primary" id="engine-save">Save engine tune</button><button id="engine-reload">Reload saved tune</button><button id="engine-export">Export tune JSON</button><button id="engine-msq">Export TunerStudio MSQ</button><button id="engine-import">Import engine tune</button><input id="engine-import-file" type="file" accept=".json,.msq,application/json,application/xml" class="hidden"><span class="fine" id="engine-save-state">Revision ${t.revision}</span></div><div class="grid"><div class="stack"><section class="panel"><div class="panelhead"><h2>Engine and operating settings</h2></div><div class="panelbody"><div class="field"><label for="eng-strategy">Fuel and spark strategy</label><select id="eng-strategy"><option value="batch_wasted_4cyl" ${t.strategy==='batch_wasted_4cyl'?'selected':''}>Batch injection / wasted COP (360°)</option><option value="sequential_4cyl" ${t.strategy==='sequential_4cyl'?'selected':''}>Sequential fuel and spark (720°)</option><option value="semi_sequential_4cyl" ${t.strategy==='semi_sequential_4cyl'?'selected':''}>Semi-sequential fuel / wasted COP (360°)</option></select></div><details open><summary>Cycle, firing order and cam reference</summary><div class="field" style="margin-top:12px"><label for="eng-order">Firing order, starting with cylinder 1</label><input id="eng-order" value="${esc(t.timing.firing_order.join(', '))}" placeholder="1, 3, 4, 2"></div><div class="formgrid">${[['injection_end_deg','Injector closing angle, °ATDC of each cylinder compression TDC'],['cam_sync_deg','Cam rising edge, crank °ATDC of cylinder 1 compression TDC'],['cam_window_deg','Cam acceptance window, ±crank degrees']].map(([k,label])=>`<div class="field"><label for="eng-${k}">${label}</label><input id="eng-${k}" data-eng-group="timing" data-eng-key="${k}" type="number" step="any" value="${t.timing[k]}"></div>`).join('')}</div><div id="engine-cycle-summary"></div><p class="hint">Only full sequential mode requires a missing-tooth crank wheel and one rising cam pulse per 720°. Two valid cam pulses establish phase. Cam loss cuts and latches until a supervised stop. A reference 360° wrong cannot be detected from one cam pulse alone. Confirm compression TDC mechanically. J17 is crank, J18 is cam.</p><p class="hint">Sequential fuel uses one opening per 720°, with dead time once per opening. The 15 ms limit still applies; cold default enrichment can exceed it and inhibit fuel. The host regression plant uses a fixed 1-3-4-2 engine; use that order for its coupled runs. A cam edge is generated only for full sequential mode.</p></details><div class="formgrid">${Object.entries(t.engine).map(([k,v])=>`<div class="field"><label for="eng-${k}">${esc(k.replaceAll('_',' '))}</label><input id="eng-${k}" data-eng-group="engine" data-eng-key="${k}" type="number" step="any" value="${v}" ${k==='cylinders'?'readonly':''}></div>`).join('')}</div><details><summary>Starting, enrichment, protection and auxiliary proposals</summary><div class="formgrid" style="margin-top:16px">${Object.entries(t.settings).filter(([k])=>!k.startsWith('idle_')&&!k.startsWith('accel_')).map(([k,v])=>`<div class="field"><label for="eng-${k}">${esc(k.replaceAll('_',' '))}</label><input id="eng-${k}" data-eng-group="settings" data-eng-key="${k}" type="${typeof v==='boolean'?'checkbox':'number'}" ${typeof v==='boolean'?(v?'checked':''):`step="any" value="${v}"`}></div>`).join('')}</div></details><details><summary>Coolant and battery compensation curves</summary><div class="field" style="margin-top:12px"><label for="engine-curves">Curve arrays (JSON, increasing axes)</label><textarea id="engine-curves" rows="12" spellcheck="false">${esc(JSON.stringify(t.curves,null,2))}</textarea></div><p class="hint">Values are physical units. All curves are validated by the same C++ parser on target and host.</p></details><p class="hint">Current carrier limits: 15 ms injection, 3.5 ms dwell. Idle control drives virtual PWM in enabled SIL runs. Fan and pump remain proposals; physical engine outputs are inhibited.</p></div></section><section class="panel"><div class="panelhead"><h2>16 × 16 maps</h2><select id="engine-map-kind" style="width:auto"><option value="ve">Fuel coefficient (%)</option><option value="spark">Spark (degrees BTDC)</option><option value="lambda">Lambda target</option><option value="secondary_fuel">Secondary fuel map</option><option value="secondary_spark">Secondary spark map</option></select></div><div class="panelbody"><div id="engine-map"></div><p class="hint">Rows use the explicitly declared table basis. Columns: RPM. Bilinear interpolation; edge values clamp. Fuel coefficients allow0..255%; changing the source requires calibration review. Axes and all cells are validated on save.</p></div></section></div><div class="stack"><section class="panel"><div class="panelhead"><h2>Control diagnostics</h2><span class="tag">OUTPUTS INHIBITED</span></div><div class="panelbody" id="engine-live"></div></section><section class="panel"><div class="panelhead"><h2>Timing execution</h2><button class="small ghost" id="engine-timing-export">Export timing trace</button></div><div class="panelbody" id="engine-timing"><p class="hint">Waiting for timing diagnostics.</p></div></section><section class="panel"><div class="panelhead"><h2>Software-in-the-loop</h2><span class="tag">SYNTHETIC PLANT</span></div><div class="panelbody"><div class="field"><label for="engine-scenario">Regression scenario</label><select id="engine-scenario">${['warm_start','cold_start','throttle_step','load_step','trigger_dropout','sensor_short','overrev','stall_restart','load_stall_restart'].map(x=>`<option value="${x}">${x.replaceAll('_',' ')}</option>`).join('')}</select></div><details><summary>Synthetic flex sensor stimulus</summary><div class="field"><label for="engine-flex-emit">Generate raw flex edges for this run</label><input id="engine-flex-emit" type="checkbox"></div><div class="formgrid"><div class="field"><label for="engine-flex-hz">Frequency (Hz)</label><input id="engine-flex-hz" type="number" min="10" max="500" step="any" value="100"></div><div class="field"><label for="engine-flex-width">Low pulse (us)</label><input id="engine-flex-width" type="number" min="998" max="5002" step="any" value="3000"></div></div><p class="hint">Synthetic sensor waveform only. The regression plant retains fixed gasoline chemistry; this run does not validate ethanol combustion or sensor wiring.</p></details><div class="actions" style="margin-top:12px"><button id="engine-run">Run 12 virtual seconds</button><button id="engine-log">Export MSL log</button></div><p class="hint">Host simulator only. The native C++ ECU consumes generated 60-2 tooth events; virtual injector and spark edges feed an independent reduced-order plant. No predetermined RPM trace is played back.</p><pre id="engine-run-result" class="log" style="margin-top:14px">No SIL run yet.</pre></div></section></div></div>`;
 $('#eng-strategy').onchange=e=>{t.strategy=e.target.value;engineDirty=true;set('engine-save-state','Unsaved engine tune');engineCycleSummary(t);};
 $('#eng-order').onchange=e=>{t.timing.firing_order=e.target.value.trim().split(/[\s,]+/).map(Number);engineDirty=true;set('engine-save-state','Unsaved engine tune');engineCycleSummary(t);};
 document.querySelectorAll('[data-eng-key]').forEach(i=>i.onchange=()=>{t[i.dataset.engGroup][i.dataset.engKey]=i.type==='checkbox'?i.checked:Number(i.value);engineDirty=true;set('engine-save-state','Unsaved engine tune');engineCycleSummary(t);});
 $('#engine-curves').onchange=e=>{try{t.curves=JSON.parse(e.target.value);engineDirty=true;set('engine-save-state','Unsaved engine tune')}catch(err){toast('Invalid curve JSON: '+err.message,true)}};
 $('#engine-map-kind').onchange=()=>drawEngineMap();
 $('#engine-save').onclick=async()=>{try{for(const i of p.querySelectorAll('[data-eng-key][type=number]'))if(!i.value.trim()||!Number.isFinite(Number(i.value)))throw Error('Engine settings: enter a finite value in every numeric field.');window.EcuIdleControl.validate($('#engine-idle-panel'));window.EcuTransientEnrichment.validate($('#engine-transient-panel'));window.EcuLoadModel.validate($('#engine-load-panel'),t);window.EcuSecondaryTables.validate($('#engine-secondary-panel'),t);window.EcuFlexFuel.validate($('#engine-flex-panel'),t);const curves=JSON.parse($('#engine-curves').value);t.curves=curves;engineTune=await api('/api/engine/config',{method:'PUT',body:JSON.stringify(t)});engineDirty=false;engineImportOrigin=undefined;toast('Engine tune validated and saved. Physical outputs remain inhibited.');renderEngine(p)}catch(e){toast(e.message,true)}};
 $('#engine-reload').onclick=async()=>{try{engineTune=await api('/api/engine/config');engineDirty=false;engineImportOrigin=undefined;renderEngine(p)}catch(e){toast(e.message,true)}};
 $('#engine-export').onclick=()=>download('ecu-shadow-engine-tune.json',t);

 $('#engine-msq').onclick=()=>engineFile('ecu-shadow-engine-tune.msq',engineToMsq(t),'application/xml');
 $('#engine-import').onclick=()=>$('#engine-import-file').click();
 $('#engine-import-file').onchange=async event=>{const file=event.target.files[0];if(!file)return;try{
  if(file.size>65536)throw Error('Engine tune file exceeds 64 KiB.');
  const text=await file.text(),candidate=file.name.toLowerCase().endsWith('.msq')?engineFromMsq(text,t):upgradeLegacyEngine(JSON.parse(text),t);engineImportShape(candidate,t);
  if(!Number.isInteger(candidate.revision)||candidate.revision<1||candidate.revision>4294967295)throw Error('Invalid tune origin revision.');
  const ownWholeFile=file.name.toLowerCase().endsWith('.msq')&&engineCapabilities(new DOMParser().parseFromString(text,'application/xml').getElementsByTagNameNS(MSQ_NS,'versionInfo')[0]?.getAttribute('signature')).whole;
  if(!ownWholeFile&&candidate.revision!==t.revision)throw Error('Tune base revision differs. Reload and export a current tune before editing it.');
  const originElement=ownWholeFile?[...new DOMParser().parseFromString(text,'application/xml').getElementsByTagNameNS(MSQ_NS,'constant')].find(e=>e.getAttribute('name')==='baseRevision'):null;
  engineImportOrigin=ownWholeFile?(originElement?candidate.revision:null):undefined;
  // An offline file origin is metadata. Keep this loaded editor's CAS revision;
  // never fetch/rebase a newer server revision while importing someone’s file.
  if(ownWholeFile)candidate.revision=t.revision;
  engineTune=candidate;engineDirty=true;if(current==='engine'){await renderEngine(p);set('engine-save-state','Imported edits. '+(engineImportOrigin===undefined?'':'File origin '+(engineImportOrigin===null?'unavailable':engineImportOrigin)+', editor base '+t.revision+'. ')+'Review, then save to validate.');}toast('Engine edits imported for review. Save validates them; outputs stay inhibited.');
 }catch(e){toast(e.message,true)}};

 $('#engine-run').disabled=!session.simulator;$('#engine-log').disabled=!session.simulator;
 $('#engine-run').onclick=async()=>{if(engineDirty)return toast('Save or reload the engine tune before running SIL.',true);const button=$('#engine-run');button.disabled=true;try{engineRun=await api('/api/engine/run',{method:'POST',body:JSON.stringify({scenario:$('#engine-scenario').value,duration_s:12,...($('#engine-flex-emit').checked?{flex_stimulus:{frequency_hz:Number($('#engine-flex-hz').value),low_pulse_us:Number($('#engine-flex-width').value)}}:{})})});set('engine-run-result',JSON.stringify(engineRun.summary,null,2));await pollEngine()}catch(e){toast(e.message,true)}finally{if(current==='engine')button.disabled=false}};
 $('#engine-log').onclick=async()=>{try{const response=await fetch('/api/engine/log');if(!response.ok)throw Error('Run a SIL scenario before exporting.');const blob=await response.blob(),a=document.createElement('a');a.href=URL.createObjectURL(blob);a.download='ecu-sil.msl';a.click();setTimeout(()=>URL.revokeObjectURL(a.href),1000)}catch(e){toast(e.message,true)}};
 $('#engine-timing-export').onclick=async()=>{try{download('ecu-timing-trace.json',await api('/api/engine/timing'))}catch(e){toast(e.message,true)}};
 const loadPane=document.createElement('div');loadPane.id='engine-load-panel';p.append(loadPane);window.EcuLoadModel.attach(loadPane,t,()=>{engineDirty=true;set('engine-save-state','Unsaved engine tune')},()=>{drawEngineMap();const c=$('#engine-cylinder-panel');if(c)window.EcuCylinderTuning.attach(c,t,()=>{engineDirty=true;set('engine-save-state','Unsaved engine tune');engineCycleSummary(t)},toast);});
 const flexPane=document.createElement('div');flexPane.id='engine-flex-panel';p.append(flexPane);window.EcuFlexFuel.attach(flexPane,t,()=>{engineDirty=true;set('engine-save-state','Unsaved engine tune')});
 const secondaryPane=document.createElement('div');secondaryPane.id='engine-secondary-panel';p.append(secondaryPane);window.EcuSecondaryTables.attach(secondaryPane,t,()=>{engineDirty=true;set('engine-save-state','Unsaved engine tune');drawEngineMap();},kind=>{$('#engine-map-kind').value='secondary_'+kind;drawEngineMap();});
 const aePane=document.createElement('div');aePane.id='engine-transient-panel';p.append(aePane);window.EcuTransientEnrichment.attach(aePane,t,()=>{engineDirty=true;set('engine-save-state','Unsaved engine tune')});
 const cylinderPane=document.createElement('div');cylinderPane.id='engine-cylinder-panel';p.append(cylinderPane);window.EcuCylinderTuning.attach(cylinderPane,t,()=>{engineDirty=true;set('engine-save-state','Unsaved engine tune');engineCycleSummary(t)},toast);
 const idlePane=document.createElement('div');idlePane.id='engine-idle-panel';p.append(idlePane);window.EcuIdleControl.attach(idlePane,t,()=>{engineDirty=true;set('engine-save-state','Unsaved engine tune')});
 const logPane=document.createElement('div');p.append(logPane);window.EcuEngineLogger?.attach(logPane,{api,file:engineFile,toast,simulator:session.simulator,token:session.token});
 const tuningPane=document.createElement('div');p.append(tuningPane);window.EcuTuningDiagnostics?.attach(tuningPane,{api,file:engineFile,toast});
 engineCycleSummary(t);drawEngineMap();pollEngine();
 }catch(e){if(current==='engine')p.innerHTML='<section class="panel panelbody"><p>'+esc(e.message)+'</p></section>';}
}
function drawEngineMap(){const kind=$('#engine-map-kind').value,secondary=kind.startsWith('secondary_')?kind.slice(10):null,rule=secondary?engineTune.secondary_tables[secondary]:null,m=rule?rule.map:engineTune.maps[kind],basis=rule?window.EcuSecondaryTables.basis(engineTune,secondary):window.EcuLoadModel.basis(engineTune,kind),unit=esc(basis.unit),limits=rule?window.EcuSecondaryTables.cellLimits(secondary,rule.cells):kind==='ve'?[0,255]:kind==='spark'?[-5,40]:[.75,1.2];$('#engine-map').innerHTML=`<p class="hint ${basis.matched?'':'warn'}">Stored rows: ${unit}. ${rule?'Stored cells: '+esc(rule.cells)+' ('+esc(window.EcuSecondaryTables.cellUnit(secondary,rule.cells))+'). ':''}${basis.matched?'Basis matches selected source.':'Source differs; review and acknowledge in Load sources & fuel model.'}</p><div class="tablewrap"><table><thead><tr><th>${unit} / RPM</th>${m.rpm.map((x,i)=>`<th><input aria-label="RPM axis ${i+1}" data-axis="rpm" data-idx="${i}" type="number" style="width:64px" value="${x}"></th>`).join('')}</tr></thead><tbody>${m.load.map((load,y)=>`<tr><th><input aria-label="Load axis ${y+1} ${unit}" data-axis="load" data-idx="${y}" type="number" step="any" min="${basis.min}" max="${basis.max}" style="width:64px" value="${load}"></th>${m.rpm.map((rpm,x)=>`<td><input aria-label="${kind} at ${load} ${unit} ${rpm} RPM" data-cell="${y*16+x}" type="number" step="any" min="${limits[0]}" max="${limits[1]}" style="width:64px" value="${m.cells[y*16+x]}"></td>`).join('')}</tr>`).join('')}</tbody></table></div>`;document.querySelectorAll('[data-cell],[data-axis]').forEach(i=>i.onchange=()=>{const v=i.value.trim()?Number(i.value):NaN;if(i.dataset.axis)m[i.dataset.axis][Number(i.dataset.idx)]=v;else m.cells[Number(i.dataset.cell)]=v;engineDirty=true;set('engine-save-state','Unsaved engine tune');});}
async function pollEngine(){clearTimeout(engineStatusTimer);if(current!=='engine')return;try{const e=await api('/api/engine/status');if(current!=='engine')return;window.EcuCylinderTuning?.status(document.querySelector('#page'),e.cylinders);window.EcuIdleControl?.status(document.querySelector('#page'),e);window.EcuTransientEnrichment?.status(document.querySelector('#page'),e);window.EcuLoadModel?.status(document.querySelector('#page'),e);window.EcuSecondaryTables?.status(document.querySelector('#page'),e);window.EcuFlexFuel?.status(document.querySelector('#page'),e);const fields=['active_strategy','state','faults','crank_synced','phase_synced','phase_required','phase_reason','phase_losses','cam_rejected','cam_error_deg','rpm','ve_pct','target_lambda','pulse_ms','advance_deg','dwell_ms','deadtime_ms','warmup','afterstart','accel','ego','duty_pct','idle_pct','timing_stop_reason','timing_stops','timing_recoveries'];$('#engine-live').innerHTML=fields.map(k=>`<div class="keyline"><span>${esc(k.replaceAll('_',' '))}</span><strong>${typeof e[k]==='number'?num(e[k],k==='faults'?0:2):esc(k==='phase_reason'&&e.phase_required===false?'not required for current strategy':e[k]??'--')}</strong></div>`).join('')+'<p class="hint">'+esc(e.binding||e.execution)+'</p>'+(!e.storage_ok?'<p class="warn" role="alert">'+esc(e.error||'Engine tune storage unavailable. Defaults may be active; inspect UART. Saves are blocked.')+'</p>':'')+'<p class="hint">'+esc(e.simulator?(e.last_run?'Completed SIL snapshot, '+Math.floor((e.sample_age_ms||0)/1000)+' seconds since completion.':'No SIL result yet.'):(e.fresh?'Fresh shadow sample.':'Shadow sample is stale.'))+'</p>';const timing=e.timing;const pane=$('#engine-timing');if(pane){if(!timing)pane.innerHTML='<p class="hint">Timing diagnostics are not available in this firmware.</p>';else{const rows=[['Mode',timing.mode],['Fault',timing.fault],['Last fault',timing.last_fault],['Angle plan reason',timing.angle_stop_reason],['Dispatched edges',timing.dispatched],['Virtual high mask',timing.virtual_high_mask],['Physical high mask',timing.physical_high_mask],['Capture clock uncertainty (µs)',timing.clock_uncertainty_us],['Maximum dispatch lateness (µs)',timing.max_lateness_us],['Maximum capture age (µs)',timing.max_capture_age_us],['Producer age (µs)',timing.producer_age_us],['Maximum coil dispatch high (µs)',timing.max_coil_high_us],['Trace records overwritten',timing.trace_overwritten]];pane.innerHTML=rows.map(([label,value])=>'<div class="keyline"><span>'+esc(label)+'</span><strong>'+esc(value??'--')+'</strong></div>').join('')+'<p class="hint">'+esc(timing.qualification||'')+'</p>';if(timing.fault&&timing.fault!=='none')pane.innerHTML+='<p class="warn" role="alert">Timing execution is inhibited: '+esc(timing.fault)+'</p>';}}if(e.last_run&&!engineRun)set('engine-run-result',JSON.stringify(e.last_run,null,2));}catch(e){if(current==='engine'){set('engine-live','Engine diagnostics offline: '+e.message);window.EcuFlexFuel?.offline(document.querySelector('#page'));}}finally{if(current==='engine')engineStatusTimer=setTimeout(pollEngine,500);}}

function radioIndicatorText(r){
 const names={off:'off',green:'steady green',blue_blink:'blinking blue',red_blink:'blinking red'},colors={0:'off',1:'red',2:'green',4:'blue'};
 const policies=['off','green','blue_blink','red_blink'];
 if(r?.simulator!==false)return 'Host fixture: LED hardware is not measured.';
 const i=r.indicator;
 if(!i||i.available!==true||i.source!=='mcp23008_latch_readback')return 'Requested policy: '+(policies.includes(r.led)?names[r.led]:'unknown')+'. Hardware readback is unavailable; the indicator is advisory.';
 const unknown='LED readback is unknown or inconsistent. The indicator is advisory; light output and live CPU health are unproven.';
 if(i.contract!=='FLEX-G38-DRAFT1'||!policies.includes(i.requested_pattern)||!policies.includes(i.serviced_pattern)||
  !['known','fresh','ready','device_allocated'].every(k=>typeof i[k]==='boolean')||!Number.isInteger(i.sdk_error)||i.sdk_error< -2147483648||i.sdk_error>2147483647)return unknown;
 const policy='Requested '+names[i.requested_pattern]+'. ';
 if(!i.known)return policy+'Latch unknown. Current verification is unavailable. The indicator is advisory.';
 const u64=v=>typeof v==='string'&&/^(0|[1-9][0-9]{0,19})$/.test(v)&&BigInt(v)<=18446744073709551615n?BigInt(v):null;
 const stamp=u64(i.observed_us),completed=u64(i.read_completed_us),now=u64(i.snapshot_us);
 if(stamp===null||completed===null||now===null||completed<stamp||now<completed||![0,1,2,4].includes(i.last_verified_latch)||![0,1,2,4].includes(i.last_written_rgb)||![0,1,2,4].includes(i.requested_rgb))return unknown;
 const age=now-stamp,allowed={off:[0],green:[2],blue_blink:[0,4],red_blink:[0,1]};
 if(i.fresh&&age>250000n)return unknown;
 if(i.ready&&(!i.fresh||!i.device_allocated||i.sdk_error!==0||i.fault!=='none'||i.phase!=='monitoring_latch'||
  i.requested_pattern!==i.serviced_pattern||i.last_verified_latch!==i.last_written_rgb||i.last_verified_latch!==i.requested_rgb||!allowed[i.serviced_pattern].includes(i.requested_rgb)))return unknown;
 const detail=(Number(age)/1000).toFixed(1)+' ms old. ';
 return policy+(i.ready?'Expander latch verified ':'Historical latch: ')+colors[i.last_verified_latch]+', '+detail+
  (i.ready?'':'Current verification unavailable ('+(typeof i.fault==='string'?i.fault:'unknown')+', SDK '+i.sdk_error+'). ')+'Advisory only; light output and live CPU health are unproven.';
}
function radioLinkText(p){
 if(typeof p?.connected!=='boolean')return 'Link status unknown';
 if(p.connected&&(!Number.isInteger(p.last_ack_ms)||p.last_ack_ms<0||p.last_ack_ms>=3000))return 'Link acknowledgement unknown';
 return p.connected?'Link connected':'Link offline';
}
function radioEnginePeerText(p){
 const unknown='Engine observation ACK status unknown';
 if(typeof p?.engine_telemetry!=='boolean')return unknown;
 if(!p.engine_telemetry)return 'legacy sensor stream';
 const schema=p.engine_schema;if(!Number.isInteger(schema)||schema<1||schema>5)return unknown;
 if(typeof p.engine_connected!=='boolean'||!Number.isInteger(p.last_engine_ack_ms)||p.last_engine_ack_ms< -1||p.last_engine_ack_ms>9007199254740991||p.engine_parts_per_observation!==(schema===5?2:1)||typeof p.engine_pair_pending!=='boolean'||typeof p.engine_base_submitted!=='boolean'||p.engine_base_submitted&&(!p.engine_pair_pending||schema!==5)||p.engine_pair_pending&&schema!==5)return unknown;
 if(p.engine_connected&&(p.last_engine_ack_ms<0||p.last_engine_ack_ms>=3000)||!p.engine_connected&&p.last_engine_ack_ms>=0&&p.last_engine_ack_ms<3000)return unknown;
 return 'engine schema'+schema+' / '+p.engine_parts_per_observation+' datagram'+(schema===5?'s':'')+' per observation / '+(p.engine_connected?'complete engine observation ACK '+p.last_engine_ack_ms+' ms ago':p.last_engine_ack_ms<0?'no complete engine observation acknowledged':'engine observation ACK is stale')+(p.engine_pair_pending?(p.engine_base_submitted?' / base submitted, flex submission pending':' / pair submission pending'):'');
}
function renderScreens(p){
 p.innerHTML=`<section class="panel"><div class="panelhead"><h2>ESP-NOW screens</h2><span class="tag" id="radio-environment">LOADING</span></div><div class="panelbody"><p class="fine">Hold PAIR / BOOT for 3 seconds, or start pairing below. Enter the setup key on the future screen, then approve its name and MAC here or with a short PAIR press. Keep the key private. Pairing lasts 30 seconds.</p><div class="actions"><button class="primary" id="pair-open">Start pairing</button><button id="pair-cancel" disabled>Cancel pairing</button></div><p id="radio-status" role="status" aria-live="polite" class="fine">Loading radio status...</p><div id="pair-details" class="hidden"><div class="keyline"><span>Setup key</span><strong id="pair-key" style="overflow-wrap:anywhere;min-width:0"></strong></div><p class="hint">Enter this 32-character key on the screen or its setup tool. It is never broadcast over the radio.</p></div><div id="pair-candidate"></div><div class="divider"></div><h3>Saved screens</h3><div id="radio-peers"></div><p class="hint">A saved screen is connected only after authenticated acknowledgements. Unpair removes its saved key and stops future telemetry sends. Screens cannot control engine outputs. New screens can request authenticated engine telemetry with inputs, proposed fuel/spark, phase diagnostics and sample ages. Schema5 adds the complete flex record in a second authenticated datagram; both parts are required. The unchanged datagram budget normally allows up to8 complete schema5 observations/s. Existing screens keep their sensor stream and explicit upgrade/fallback status.</p><p class="fine" id="radio-engine-status"></p><p class="fine">LED policy: request steady green for normal operation, blinking blue for pairing and blinking red for detected problems. Faults take priority. No saved screens is a normal idle state. Readback is advisory; a stopped CPU or failed bus can retain the last color.</p><div id="radio-simulator" class="hidden"><div class="divider"></div><button id="sim-screen">Simulate a screen requesting pairing</button><p class="hint">Synthetic screen only. This simulator does not send ESP-NOW packets or prove radio range.</p></div></div></section>`;
 $('#pair-open').onclick=()=>radioAction({action:'open'});
 const indicator=document.createElement('p');indicator.id='radio-indicator-status';indicator.className='fine';indicator.textContent='LED hardware readback loading...';$('#radio-engine-status').after(indicator);
 $('#pair-cancel').onclick=()=>radioAction({action:'cancel',window:radioState?.window||''});
 $('#sim-screen').onclick=()=>radioAction({action:'simulate'});
 refreshRadio();
}
async function radioAction(command){
 try{await api('/api/radio',{method:'POST',body:JSON.stringify(command)});await refreshRadio();}catch(e){toast(e.message,true)}
}
async function refreshRadio(){
 clearTimeout(radioTimer);if(current!=='screens')return;
 try{
 const r=await api('/api/radio');if(current!=='screens')return;radioState=r;
 set('radio-environment',r.simulator?'SIMULATED RADIO':'ESP-NOW / CHANNEL '+(r.channel??6));
 set('radio-indicator-status',radioIndicatorText(r));
 set('radio-engine-status',r.simulator?'Host radio fixture only. No ESP-NOW packets are transmitted.':`Engine source: ${r.engine_data_source||'unknown'} / source age ${r.engine_sample_age_ms??'unknown'} ms / ${r.engine_observations_submitted??'unknown'} engine observations submitted / ${r.engine_datagrams_submitted??'unknown'} engine datagrams / ${r.mac_send_failures??0} MAC send failures. Link connectivity does not imply a complete engine observation or fresh flex data; receivers must assemble both schema5 packets and check original sample expiry.`);
 $('#pair-open').disabled=!r.available||!r.storage_ok||r.pairing||r.peers?.length>=r.max_peers;
 $('#pair-cancel').disabled=!r.pairing;
 set('radio-status',r.error||(r.pairing?`Pairing: ${r.remaining_s} seconds remaining.`:r.available?'Pairing closed. Telemetry goes only to saved screens.':'Radio unavailable. Check UART.'));
 $('#pair-details').classList.toggle('hidden',!r.pairing);set('pair-key',r.setup_key||'');
 $('#pair-candidate').innerHTML=r.candidate?`<div class="notice" style="margin-top:16px"><p>Screen: <b>${esc(r.candidate.name)}</b> / <span class="mono">${esc(r.candidate.mac)}</span></p><button id="pair-confirm" ${r.candidate.approved?'disabled':''}>${r.candidate.approved?'Waiting for screen key confirmation':'Approve screen'}</button></div>`:'';
 if(r.candidate&&!r.candidate.approved)$('#pair-confirm').onclick=()=>radioAction({action:'confirm',mac:r.candidate.mac,window:r.window});
 $('#radio-peers').innerHTML=(r.peers||[]).map(p=>`<div class="keyline" style="gap:12px;flex-wrap:wrap"><div><b>${esc(p.name)}</b><p class="fine mono">${esc(p.mac)} / ${esc(radioLinkText(p))}${p.last_ack_ms>=0?' / last reply '+num(p.last_ack_ms/1000,1)+' s ago':''} / ${esc(radioEnginePeerText(p))}${p.engine_telemetry_blocked?' / sensor stream fallback':''}${p.engine_upgrade_needed?' / update screen firmware for current engine data':p.engine_telemetry_blocked?' / current engine data unavailable':''}</p></div><button class="small" data-unpair="${esc(p.mac)}" aria-label="Unpair ${esc(p.name)}">Unpair</button></div>`).join('')||'<p class="fine">No screens paired.</p>';
 document.querySelectorAll('[data-unpair]').forEach(b=>b.onclick=()=>radioAction({action:'unpair',mac:b.dataset.unpair}));
 $('#radio-simulator').classList.toggle('hidden',!r.simulator);$('#sim-screen').disabled=!r.pairing||!!r.candidate;
 }catch(e){if(current==='screens'){set('radio-status',e.message+' Pairing controls unavailable.');set('radio-indicator-status','LED hardware readback unavailable. Previous latch status is unverified.');set('radio-engine-status','Engine telemetry and acknowledgement status unknown. Connection lost.');$('#pair-open').disabled=true;$('#pair-cancel').disabled=true;$('#pair-candidate').innerHTML='';$('#radio-peers').innerHTML='<p class="bad">Connection lost. Saved-screen state and previous link or engine acknowledgement ages are unknown.</p>';$('#pair-details').classList.add('hidden');set('pair-key','');}}
 finally{if(current==='screens')radioTimer=setTimeout(refreshRadio,500);}
}

function renderDevice(p){p.innerHTML=`<div class="grid"><section class="panel"><div class="panelhead"><h2>Measurement profile</h2><span class="eyebrow">PERSISTED IN NVS</span></div><div class="panelbody"><div class="formgrid"><div class="field wide"><label for="profile-name">Profile name</label><input id="profile-name" value="${esc(profile.name)}" maxlength="63"></div><div class="field"><label for="reference">Measured ADC reference (V)</label><input id="reference" type="number" step=".001" min="2.9" max="3.6" value="${profile.adc_reference_v}"><small>Measure U6 VREF to ground. This scales every analog channel.</small></div><div class="field"><label for="poll-rate">Browser update interval (ms)</label><input id="poll-rate" type="number" min="100" max="2000" step="100" value="${profile.ui_poll_ms}"><small>100-2000 ms. The monitor sampling loop runs independently.</small></div></div><div class="divider"></div><p class="sectiontitle">MISSING-TOOTH BENCH DECODER</p><div class="formgrid"><div class="field"><label for="slots">Total wheel slots</label><input id="slots" type="number" min="12" max="120" value="${profile.trigger.slots}"></div><div class="field"><label for="missing">Missing teeth</label><input id="missing" type="number" min="1" max="3" value="${profile.trigger.missing}"></div><div class="field"><label for="max-rpm">Capture ceiling (RPM)</label><input id="max-rpm" type="number" min="500" max="12000" value="${profile.trigger.max_rpm}"></div></div><p class="hint">Applied on save; cuts timing and resets crank sync. Rising edges only. The batch/wasted timing model uses 360° synchronization; sequential mode uses one rising cam pulse per 720° after two valid cam references.</p></div></section><div class="stack"><section class="panel"><div class="panelhead"><h2>Service connection</h2></div><div class="panelbody"><div class="keyline"><span>Network</span><strong>ECU-Service-XXXX</strong></div><div class="keyline"><span>Device URL</span><strong>192.168.4.1</strong></div><div class="keyline"><span>Wi-Fi password</span><strong>UART / new each boot</strong></div><div class="keyline"><span>UART</span><strong>115200 / 3.3 V</strong></div><p class="hint">Open J3 before boot. Work on a dry bench with the lid open: conductive enclosure lining can block Wi-Fi. Do not connect the DevKit USB power and carrier power together.</p></div></section><section class="panel"><div class="panelhead"><h2>Profile management</h2></div><div class="panelbody"><div class="actions"><button class="small" id="reload">Discard edits & reload</button><button class="small" id="defaults">Load defaults into editor</button></div><p class="hint">Save validates the complete profile and commits it before changing live conversion. Imported profiles use the current revision. Keep an exported backup before editing.</p><p class="fine" id="storage-status"></p></div></section><section class="panel"><div class="panelhead"><h2>Scope of this release</h2></div><div class="panelbody fine">Analog calibration, Hall capture, batch/wasted timing prototypes and engine maps are implemented with physical engine outputs inhibited. Timing and electrical behavior need hardware testing. DBW, immobilizer, OEM dashboard integration and emissions readiness are not implemented. A generic harness does not provide a universal OEM ECU replacement.</div></section></div></div>`;
 const bind=(id,obj,key)=>{$('#'+id).oninput=e=>{obj[key]=e.target.type==='number'?(e.target.value===''?null:Number(e.target.value)):e.target.value;markDirty()}};bind('profile-name',profile,'name');bind('reference',profile,'adc_reference_v');bind('poll-rate',profile,'ui_poll_ms');for(const k of ['slots','missing','max_rpm'])bind(k.replace('_','-'),profile.trigger,k);
 $('#reload').onclick=async()=>{try{profile=await api('/api/config');savedProfile=structuredClone(profile);dirty=false;$('#save').disabled=true;render();toast('Saved device profile reloaded')}catch(e){toast(e.message,true)}};
 $('#defaults').onclick=async()=>{const defaults=await api('/api/defaults').catch(()=>null);if(!defaults)return toast('Import config/defaults.json from the release bundle to restore defaults.',true);defaults.revision=profile.revision;profile=defaults;markDirty();render()};}
function num(n,d=2){return Number.isFinite(n)?n.toFixed(d):'--'}
function set(id,text,cls){const e=document.getElementById(id);if(e){e.textContent=text;if(cls!==undefined)e.className=cls}}
function updateLive(){if(!status)return;const age=status.sample_age_ms+(lastReceived?performance.now()-lastReceived:0),live=online&&status.fresh&&age<3000;set('last-sample',`${live?'LIVE':'STALE'} / ${num(age,0)} ms / rev ${status.revision}`);$('#last-sample').className='mono '+(live?'':'bad');set('side-revision',`Profile revision ${status.revision}`);set('connection',online?(session.simulator?'Simulator connected':'Device connected'):'Connection lost');$('#connection-dot').style.background=live?'var(--green)':'var(--red)';set('environment',session.simulator?'SIMULATOR / NO HARDWARE':'ESP32-S3 / BENCH');if(!dirty){set('save-state',`Saved profile / revision ${profile.revision} / ${status.storage}`);$('#save-state').className='';}
 set('m-battery',num(status.battery_v));set('m-rail',num(status.sensor_5v));set('m-rpm',num(status.rpm,0));set('m-arm','OFF','good');
 for(const r of status.sensors){const s=savedProfile.sensors.find(x=>x.id===r.id);const valid=live&&r.valid;set('reading-'+r.id,valid?num(r.value)+' '+s.unit:'--');set('volts-'+r.id,num(r.sensor_v,3)+' V');set('badge-'+r.id,!live?'STALE':!r.valid?'FAULT':!r.confirmed?'UNCONFIRMED':'OK','pill '+(!valid?'fault':!r.confirmed?'unset':''));}
 const r=selectedReading();if(r){const s=savedProfile.sensors.find(x=>x.id===selected);set('live-v',num(r.sensor_v,3));set('live-label',live?'LIVE / SAVED PROFILE':'STALE');set('converted',live&&r.valid?num(r.value)+' '+s.unit:'--');set('raw-value',`${r.raw} / ${num(r.adc_v,3)} V`);set('input-fault',live?r.fault:'connection stale',live&&r.valid?'good':'bad');set('calbadge',!live?'STALE':!r.valid?'FAULT':r.confirmed?'VERIFIED':'UNCONFIRMED','pill '+(!live||!r.valid?'fault':!r.confirmed?'unset':''));drawChart($('#signal-chart'),history[selected]||[]);}
 set('d-adc',live&&status.adc_ok?'OK':'FAULT',live&&status.adc_ok?'good':'bad');set('d-safe',status.safe?'HIGH':'LOW',status.safe?'good':'bad');set('d-lock',status.interlock?'CLOSED':'OPEN',status.interlock?'warn':'good');set('d-overflow',status.overflow?'LATCHED':'CLEAR',status.overflow?'bad':'good');
 if($('#adc-rows'))$('#adc-rows').innerHTML=status.raw_adc.map((n,i)=>`<tr><td class="mono">${i} / ${i<6?guide.sensors[i].connector:i===6?'VIN_PROT':'SENSOR_5V'}</td><td class="mono">${n}</td><td class="mono">${num(n*savedProfile.adc_reference_v/4095,3)} V</td><td class="mono">${num(i<6?status.sensors[i].sensor_v:i===6?status.battery_v:status.sensor_5v,3)} V</td></tr>`).join('');
 if($('#digital-status'))$('#digital-status').innerHTML=[['Crank edges',status.crank_edges],['Cam edges',status.cam_edges],['Crank / cam GPIO',`${status.crank_level} / ${status.cam_level}`],['Crank synchronization',status.synced?'SYNCED / 360°':'WAITING'],['CAN frames / 500 kbit/s',status.can_frames],['ARM / outputs','0 / ALL OFF']].map(([a,b])=>`<div class="keyline"><span>${a}</span><strong>${esc(b)}</strong></div>`).join('');
 set('event-log',events.slice(-12).join('\n')||'No connection transitions recorded.');set('storage-status',`Storage: ${status.storage}. ${status.storage_ok?'Ready to save.':'Saving is blocked; inspect UART.'}`);}
function drawChart(c,values){if(!c)return;const d=devicePixelRatio||1,w=c.clientWidth,h=c.clientHeight;c.width=w*d;c.height=h*d;const x=c.getContext('2d');x.scale(d,d);x.clearRect(0,0,w,h);x.strokeStyle='#303a3d';x.lineWidth=1;x.setLineDash([3,4]);for(let i=0;i<3;i++){let y=10+i*(h-20)/2;x.beginPath();x.moveTo(0,y);x.lineTo(w,y);x.stroke()}x.setLineDash([]);if(!values.length)return;const pts=values.map((v,i)=>[i/59*w,h-10-Math.max(0,Math.min(5.5,v))/5.5*(h-20)]);x.beginPath();x.moveTo(pts[0][0],h);pts.forEach(([a,b])=>x.lineTo(a,b));x.lineTo(pts.at(-1)[0],h);x.closePath();let gr=x.createLinearGradient(0,0,0,h);gr.addColorStop(0,'#b8ee8328');gr.addColorStop(1,'#b8ee8300');x.fillStyle=gr;x.fill();x.beginPath();pts.forEach(([a,b],i)=>i?x.lineTo(a,b):x.moveTo(a,b));x.strokeStyle='#b8ee83';x.lineWidth=2;x.stroke();}
function validate(p){if(!p||p.schema_version!==1||!Array.isArray(p.sensors)||p.sensors.length!==6)throw Error('Expected schema version 1 with all six sensors.');const range=(x,a,b,label,integer=false)=>{if(typeof x!=='number'||!Number.isFinite(x)||x<a||x>b||(integer&&!Number.isInteger(x)))throw Error(`${label}: enter ${integer?'an integer':'a finite number'} from ${a} to ${b}.`)};
 if(typeof p.name!=='string'||!p.name.trim()||new TextEncoder().encode(p.name).length>63)throw Error('Profile name is required (up to 63 bytes).');range(p.adc_reference_v,2.9,3.6,'ADC reference');range(p.ui_poll_ms,100,2000,'Update interval',true);range(p.trigger.slots,12,120,'Wheel slots',true);range(p.trigger.missing,1,3,'Missing teeth',true);if(p.trigger.missing>=Math.floor(p.trigger.slots/4))throw Error('Too many missing teeth for this wheel.');range(p.trigger.max_rpm,500,12000,'RPM ceiling',true);
 const ids=['map','tps','clt','iat','wideband','postcat'];p.sensors.forEach((s,i)=>{let n=s.id.toUpperCase();if(s.id!==ids[i])throw Error('Sensor order / identity cannot be changed.');if(!['voltage','linear','table','ntc_beta'].includes(s.mode))throw Error(n+': unknown conversion mode.');for(const [key,max]of [['label',63],['unit',15]])if(typeof s[key]!=='string'||!s[key].trim()||new TextEncoder().encode(s[key]).length>max)throw Error(n+': '+key+' is missing or too long.');range(s.fault_low_v,0,5.3,n+' minimum voltage');range(s.fault_high_v,0,5.3,n+' maximum voltage');if(s.fault_low_v>=s.fault_high_v)throw Error(n+': minimum fault limit must be below maximum.');range(s.filter_ms,0,2000,n+' filter');range(s.v0,0,5.3,n+' point 1 voltage');range(s.v1,0,5.3,n+' point 2 voltage');if(s.v1-s.v0<.01)throw Error(n+': calibration voltages must be ascending and at least 0.01 V apart.');range(s.y0,-1e5,1e5,n+' point 1 value');range(s.y1,-1e5,1e5,n+' point 2 value');if(!Array.isArray(s.points)||s.points.length<2||s.points.length>16)throw Error(n+': use 2-16 table points.');s.points.forEach((x,k)=>{range(x.v,0,5.3,n+' table voltage');range(x.value,-1e5,1e5,n+' table value');if(k&&x.v-s.points[k-1].v<.001)throw Error(n+': table voltages must be ascending by at least 0.001 V.');});range(s.ntc_r0_ohm,100,1e6,n+' nominal resistance');range(s.ntc_t0_c,-50,150,n+' reference temperature');range(s.ntc_beta_k,1000,10000,n+' beta');range(s.pullup_ohm,100,1e5,n+' pull-up');if(s.mode==='ntc_beta'&&(!['clt','iat'].includes(s.id)||s.pullup_fitted!==true))throw Error(n+': NTC requires CLT/IAT and a physically fitted pull-up.');});}
async function save(){if(busy)return;try{validate(profile);busy=true;$('#save').textContent='Saving...';const saved=await api('/api/config',{method:'PUT',body:JSON.stringify(profile)});profile=saved;savedProfile=structuredClone(saved);dirty=false;$('#save').disabled=true;toast('Profile validated and saved. Live conversion updated.');render();await poll()}catch(e){toast(e.message,true)}finally{busy=false;$('#save').textContent='Save to device'}}
function download(name,data){const a=document.createElement('a');a.href=URL.createObjectURL(new Blob([JSON.stringify(data,null,2)],{type:'application/json'}));a.download=name;a.click();setTimeout(()=>URL.revokeObjectURL(a.href),1000)}
async function poll(){clearTimeout(pollTimer);try{status=await api('/api/status');lastReceived=performance.now();online=true;if(status.revision!==savedProfile.revision){savedProfile=await api('/api/config');if(!dirty){profile=structuredClone(savedProfile);render();}}for(const r of status.sensors){(history[r.id]??=[]).push(r.sensor_v);if(history[r.id].length>60)history[r.id].shift();let f=status.fresh&&r.valid?'ok':r.fault;if(lastFaults[r.id]!==f){events.push(new Date().toLocaleTimeString()+' '+r.id.toUpperCase()+' / '+f);lastFaults[r.id]=f;}}if(events.length>100)events=events.slice(-100);updateLive()}catch(e){online=false;set('connection','Connection lost','offline');set('last-sample','OFFLINE / last values are stale','mono bad');if(status){status.fresh=false;updateLive()}}finally{pollTimer=setTimeout(poll,profile?.ui_poll_ms||500)}}
async function start(){try{[session,profile,guide]=await Promise.all([api('/api/session'),api('/api/config'),api('/api/guide')]);savedProfile=structuredClone(profile);$('#nav').innerHTML=Object.entries(pages).map(([id,v])=>`<button data-page="${id}"><svg viewBox="0 0 24 24" fill="none" stroke="currentColor" stroke-width="1.5">${icons[id]}</svg>${v[0]}</button>`).join('');document.querySelectorAll('[data-page]').forEach(b=>b.onclick=()=>nav(b.dataset.page));let hash=location.hash.slice(1);nav(pages[hash]?hash:'calibration');$('#save').onclick=save;$('#export').onclick=()=>{try{validate(profile);download('ecu-profile.json',profile)}catch(e){toast(e.message,true)}};$('#import').onclick=()=>$('#import-file').click();$('#import-file').onchange=async e=>{try{const file=e.target.files[0];if(!file)return;if(file.size>16384)throw Error('Profile exceeds 16 KiB.');const loaded=JSON.parse(await file.text());validate(loaded);loaded.revision=profile.revision;profile=loaded;markDirty();render();toast('Imported into editor. Save to apply.')}catch(e){toast(e.message,true)}finally{e.target.value=''}};await poll()}catch(e){$('#page').innerHTML='<section class="panel panelbody"><h2>Cannot load device</h2><p class="fine">'+esc(e.message)+'. Check the service Wi-Fi connection and reload this page.</p></section>'}}
setInterval(()=>{if(status&&lastReceived&&performance.now()-lastReceived>3000){online=false;updateLive()}},500);
window.addEventListener('beforeunload',e=>{if(dirty){e.preventDefault();e.returnValue=''}});window.addEventListener('resize',()=>drawChart($('#signal-chart'),history[selected]||[]));start();
</script></body></html>
)ECU_ASSET";
inline constexpr char trigger_js[]=R"ECU_ASSET('use strict';
let triggerFrame=null,triggerTimer,triggerView=0,triggerRead=0,triggerBusy=false;
function leaveTriggers(){clearTimeout(triggerTimer);++triggerView;triggerBusy=false;}
function triggerVisible(view){return current==='triggers'&&view===triggerView;}
function triggerHeader(frame){
 if(frame.schema_version!==1||!Number.isInteger(frame.frame_id)||frame.frame_id<0||frame.frame_id>4294967295||
    !Number.isInteger(frame.count)||frame.count<0||frame.count>512||frame.snapshot_superseded!==false||
    !['idle','armed','full','timeout','stopped','clock_reversed'].includes(frame.state))throw Error('Invalid or replaced trigger frame. Reload the capture.');
 return frame;
}
async function readTriggerFrame(header,keep=()=>true){
 triggerHeader(header);const records=[];
 if(header.state==='armed')return {...header,records};
 for(let offset=0;offset<header.count;offset+=64){
  if(!keep())throw Error('Trigger view changed.');
  const part=triggerHeader(await api(`/api/engine/trigger-log?frame_id=${header.frame_id}&offset=${offset}`));
  const count=Math.min(64,header.count-offset);
  if(part.frame_id!==header.frame_id||part.count!==header.count||part.state!==header.state||part.offset!==offset||part.returned!==count||!Array.isArray(part.records)||part.records.length!==count)throw Error('Trigger capture changed during download. Reload it.');
  for(const [i,row] of part.records.entries()){
   if(row.sequence!==offset+i+1||!['crank','cam'].includes(row.channel)||typeof row.high!=='boolean'||row.timebase_valid!==true||
      !Number.isSafeInteger(row.captured_us)||row.captured_us<0||!Number.isSafeInteger(row.callback_us)||row.callback_us<row.captured_us||
      !Number.isInteger(row.configuration_epoch)||row.configuration_epoch<0||row.configuration_epoch>4294967295||
      !(row.raw_counter===null||Number.isInteger(row.raw_counter)&&row.raw_counter>=0&&row.raw_counter<=4294967295))throw Error('Trigger record is invalid. No export was produced.');
   records.push(row);
  }
 }
 const final=triggerHeader(await api('/api/engine/trigger-log'));
 if(final.frame_id!==header.frame_id||final.count!==header.count||final.state!==header.state)throw Error('A new capture replaced this frame. Reload it.');
 return {...header,records};
}
function renderTriggers(p){
 clearTimeout(triggerTimer);const view=++triggerView;triggerBusy=false;
 p.innerHTML=`<div class="banner"><b>INPUT DIAGNOSTICS</b><span>J17 crank and J18 cam, after Hall conditioning. Physical outputs remain inhibited. Digital captures do not measure sensor voltage. Continuous cam phase is shown in Engine development.</span></div><section class="panel"><div class="panelhead"><h2>Crank / cam recording</h2><span id="trigger-state" class="pill unset">LOADING</span></div><div class="panelbody"><div class="formgrid"><div class="field"><label for="trigger-samples">Maximum recorded edges</label><select id="trigger-samples"><option>128</option><option>256</option><option>512</option></select></div><div class="field"><label for="trigger-timeout">Recording window (ms)</label><input id="trigger-timeout" type="number" min="50" max="5000" step="50" value="1000"></div></div><div class="actions" style="margin-top:16px"><button class="primary" id="trigger-start">${session.simulator?'Replay SIL window':'Record trigger window'}</button><button id="trigger-stop" disabled>Stop recording</button><button id="trigger-reload">Reload capture</button><button id="trigger-json" disabled>Export trigger JSON</button><button id="trigger-msl" disabled>Export trigger MSL</button></div><p id="trigger-status" class="fine" role="status" aria-live="polite">Loading recorder...</p><p id="trigger-source" class="hint"></p><p class="hint">The frame freezes at its edge limit, timeout or Stop. Host replay uses the final window of a completed SIL run and contains rising crank edges and, for sequential runs, generated cam edges. Falling edges are not simulated. Run a scenario in Engine development first.</p><p class="hint">At J17/J18, verify ground and a compatible 5 V Hall interface before applying an isolated test signal. A raw VR sensor requires a conditioner. Keep actuator harnesses disconnected.</p></div></section><section class="panel" style="margin-top:18px"><div class="panelhead"><h2>Recorded inputs and tooth intervals</h2><span id="trigger-frame-id" class="eyebrow">NO FRAME</span></div><div class="panelbody"><div class="formgrid"><div class="field"><label for="trigger-zoom">Zoom</label><input id="trigger-zoom" type="range" min="1" max="20" value="1"></div><div class="field"><label for="trigger-pan">Window position</label><input id="trigger-pan" type="range" min="0" max="100" value="0"></div></div><p id="trigger-window" class="fine"></p><svg id="trigger-scope" role="img" aria-label="Recorded crank and cam input edges" style="width:100%;height:190px;display:block"></svg><svg id="trigger-periods" role="img" aria-label="Intervals between recorded rising crank edges" style="width:100%;height:180px;display:block"></svg><div id="trigger-summary" class="fine"></div><p class="hint">Long intervals above 1.5 × median are highlighted. Intentional missing teeth, signal loss and lost captures can all make long intervals. A digital trace cannot distinguish these causes by itself.</p><details><summary>Raw recorded edges</summary><div id="trigger-rows" class="tablewrap" style="max-height:320px"></div></details></div></section>`;
 $('#trigger-start').onclick=()=>triggerAction({action:'start',samples:Number($('#trigger-samples').value),timeout_ms:Number($('#trigger-timeout').value)},view);
 $('#trigger-stop').onclick=()=>triggerAction({action:'stop',frame_id:triggerFrame?.frame_id||0},view);
 $('#trigger-reload').onclick=()=>refreshTriggers(view);
 $('#trigger-json').onclick=()=>{if(triggerFrame?.records.length===triggerFrame?.count)download('ecu-trigger-capture.json',triggerFrame)};
 $('#trigger-msl').onclick=()=>{try{engineFile('ecu-trigger-capture.msl',triggerToMsl(triggerFrame),'text/plain')}catch(e){toast(e.message,true)}};
 $('#trigger-zoom').oninput=$('#trigger-pan').oninput=drawTriggerCharts;
 refreshTriggers(view);
}
async function triggerAction(command,view){
 if(triggerBusy||!triggerVisible(view))return;
 triggerBusy=true;++triggerRead;clearTimeout(triggerTimer);$('#trigger-start').disabled=true;$('#trigger-stop').disabled=true;
 try{const frame=await api('/api/engine/trigger-log',{method:'POST',body:JSON.stringify(command)});if(triggerVisible(view))await refreshTriggers(view,frame.frame_id)}
 catch(e){if(triggerVisible(view))toast(e.message,true)}
 finally{if(triggerVisible(view)){triggerBusy=false;$('#trigger-start').disabled=triggerFrame?.state==='armed'||triggerFrame?.available===false;$('#trigger-stop').disabled=triggerFrame?.state!=='armed';}}
}
async function refreshTriggers(view=triggerView,expected=null){
 clearTimeout(triggerTimer);const request=++triggerRead,keep=()=>triggerVisible(view)&&request===triggerRead;
 try{
  const header=triggerHeader(await api('/api/engine/trigger-log'));
  if(expected!==null&&header.frame_id!==expected)throw Error('Another capture replaced the requested frame. Reload it.');
  const frame=await readTriggerFrame(header,keep);if(!keep())return;
  triggerFrame=frame;const armed=frame.state==='armed',ready=!armed&&frame.records.length===frame.count&&frame.count>0;
  $('#trigger-state').textContent=frame.state.toUpperCase();$('#trigger-state').className='pill'+(armed?' unset':frame.state==='clock_reversed'?' fault':'');
  $('#trigger-status').textContent=`Frame ${frame.frame_id}: ${frame.count} / ${frame.requested} edges. ${frame.prearm_ignored||0} pre-arm and ${frame.invalid_timebase_ignored||0} unresolved timestamps ignored.`;
  $('#trigger-source').textContent=(frame.simulator?'COMPLETED SYNTHETIC SIL. ':'MCU DIGITAL CAPTURE. ')+(frame.qualification||'');
  if(frame.available===false)$('#trigger-status').textContent+=' '+(frame.simulator?'Run a SIL scenario before replaying.':'Recorder unavailable: '+frame.driver_error);
  $('#trigger-start').disabled=armed||triggerBusy||frame.available===false;$('#trigger-stop').disabled=!armed||triggerBusy;
  $('#trigger-json').disabled=$('#trigger-msl').disabled=!ready;
  $('#trigger-frame-id').textContent=frame.frame_id?'FRAME '+frame.frame_id:'NO FRAME';
  drawTriggerCharts();renderTriggerRows();
  if(armed)triggerTimer=setTimeout(()=>refreshTriggers(view,frame.frame_id),250);
 }catch(e){if(keep()){$('#trigger-status').textContent='Recorder unavailable: '+e.message;$('#trigger-json').disabled=$('#trigger-msl').disabled=true;toast(e.message,true)}}
}
function triggerSeries(frame){
 const rows=[...(frame?.records||[])].sort((a,b)=>a.captured_us-b.captured_us||a.sequence-b.sequence),periods=[];let previous=null;
 for(const row of rows)if(row.channel==='crank'&&row.high){if(previous!==null)periods.push({time:row.captured_us,period:row.captured_us-previous,sequence:row.sequence});previous=row.captured_us;}
 const sorted=periods.map(p=>p.period).sort((a,b)=>a-b),median=sorted.length?(sorted[Math.floor((sorted.length-1)/2)]+sorted[Math.floor(sorted.length/2)])/2:0;
 return {rows,periods,median};
}
function drawTriggerCharts(){
 const scope=document.querySelector('#trigger-scope'),plot=document.querySelector('#trigger-periods');if(!scope||!plot)return;
 const {rows,periods,median}=triggerSeries(triggerFrame),width=Math.max(280,scope.getBoundingClientRect().width),left=54,right=width-12;
 scope.setAttribute('viewBox',`0 0 ${width} 190`);plot.setAttribute('viewBox',`0 0 ${width} 180`);
 const text=(x,y,value,fill='var(--sub)',anchor='start')=>`<text x="${x}" y="${y}" fill="${fill}" text-anchor="${anchor}" font-size="10" font-family="var(--mono)">${esc(value)}</text>`;
 if(!rows.length){scope.innerHTML=text(left,75,triggerFrame?.state==='armed'?'Recording input edges...':'No recorded input edges');plot.innerHTML='';$('#trigger-window').textContent='';$('#trigger-summary').textContent='';return;}
 const first=rows[0].captured_us,last=rows.at(-1).captured_us,total=Math.max(1,last-first),span=total/Number($('#trigger-zoom').value),start=first+(total-span)*Number($('#trigger-pan').value)/100,end=start+span;
 const x=time=>left+(time-start)/span*(right-left),axis=height=>Array.from({length:5},(_,i)=>{const pos=left+i*(right-left)/4,t=start+i*span/4;return `<line x1="${pos}" y1="12" x2="${pos}" y2="${height-22}" stroke="var(--line)"/>`+text(pos,height-5,((t-first)/1000).toFixed(1),undefined,i===0?'start':i===4?'end':'middle');}).join('')+text(right,11,'ms',undefined,'end');
 let digital=axis(190);
 for(const [channel,y,color] of [['crank',42,'var(--green)'],['cam',112,'var(--amber)']]){
  digital+=text(2,y+10,channel.toUpperCase(),color);const values=rows.filter(r=>r.channel===channel),visible=values.filter(r=>r.captured_us>=start&&r.captured_us<=end);
  if(!values.length){digital+=text(left,y+12,triggerFrame?.includes_cam===false&&channel==='cam'?'Not simulated':'No recorded edges');continue;}
  if(!triggerFrame.includes_falling_edges){for(const row of visible)digital+=`<line x1="${x(row.captured_us)}" y1="${y}" x2="${x(row.captured_us)}" y2="${y+28}" stroke="${color}"><title>Rising ${channel}, sequence ${row.sequence}</title></line>`;continue;}
  let level=null,cursor=start,path='';for(const row of values)if(row.captured_us<start)level=row.high;
  for(const row of visible){const position=x(row.captured_us),next=y+(row.high?0:28);if(level!==null)path+=`M ${x(cursor)} ${y+(level?0:28)} H ${position} V ${next} `;else path+=`M ${position} ${y+(row.high?28:0)} V ${next} `;cursor=row.captured_us;level=row.high;}
  if(level!==null)path+=`M ${x(cursor)} ${y+(level?0:28)} H ${right}`;
  digital+=`<path d="${path}" fill="none" stroke="${color}" stroke-width="1.5"/>`;
 }
 scope.innerHTML=digital;
 const visible=periods.filter(p=>p.time>=start&&p.time<=end),max=Math.max(1,...visible.map(p=>p.period));
 let bars=axis(180);for(const fraction of [0,.5,1])bars+=text(0,145-fraction*120,(max*fraction/1000).toFixed(1)+'ms');
 for(const item of visible){const height=Math.max(2,item.period/max*120),pos=x(item.time),color=!item.period?'var(--red)':median>0&&item.period>median*1.5?'var(--amber)':'var(--green)';bars+=`<line x1="${pos}" x2="${pos}" y1="145" y2="${145-height}" stroke="${color}" stroke-width="2"><title>Sequence ${item.sequence}: ${item.period} µs between rising crank edges</title></line>`;}
 plot.innerHTML=bars;
 $('#trigger-window').textContent=`View ${((start-first)/1000).toFixed(2)} to ${((end-first)/1000).toFixed(2)} ms from first captured edge. ${triggerFrame.includes_falling_edges?'Digital levels start at the first known edge.':'Rising-edge marks only; signal levels are unknown.'}`;
 const reordered=triggerFrame.records.filter((r,i,a)=>i&&r.captured_us<a[i-1].captured_us).length;
 $('#trigger-summary').textContent=`${periods.length} rising crank intervals; median ${median.toFixed(0)} µs; longest ${Math.max(0,...periods.map(p=>p.period)).toFixed(0)} µs; ${periods.filter(p=>!p.period).length} zero intervals. ${reordered} timestamp reversals in callback order. No 720° cam-phase claim.`;
}
function renderTriggerRows(){
 const frame=triggerFrame;if(!frame)return;
 const first=frame.records[0]?.captured_us||0;
 $('#trigger-rows').innerHTML='<table><thead><tr><th>Seq</th><th>Time ms</th><th>Input</th><th>Edge</th><th>Callback µs</th><th>Counter</th><th>Epoch</th></tr></thead><tbody>'+frame.records.map(row=>`<tr><td>${row.sequence}</td><td>${((row.captured_us-first)/1000).toFixed(3)}</td><td>${row.channel}</td><td>${row.high?'rise':'fall'}</td><td>${frame.simulator?'synthetic':row.callback_us-row.captured_us}</td><td>${row.raw_counter??'--'}</td><td>${row.configuration_epoch}</td></tr>`).join('')+'</tbody></table>';
}
function triggerToMsl(frame){
 if(!frame||frame.state==='armed'||!frame.count||frame.records.length!==frame.count)throw Error('Load a complete frozen capture before exporting.');
 const {rows}=triggerSeries(frame),first=rows[0].captured_us;let crank=null,cam=null,previous=null;
 const metadata=(frame.simulator?'COMPLETED SYNTHETIC SIL, RISING CRANK ONLY':'MCU REPORTED DIGITAL CAPTURE, HARDWARE TIMING UNQUALIFIED')+' / '+frame.data_source+' / rows sorted by captured time; Sequence retains callback order';
 const lines=['"ESP32ECU TRIGGER 001"','"'+metadata.replaceAll('"','""')+'"','Time\tCrankEdge\tCamEdge\tCrankLevel\tCamLevel\tToothTime\tCallbackDelay\tRawCounter\tEpoch\tSequence','s\tflag\tflag\tflag\tflag\tus\tus\tticks\t\t'];
 for(const row of rows){let period=null;if(row.channel==='crank'){if(frame.includes_falling_edges)crank=Number(row.high);if(row.high){if(previous!==null)period=row.captured_us-previous;previous=row.captured_us;}}else if(frame.includes_falling_edges)cam=Number(row.high);
  const values=[((row.captured_us-first)/1e6).toFixed(6),row.channel==='crank'?(row.high?1:-1):0,row.channel==='cam'?(row.high?1:-1):0,crank,cam,period,frame.simulator?null:row.callback_us-row.captured_us,row.raw_counter,row.configuration_epoch,row.sequence];lines.push(values.map(v=>v===null?'NaN':v).join('\t'));
 }
 return lines.join('\n')+'\n';
}
window.addEventListener('resize',()=>{if(document.querySelector('#trigger-scope'))drawTriggerCharts()});
)ECU_ASSET";
inline constexpr char engine_log_js[]=R"ECU_ASSET(/* A bounded browser collector. Identity/cursor validation precedes every commit. */
'use strict';
window.EcuEngineLogger=(()=>{
 const MAX_ROWS=45000,INPUTS=['rpm','map_kpa','tps_pct','clt_c','iat_c','lambda','battery_v','sensor_v'];
 const PROPOSALS=['rpm','ve_pct','target_lambda','advance_deg','pulse_ms','dwell_ms','deadtime_ms','air_mg','warmup','afterstart','accel','ego','duty_pct','idle_pct'];
 const INPUT_LABELS=['RPM','MAP','TPS','CLT','IAT','Lambda','Battery','Sensor5V'];
 const PROPOSAL_LABELS=['ProposedRPM','VE','LambdaTarget','ProposedAdvance','ProposedPW','ProposedDwell','DeadTime','AirMass','Warmup','Afterstart','Accel','EGO','Duty','IdleProposal'];
 const IDLE_LABELS=['IdleTarget','IdleDuty','IdleFeedforward','IdleP','IdleI','IdleD','IdleFlags','IdleState','IdleReason','IdleAlgorithm','IdlePidUpdates','IdleAvailable'],IDLE_VALUES=['target_rpm','duty_pct','feedforward_pct','p_term','i_term','d_term'];
 const AE_VALUES=['tps_dot_pct_s','map_dot_kpa_s','window_ms','trigger_dot','correction_pct','unclamped_pct','remaining_ms','added_fuel_mg'];
 const AE_LABELS=['AeTpsDot','AeMapDot','AeWindowMs','AeTriggerDot','AeCorrectionPct','AeUnclampedPct','AeRemainingAtSampleMs','AeAddedFuelMg','AeFlags','AeMode','AeApply','AePhase','AeReason','AeAvailable'];
 const AE_UNITS=['%/s','kPa/s','ms','source_units/s','%','%','ms','mg','bitfield','code','code','code','code','bool'];
 const LOAD_VALUES=['fuel_load','spark_load','lambda_load','trim_load','pressure_factor','baro_kpa','emap_kpa','aux_kpa','afr_factor'];
 const LOAD_CODES=['flags','fuel_source_code','spark_source_code','lambda_source_code','trim_source_code','pressure_code','aux_role_code','baro_source_code','afr_code','reason_code','afr_state_code'];
 const LOAD_LABELS=['LoadFuel','LoadSpark','LoadLambda','LoadTrim','LoadPressureFactor','LoadBaro','LoadEmap','LoadAux','LoadAfrFactor','LoadFlags','LoadFuelSource','LoadSparkSource','LoadLambdaSource','LoadTrimSource','LoadPressure','LoadAuxRole','LoadBaroSource','LoadAfr','LoadReason','LoadAfrState','LoadAvailable'];
 const LOAD_UNITS=['source_units','source_units','source_units','source_units','ratio','kPa','kPa','kPa','ratio','bitfield',...Array(10).fill('code'),'bool'];
 const SEC_VALUES=window.EcuSecondaryTables.values,SEC_LABELS=window.EcuSecondaryTables.valueLabels,SEC_BOOLS=window.EcuSecondaryTables.boolFields;
 const SEC_CODES=['mode_code','cells_code','source_code','reason_code','input_source_code','condition_code','axis_code','input_channel'],SEC_CODE_LABELS=['Mode','Cells','Source','Reason','InputSource','Condition','Axis','InputChannel'];
 const SEC_HEADERS=['fuel','spark'].flatMap(kind=>{const prefix='Sec'+kind[0].toUpperCase()+kind.slice(1);return [...SEC_LABELS.map(k=>prefix+k),prefix+'Flags',...SEC_CODE_LABELS.map(k=>prefix+k),prefix+'ObservedUs',...SEC_BOOLS.map(k=>prefix+k.split('_').map(x=>x[0].toUpperCase()+x.slice(1)).join(''))];});
 const SEC_UNITS=['fuel','spark'].flatMap(kind=>{const unit=kind==='fuel'?'%':'deg';return [unit,unit,'cell_units',unit,'source_units','condition_units','ms','condition_units','ms','bitfield',...Array(8).fill('code'),'us',...Array(12).fill('bool')];});
 function secondaryValues(s){return ['fuel','spark'].flatMap(kind=>{let d=s.secondary_tables?.[kind];if(!d?.available)d={flags:1024,active_high:true};return [...SEC_VALUES.map(k=>number(d.available&&Number.isFinite(d[k])?Math.fround(d[k]):null)),d.flags??1024,...SEC_CODES.map(k=>d[k]??0),d.mode_code===4&&d.input_source_code?d.input_observed_us??'NaN':'NaN',...SEC_BOOLS.map(k=>d[k]?1:0)];});}
 const PREFIX=['Time','RowSequence','SnapshotSequence','ControlAge','SensorAge','Source','TuneRevision','SensorRevision','PhaseEpoch','Flags','Faults','State','Strategy','PhaseReason','PhaseLosses','CamRejected','CamError','WorkerCommand','WorkerAge','WorkerEpoch','WorkerTuneRevision','WorkerSensorRevision','TimingFault','LastTimingFault','VirtualMask','PhysicalCommandMask','BoardFlags','InputValidMask'];
 const UNITS=['s','count','count','ms','ms','code','count','count','count','bitfield','bitfield','code','code','code','count','count','deg','count','ms','count','count','count','code','code','bitfield','bitfield','bitfield','bitfield',
  'RPM','kPa','%','C','C','lambda','V','V','RPM','%','lambda','deg','ms','ms','ms','mg','ratio','ratio','ratio','ratio','%','%',...Array(8).fill('count')];
 let root,options,meta,identity,rows=[],gaps=[],cursor=0,error='',collecting=false,timer,polling=false,sampleTimer,generation=0,mount=0;
 const text=(node,value)=>{if(node)node.textContent=String(value??'--');};
 const el=id=>root?.isConnected?root.querySelector('#engine-data-'+id):null;
 const uint=n=>Number.isSafeInteger(n)&&n>=0&&n<=4294967295;
 const u64=s=>typeof s==='string'&&/^(0|[1-9][0-9]{0,19})$/.test(s)&&BigInt(s)<=18446744073709551615n;
 function checkHeader(h){
  if(!h||h.schema_version!==1||!/^[0-9a-f]{32}$/.test(h.boot_id)||!uint(h.log_id)||!uint(h.total)||!uint(h.first_sequence)||!uint(h.next_after??0)||![128,256].includes(h.capacity)||!['idle','recording','timeout','stopped','clock_reversed','counter_limit'].includes(h.state)||!u64(h.started_us)||!u64(h.ended_us)||(h.log_id&&!([1,2].includes(h.source_code))))throw Error('Invalid engine log metadata.');
 }
 function adopt(h){checkHeader(h);++generation;meta=h;identity={boot_id:h.boot_id,log_id:h.log_id};rows=[];gaps=[];cursor=0;error='';}
 function acceptPage(p){
  checkHeader(p);
  if(!identity||p.boot_id!==identity.boot_id||p.log_id!==identity.log_id||p.snapshot_superseded||p.future_cursor||p.invalid_row||['started_us','period_ms','duration_s','source_code'].some(k=>p[k]!==meta[k]))throw Error('Log identity changed. Collected rows are preserved.');
  if(!Array.isArray(p.records)||p.records.length>16||!uint(p.gap_first)||!uint(p.gap_last))throw Error('Invalid log page.');
  let expected=cursor+1;const staged=[];
  if(p.gap_first||p.gap_last){
   if(p.gap_first!==expected||p.gap_last<p.gap_first||p.gap_last>=p.first_sequence||!p.records.length)throw Error('Invalid lost-row range.');
   expected=p.gap_last+1;
  }
  for(const r of p.records){
   const s=r?.sample;
   if(r.log_id!==identity.log_id||!uint(r.row_sequence)||r.row_sequence!==expected++||!u64(r.recorded_us)||!s||s.schema_version!==1||!s.available||!u64(s.sequence)||!u64(s.control_us)||!u64(s.sampled_us)||s.source_code!==p.source_code||!s.inputs||!s.proposals||!Array.isArray(s.raw_adc)||s.raw_adc.length!==8||!s.worker_observation||!u64(s.worker_observation.command_sequence))throw Error('Invalid or mixed engine row. Cursor unchanged.');
   const previous=staged.at(-1)||rows.at(-1);
   if(s.cylinders&&(!uint(s.cylinders.valid_mask)||s.cylinders.valid_mask>15||!Array.isArray(s.cylinders.proposals)||s.cylinders.proposals.length!==4))throw Error('Invalid cylinder observation.');
   if(s.idle&&(typeof s.idle.available!=='boolean'||!u64(s.idle.pid_updates)||!uint(s.idle.flags)||!uint(s.idle.state_code)||s.idle.state_code>10||!uint(s.idle.reason_code)||s.idle.reason_code>12||!uint(s.idle.algorithm_code)||s.idle.algorithm_code>2||IDLE_VALUES.some(k=>s.idle.available?!Number.isFinite(s.idle[k]):s.idle[k]!==null)))throw Error('Invalid idle observation.');
   if(s.secondary_tables!==undefined){if(!s.secondary_tables||Object.keys(s.secondary_tables).sort().join('|')!=='fuel|spark')throw Error('Invalid secondary observations.');for(const kind of ['fuel','spark'])window.EcuSecondaryTables.checkObservation(s.secondary_tables[kind],kind,s.available);}
   if(s.flex_fuel!==undefined)window.EcuFlexFuel.checkObservation(s.flex_fuel,s.available);
   if(s.load_model!==undefined)window.EcuLoadModel.checkObservation(s.load_model,s.available);
   const ae=s.transient_enrichment;
   if(ae!==undefined){
    if(!ae||typeof ae!=='object'||Array.isArray(ae))throw Error('Invalid transient observation.');
    if(typeof ae.available!=='boolean'||!uint(ae.flags)||ae.flags>31||!uint(ae.mode_code)||ae.mode_code>3||!uint(ae.apply_code)||ae.apply_code>1||!uint(ae.phase_code)||ae.phase_code>2||!uint(ae.reason_code)||ae.reason_code>11||AE_VALUES.some(k=>ae.available?ae[k]!==null&&!Number.isFinite(ae[k]):ae[k]!==null))throw Error('Invalid transient observation.');
    if(ae.available&&(Boolean(ae.flags&2)!==Boolean(ae.phase_code)||!Number.isFinite(ae.correction_pct)||ae.correction_pct<0||!Number.isFinite(ae.remaining_ms)||ae.remaining_ms<0||ae.remaining_ms>2000||!Number.isFinite(ae.added_fuel_mg)||ae.added_fuel_mg<0||((ae.flags&1)&&(!Number.isFinite(ae[ae.mode_code===3?'map_dot_kpa_s':'tps_dot_pct_s'])||!Number.isFinite(ae.window_ms)||ae.window_ms<=0))))throw Error('Invalid transient rate/phase.');
   }
   if(BigInt(s.sequence)===0n||BigInt(r.recorded_us)<BigInt(p.started_us)||BigInt(s.control_us)>BigInt(r.recorded_us)||BigInt(s.sampled_us)>BigInt(r.recorded_us)||
    (previous&&(BigInt(s.sequence)<=BigInt(previous.sample.sequence)||BigInt(r.recorded_us)<BigInt(previous.recorded_us))))throw Error('Invalid source sequence or observation clock. Cursor unchanged.');
   staged.push(r);
  }
  const next=staged.length?staged.at(-1).row_sequence:cursor;
  if(p.next_after!==next||next>p.total||rows.length+staged.length>MAX_ROWS)throw Error('Invalid cursor or browser row limit reached. Export collected rows.');
  if(p.gap_first)gaps.push([p.gap_first,p.gap_last]);
  rows.push(...staged);cursor=next;meta=p;return staged.length;
 }
 function headers(){return {'X-ECU-Log-Boot':identity.boot_id};}
 function paint(){
  const h=meta;const missing=gaps.reduce((sum,[a,b])=>sum+b-a+1,0);
  text(el('summary'),h?`${h.state} / ${h.data_source} / ${rows.length} browser rows / ${h.retained} retained on device / ${h.total} recorded`:'Loading recorder metadata...');
  text(el('gaps'),h?`${missing} rows missed by this browser; ${h.overwritten} overwritten on device; ${h.missed_periods} sampling periods missed; ${h.repeated_skipped} repeated snapshots skipped; ${h.invalid_skipped} invalid observations skipped. Producer lock contentions: ${h.producer_lock_contention_attempts??0}.`:'');
  text(el('error'),error);text(el('identity'),identity?`Boot ${identity.boot_id} / log ${identity.log_id} / collected through row ${cursor}`:'No log selected');
  if(el('stop'))el('stop').disabled=!h||h.state!=='recording';
  if(el('start'))el('start').disabled=!h||h.state==='recording'||h.export_busy||polling;
  if(el('msl'))el('msl').disabled=!rows.length;
  if(el('json'))el('json').disabled=!rows.length;
  if(el('retained'))el('retained').disabled=!h||h.state==='recording'||!h.retained;
 }
 async function collect(){
  if(polling||!collecting||!identity?.log_id)return;
  polling=true;clearTimeout(timer);const selected=generation;
  try{
   for(let i=0;i<8;++i){
    const page=await options.api(`/api/engine/data-log?log_id=${identity.log_id}&after=${cursor}`,{headers:headers()});
    if(selected!==generation)return;
    const count=acceptPage(page);error='';
    if(cursor>=page.total){if(page.state!=='recording')collecting=false;break;}
    if(!count)throw Error('Log page made no progress. Collected rows are preserved.');
   }
  }catch(e){if(selected===generation){error=e.message;if(/identity|changed|boot|limit|Invalid/.test(error))collecting=false;}}
  finally{polling=false;paint();if(collecting)timer=setTimeout(collect,error?1000:250);}
 }
 async function metadata(follow=false){
  const h=await options.api('/api/engine/data-log');checkHeader(h);
  if(!identity||follow){adopt(h);collecting=!!h.log_id;}
  else if(h.boot_id!==identity.boot_id||h.log_id!==identity.log_id){error='Device log changed. Export the collected rows before choosing Follow current log.';collecting=false;}
  else meta=h;
  paint();if(collecting)collect();
 }
 function file(name,contents,type){options.file(name,contents,type);}
 const number=value=>typeof value==='number'&&Number.isFinite(value)?String(Number(value.toPrecision(9))):'NaN';
 function exportMsl(){
  if(!meta||!rows.length)throw Error('No collected engine rows.');
  const lines=['"ESP32ECU ENGINE LOG 007"',`"BROWSER COLLECTED ${meta.source_code===1?'TARGET OBSERVATIONS':'SYNTHETIC REPLAY'} / boot ${identity.boot_id} / log ${identity.log_id} / period_ms=${meta.period_ms} duration_s=${meta.duration_s} / overwritten=${meta.overwritten} missed_periods=${meta.missed_periods} repeated=${meta.repeated_skipped} invalid=${meta.invalid_skipped} / missing row ranges ${gaps.map(x=>x.join('..')).join(',')||'none'} / PhaseEpoch=configuration context; WorkerEpoch=executor generation / proposals and software command masks; no electrical execution measurement"`,
   [...PREFIX,...INPUT_LABELS,...PROPOSAL_LABELS,...Array.from({length:8},(_,i)=>'ADC'+i),'CylinderValidMask','CylinderTrimsEnabled','CylinderCapacityMask','CylinderSparkClampMask','CylinderRetardFloorMask',...Array.from({length:4},(_,i)=>['PW','Advance','FuelTrim','Duty'].map(k=>'C'+(i+1)+k)).flat(),...IDLE_LABELS,...AE_LABELS,...LOAD_LABELS,...SEC_HEADERS,...window.EcuFlexFuel.logFields.map(x=>x[0])].join('\t'),[...UNITS,'bitfield','bool','bitfield','bitfield','bitfield',...Array(4).fill(['ms','deg','%','%']).flat(),'RPM','%','%','%','%','%','bitfield','code','code','code','count','bool',...AE_UNITS,...LOAD_UNITS,...SEC_UNITS,...window.EcuFlexFuel.logFields.map(x=>x[1])].join('\t')];
  for(const r of rows){
   const s=r.sample,w=s.worker_observation,c=s.cylinders,ae=s.transient_enrichment,model=s.load_model;const extra=[c?.valid_mask||0,c?.enabled?1:0,c?.capacity_mask||0,c?.spark_clamp_mask||0,c?.retard_floor_mask||0,...Array.from({length:4},(_,i)=>['pulse_ms','advance_deg','fuel_pct','duty_pct'].map(k=>number(c?.valid_mask&(1<<i)?c.proposals[i][k]:null))).flat()];const elapsed=Number(BigInt(r.recorded_us)-BigInt(meta.started_us))/1e6;
   lines.push([elapsed.toFixed(6),r.row_sequence,s.sequence,number(s.control_age_ms),number(s.sample_age_ms),s.source_code,s.tune_revision,s.sensor_revision,s.phase_epoch,s.flags,s.controller_faults,s.state_code,s.strategy_code,s.phase_reason_code,s.phase_losses,s.cam_rejected,number(s.cam_error_deg),w.command_sequence,number(w.age_ms),w.epoch,w.tune_revision,w.sensor_revision,w.timing_fault_code,w.last_timing_fault_code,w.virtual_high_mask,w.physical_command_mask,s.board_flags,s.input_valid_mask,
    ...INPUTS.map(k=>number(s.inputs[k])),...PROPOSALS.map(k=>number(s.proposals[k])),...s.raw_adc.map(number),...extra,...IDLE_VALUES.map(k=>number(s.idle?.available?s.idle[k]:null)),s.idle?.flags??0,s.idle?.state_code??0,s.idle?.reason_code??0,s.idle?.algorithm_code??0,s.idle?.pid_updates??'0',s.idle?.available?1:0,...AE_VALUES.map(k=>number(ae?.available?ae[k]:null)),ae?.flags??0,ae?.mode_code??0,ae?.apply_code??0,ae?.phase_code??0,ae?.reason_code??3,ae?.available?1:0,...LOAD_VALUES.map(k=>number(model?.available&&Number.isFinite(model[k])?Math.fround(model[k]):null)),...LOAD_CODES.map((k,i)=>model?.[k]??([5,8].includes(i)?1:i===10?255:0)),model?.available?1:0,...secondaryValues(s),...window.EcuFlexFuel.logValues(s)].join('\t'));
  }
  return lines.join('\n')+'\n';
 }
 async function command(action){
  if(polling)return;
  try{
   if(action==='start'){
    const h=await options.api('/api/engine/data-log');checkHeader(h);
    const next=await options.api('/api/engine/data-log',{method:'POST',headers:{'X-ECU-Log-Boot':h.boot_id},body:JSON.stringify({action:'start',period_ms:Number(el('period').value),duration_s:Number(el('duration').value)})});
    adopt(next);collecting=true;
   }else{
    const h=await options.api('/api/engine/data-log',{method:'POST',headers:headers(),body:JSON.stringify({action:'stop',log_id:identity.log_id})});
    checkHeader(h);if(h.boot_id!==identity.boot_id||h.log_id!==identity.log_id)throw Error('Device log changed. Collected rows are preserved.');meta=h;collecting=true;
   }
   error='';paint();await collect();
  }catch(e){error=e.message;paint();options.toast(e.message,true);}
 }
 async function sample(selected=mount){
  if(!root?.isConnected||selected!==mount)return;
  try{
   const s=await options.api('/api/engine/sample');if(!root?.isConnected||selected!==mount)return;
   text(el('sample'),s.available?`${s.data_source}${s.historical?' / completed historical replay':''} / snapshot ${s.sequence} / control age ${s.control_age_ms??'unknown'} ms / sensor age ${s.sample_age_ms??'unknown'} ms / ${s.display_fresh?'fresh display observation':'stale or historical observation'}`:'No completed control sample yet.');
   const w=s.worker_observation;
   text(el('values'),s.available?`Input RPM ${s.inputs.rpm??'invalid'} / MAP ${s.inputs.map_kpa??'invalid'} kPa / TPS ${s.inputs.tps_pct??'invalid'} % / lambda ${s.inputs.lambda??'invalid'}. Proposed fuel ${number(s.proposals.pulse_ms)} ms / spark ${number(s.proposals.advance_deg)} °BTDC / dwell ${number(s.proposals.dwell_ms)} ms. Tune ${s.tune_revision}, sensors ${s.sensor_revision}. Worker observed command ${w.command_sequence}, age ${w.age_ms??'unknown'} ms, command mask ${w.physical_command_mask}.`:'Inputs and proposals are unavailable.');
  }catch(e){if(selected===mount){text(el('sample'),'Control sample unavailable: '+e.message);text(el('values'),'Previously displayed values are unavailable.');}}
  finally{if(root?.isConnected&&selected===mount)sampleTimer=setTimeout(()=>sample(selected),500);}
 }
 async function attach(node,config){
  clearTimeout(sampleTimer);++mount;root=node;options=config;
  root.innerHTML=`<section class="panel" style="margin-top:20px"><div class="panelhead"><h2>Control sample & engine log</h2><span class="tag">OBSERVATIONS / OUTPUTS INHIBITED</span></div><div class="panelbody"><p class="fine" id="engine-data-sample">Loading coherent control sample...</p><p class="fine" id="engine-data-values"></p><p class="hint">Inputs and proposals belong to one completed control step. The worker command was observed earlier. Submission and software masks do not establish electrical execution.</p><div class="divider"></div><div class="formgrid"><div class="field"><label for="engine-data-period">Log period</label><select id="engine-data-period">${[20,50,100,200,500,1000].map(ms=>`<option value="${ms}" ${ms===100?'selected':''}>${ms} ms</option>`).join('')}</select></div><div class="field"><label for="engine-data-duration">Log duration (seconds)</label><input id="engine-data-duration" type="number" min="1" max="900" step="1" value="12"></div></div><div class="actions" style="margin-top:12px"><button id="engine-data-start">${config.simulator?'Replay completed SIL log':'Start target log'}</button><button id="engine-data-stop" disabled>Stop log</button><button id="engine-data-follow">Follow current log</button><button id="engine-data-msl" disabled>Export collected MSL</button><button id="engine-data-json" disabled>Export collected JSON</button><button id="engine-data-retained" disabled>Export retained window</button></div><p class="hint">${config.simulator?'The host replays the end of a completed SIL run through the same native recorder, without waiting in real time.':'The device records to RAM. This tab collects rows while it stays open.'} The current device retains 128 rows (12.8 s at 100 ms, 2.56 s at 20 ms). Browser collection is limited to 45,000 rows. Pausing, closing or throttling this tab can lose older rows. A new log replaces this browser collection. Export before starting or following another log. Logs are lost on device reboot.</p><p class="fine" id="engine-data-summary" role="status"></p><p class="fine" id="engine-data-gaps"></p><p class="fine mono" style="overflow-wrap:anywhere" id="engine-data-identity"></p><p class="warn" role="alert" id="engine-data-error"></p></div></section>`;
  el('start').onclick=()=>command('start');el('stop').onclick=()=>command('stop');
  el('follow').onclick=()=>metadata(true).catch(e=>{error=e.message;paint();});
  el('msl').onclick=()=>file('ecu-collected-engine.msl',exportMsl(),'text/plain');
  el('json').onclick=()=>file('ecu-collected-engine.json',JSON.stringify({schema_version:1,identity,metadata:meta,gaps,scope:'Browser collected observations only; missing row ranges are not filled',records:rows},null,2),'application/json');
  el('retained').onclick=async()=>{try{
   const r=await fetch(`/api/engine/data-log.msl?log_id=${identity.log_id}&after=0`,{headers:{...headers(),'X-ECU-Token':options.token},signal:AbortSignal.timeout(15000)});
   if(!r.ok){const j=await r.json();throw Error(j.error||'Retained export failed.');}
   file('ecu-retained-engine.msl',await r.text(),'text/plain');
  }catch(e){error=e.message;paint();}};
  sample();try{await metadata();}catch(e){error=e.message;paint();}
 }
 function detach(){clearTimeout(sampleTimer);++mount;root=null;}
 return {attach,detach,acceptPage,exportMsl,adopt,inspect:()=>({identity,cursor,rows:rows.length,gaps:[...gaps],collecting,error}),MAX_ROWS};
})();
)ECU_ASSET";
inline constexpr char cylinder_js[]=R"ECU_ASSET('use strict';
window.EcuCylinderTuning=(()=>{
 const defaults=()=>({enabled:false,spark_deg:[0,0,0,0],fuel_maps:Array.from({length:4},()=>({rpm:[80,800,1600,3000,5000,8000],load:[10,30,50,70,90,110],cells:Array(36).fill(100)}))});
 function constants(t){
  const out=[{page:4,name:'cylinderTrimsEnabled',value:t.cylinder_trims.enabled,flag:true,trimFlag:true}];
  for(let i=0;i<4;i++){
   out.push({page:4,name:`c${i+1}SparkTrim`,value:t.cylinder_trims.spark_deg[i],trimSpark:i,unit:'deg'});
   for(const [suffix,field]of [['Rpm','rpm'],['Load','load'],['Table','cells']])out.push({page:4,name:`c${i+1}Fuel${suffix}`,value:t.cylinder_trims.fuel_maps[i][field],trimCylinder:i,field,bins:6,unit:field==='rpm'?'RPM':field==='load'?'source_units':'%'});
  }
  return out;
 }
 function apply(t,item,value){
  if(item.trimFlag)t.cylinder_trims.enabled=value;
  else if(item.trimSpark!==undefined)t.cylinder_trims.spark_deg[item.trimSpark]=value;
  else t.cylinder_trims.fuel_maps[item.trimCylinder][item.field]=value;
 }
 function attach(root,t,changed,toast){
  const trims=t.cylinder_trims;let selected=0;
  root.innerHTML=`<section class="panel" style="margin-top:20px"><div class="panelhead"><h2>Physical cylinder adjustments</h2><span class="tag">SEQUENTIAL / OUTPUTS INHIBITED</span></div><div class="panelbody"><label class="check"><input id="cylinder-trims-enabled" type="checkbox" ${trims.enabled?'checked':''}><span>Apply individual fuel and spark trims (sequential mode only)</span></label><p class="hint">Index by physical cylinders 1–4, independently of firing order. INJ1/IGN1 belong to cylinder 1, through INJ4/IGN4 for cylinder 4. J9 pins 1–4 are injector channels 1–4; J10 pins 1–4 are the smart-coil logic channels. Verify the harness and compression TDC independently. Outputs stay inhibited.</p><div class="formgrid">${trims.spark_deg.map((v,i)=>`<div class="field"><label for="cylinder-spark-${i+1}">Cylinder ${i+1} spark offset (°BTDC)</label><input id="cylinder-spark-${i+1}" type="number" min="-10" max="10" step="any" value="${v}"></div>`).join('')}</div><p class="hint">Positive offsets advance spark. Trimmed nominal timing is bounded to −5..40° (−5..15° while cranking), then mandatory soft-limit retard is applied. Clamp masks in diagnostics identify constrained cylinders.</p><div class="field"><label for="cylinder-fuel-map">6×6 fuel trim map</label><select id="cylinder-fuel-map">${[1,2,3,4].map(i=>`<option value="${i-1}">Cylinder ${i} / injector ${i}</option>`).join('')}</select></div><div id="cylinder-fuel-grid" style="margin-top:12px"></div><p class="hint">100% is neutral; 50–150% is allowed. Trims scale effective fuel before adding unchanged injector deadtime once. Disabled trims ignore saved nonneutral values. Each cylinder is checked against pulse and duty limits; one overflow inhibits all channels. An idle/single exhaust wideband cannot identify an individual cylinder imbalance.</p><div id="cylinder-live" class="fine">Waiting for per-cylinder proposals.</div></div></section>`;
  root.querySelector('#cylinder-trims-enabled').onchange=e=>{
   if(e.target.checked&&t.strategy!=='sequential_4cyl'){e.target.checked=false;toast('Select sequential mode before enabling cylinder trims.',true);return;}
   trims.enabled=e.target.checked;changed();
  };
  trims.spark_deg.forEach((_,i)=>root.querySelector(`#cylinder-spark-${i+1}`).onchange=e=>{trims.spark_deg[i]=Number(e.target.value);changed();});
  const draw=()=>{
   const m=trims.fuel_maps[selected],basis=window.EcuLoadModel.basis(t,'trim'),grid=root.querySelector('#cylinder-fuel-grid');
   grid.innerHTML=`<div class="tablewrap"><table><thead><tr><th>${basis.unit} / RPM</th>${m.rpm.map((v,x)=>`<th><input aria-label="Cylinder ${selected+1} RPM axis ${x+1}" data-trim-axis="rpm" data-index="${x}" type="number" value="${v}" style="width:70px"></th>`).join('')}</tr></thead><tbody>${m.load.map((v,y)=>`<tr><th><input aria-label="Cylinder ${selected+1} load axis ${y+1} ${basis.unit}" data-trim-axis="load" data-index="${y}" min="${basis.min}" max="${basis.max}" type="number" step="any" value="${v}" style="width:70px"></th>${m.rpm.map((_,x)=>`<td><input aria-label="Cylinder ${selected+1} fuel trim row ${y+1} column ${x+1}" data-trim-cell="${y*6+x}" type="number" min="50" max="150" step="any" value="${m.cells[y*6+x]}" style="width:70px"></td>`).join('')}</tr>`).join('')}</tbody></table></div>`;
   grid.querySelectorAll('[data-trim-axis],[data-trim-cell]').forEach(input=>input.onchange=()=>{if(input.dataset.trimAxis)m[input.dataset.trimAxis][Number(input.dataset.index)]=Number(input.value);else m.cells[Number(input.dataset.trimCell)]=Number(input.value);changed();});
  };
  root.querySelector('#cylinder-fuel-map').onchange=e=>{selected=Number(e.target.value);draw();};draw();
 }
 function status(root,c){
  const pane=root.querySelector('#cylinder-live');if(!pane)return;
  if(!c?.available){pane.textContent='Per-cylinder proposals unavailable until qualified inputs and phase permit a completed calculation.';return;}
  const n=v=>Number.isFinite(v)?v.toFixed(3):'unknown';
  pane.innerHTML=`<p>Trims ${c.enabled?'active':'disabled / neutral'} · capacity mask ${c.capacity_mask} · nominal clamp mask ${c.spark_clamp_mask} · retard floor mask ${c.retard_floor_mask}</p><div class="tablewrap"><table><thead><tr><th>CYL</th><th>FUEL %</th><th>PW ms</th><th>ADV °BTDC</th><th>DUTY %</th></tr></thead><tbody>${c.proposals.map((p,i)=>`<tr><td>${i+1}</td><td>${n(p.fuel_pct)}</td><td>${n(p.pulse_ms)}</td><td>${n(p.advance_deg)}</td><td>${n(p.duty_pct)}</td></tr>`).join('')}</tbody></table></div><p class="hint">Completed controller proposals, not electrical execution. Scalar engine fields and ESP-NOW schema1 retain untrimmed base demand.</p>`;
 }
 return {defaults,constants,apply,attach,status};
})();
)ECU_ASSET";
inline constexpr char idle_js[]=R"ECU_ASSET(// Generated by scripts/generate_idle_ui.py
window.EcuIdleMetadata={"defaults":{"algorithm":"closed_loop","frequency_hz":100,"control_period_ms":100,"min_pct":0,"max_pct":100,"tps_closed_pct":2,"tps_hysteresis_pct":0.5,"entry_rpm_above":300,"exit_rpm_above":500,"entry_delay_s":0.25,"afterstart_taper_s":2,"dashpot_pct":8,"dashpot_decay_pct_s":10,"slew_pct_s":200,"integral_limit_pct":40,"kd":0,"derivative_filter_s":0.1,"fast_idle_temp_c":50,"fast_idle_hysteresis_c":5,"coolant_c":[-40,0,20,40,70,110],"run_pct":[65,50,38,30,20,20],"crank_pct":[75,65,55,45,35,35],"target_add_rpm":[400,300,200,100,0,0]},"algorithms":["on_off","open_loop","closed_loop"],"scalars":["frequency_hz","control_period_ms","min_pct","max_pct","tps_closed_pct","tps_hysteresis_pct","entry_rpm_above","exit_rpm_above","entry_delay_s","afterstart_taper_s","dashpot_pct","dashpot_decay_pct_s","slew_pct_s","integral_limit_pct","kd","derivative_filter_s","fast_idle_temp_c","fast_idle_hysteresis_c"],"arrays":[["coolant_c",6],["run_pct",6],["crank_pct",6],["target_add_rpm",6]],"units":{"frequency_hz":"Hz","control_period_ms":"ms","min_pct":"%","max_pct":"%","tps_closed_pct":"%","tps_hysteresis_pct":"%","entry_rpm_above":"RPM","exit_rpm_above":"RPM","entry_delay_s":"s","afterstart_taper_s":"s","dashpot_pct":"%","dashpot_decay_pct_s":"%/s","slew_pct_s":"%/s","integral_limit_pct":"%","kd":"%*s/RPM","derivative_filter_s":"s","fast_idle_temp_c":"C","fast_idle_hysteresis_c":"C","coolant_c":"C","run_pct":"%","crank_pct":"%","target_add_rpm":"RPM"},"limits":{"frequency_hz":[50,250],"control_period_ms":[10,250],"min_pct":[0,99],"max_pct":[1,100],"tps_closed_pct":[0,10],"tps_hysteresis_pct":[0.1,3],"entry_rpm_above":[0,1000],"exit_rpm_above":[0,1500],"entry_delay_s":[0,5],"afterstart_taper_s":[0,10],"dashpot_pct":[0,30],"dashpot_decay_pct_s":[1,100],"slew_pct_s":[1,1000],"integral_limit_pct":[0,100],"kd":[0,0.1],"derivative_filter_s":[0.01,1],"fast_idle_temp_c":[0,90],"fast_idle_hysteresis_c":[1,15],"coolant_c":[-40,140],"run_pct":[0,100],"crank_pct":[0,100],"target_add_rpm":[-500,1000]}};
/* Metadata is prefixed by scripts/generate_idle_ui.py. No direct actuator commands. */
window.EcuIdleControl=(()=>{
 const meta=window.EcuIdleMetadata,esc=s=>String(s??'--').replace(/[&<>"']/g,c=>({'&':'&amp;','<':'&lt;','>':'&gt;','"':'&quot;',"'":'&#39;'}[c]));
 const labels={frequency_hz:'PWM frequency',control_period_ms:'PID period',min_pct:'Minimum running duty',max_pct:'Maximum duty',tps_closed_pct:'Closed throttle threshold',tps_hysteresis_pct:'Throttle exit hysteresis',entry_rpm_above:'RPM above target allowed for entry',exit_rpm_above:'RPM above target causing exit',entry_delay_s:'Stable entry delay',afterstart_taper_s:'Crank-to-run taper',dashpot_pct:'Duty added after throttle closes',dashpot_decay_pct_s:'Dashpot decay',slew_pct_s:'Running duty slew limit',integral_limit_pct:'Integral magnitude limit',kd:'Derivative gain on measured RPM',derivative_filter_s:'Derivative filter time',fast_idle_temp_c:'On/off cold opening threshold',fast_idle_hysteresis_c:'On/off closing hysteresis'};
 function defaults(){return structuredClone(meta.defaults);}
 function constants(t){return Object.entries(t.idle_control).map(([key,value])=>({page:0,name:'iac_'+key,value,idleKey:key,idleAlgorithm:key==='algorithm',unit:meta.units[key]||''}));}
 function attach(root,t,changed){
  const c=t.idle_control;
  function field(key,value,group,unit='',limit){return `<div class="field"><label for="idle-${key}">${esc(labels[key]||key.replaceAll('_',' '))}${unit?' ('+esc(unit)+')':''}</label><input id="idle-${key}" data-idle-key="${key}" data-idle-group="${group}" type="${typeof value==='boolean'?'checkbox':'number'}" ${typeof value==='boolean'?(value?'checked':''):`required step="any" value="${value}" ${limit?`min="${limit[0]}" max="${limit[1]}"`:''}`}></div>`;}
  root.innerHTML=`<section class="panel" style="margin-top:20px"><div class="panelhead"><h2>Idle air control</h2><span class="tag">NORMALLY CLOSED / 2-WIRE PWM</span></div><div class="panelbody"><p class="hint">An enabled SIL run uses executed PWM edges, an independent coil/current and spring model, then manifold air flow. The selected ESP32 physical output remains inhibited. Stepper, two-coil and throttle-motor actuators are unsupported.</p><div class="formgrid">${field('idle_enabled',t.settings.idle_enabled,'settings')}${field('idle_target_rpm',t.settings.idle_target_rpm,'settings','RPM',[600,1500])}${field('idle_kp',t.settings.idle_kp,'settings','%/RPM',[0,.2])}${field('idle_ki',t.settings.idle_ki,'settings','%/(RPM·s)',[0,.2])}<div class="field"><label for="idle-algorithm">Algorithm</label><select id="idle-algorithm">${meta.algorithms.map(a=>`<option value="${a}" ${c.algorithm===a?'selected':''}>${a.replaceAll('_',' ')}</option>`).join('')}</select></div>${meta.scalars.map(k=>field(k,c[k],'idle_control',meta.units[k],meta.limits[k])).join('')}</div><p class="hint">Duty is energized time, 0 to 100%. The on/off mode uses 0 or 100% and requires maximum duty 100%. Curves must remain within the duty bounds. The target addition is relative to the base target above. Gains use percentage points, not Speeduino raw PID counts.</p><div class="tablewrap"><table><thead><tr><th>Coolant (°C)</th><th>Running feedforward (%)</th><th>Cranking duty (%)</th><th>Target addition (RPM)</th></tr></thead><tbody>${c.coolant_c.map((_,i)=>`<tr>${meta.arrays.map(([k])=>`<td><input style="width:110px" aria-label="Idle ${k} row ${i+1}" data-idle-array="${k}" data-idle-index="${i}" type="number" required step="any" value="${c[k][i]}"></td>`).join('')}</tr>`).join('')}</tbody></table></div><p class="hint">Closed loop requires fresh valid sensors, confirmed closed throttle and RPM within the entry band. Cranking and taper use the tables. Open throttle, stop, overrun cut or a fault close the command immediately; ordinary duty slew does not delay a safety cut. Fault recovery requires fresh stopped commands and quiet crank/cam inputs.</p><details><summary>Driver connection and debugging</summary><p class="hint">Routed hardware development hold: A5 J21 PH4 → IAC-DRAFT2 J1 XH4, same pin1–4 order: GPIO3, hardware RUN_5V, carrier 5V, carrier GND. Permanent R154 (2.2 kΩ) bias stays on the carrier when unplugged. Two 6N137 optical paths separate the carrier from the locally powered HCT02/UCC27524/IRLZ44NPBF driver. J2 needs a separate protected, fused, relay-switched 9–16 V branch and return; J3 VH2 connects valve positive and IAC_LS. Actual normally closed two-wire PWM coil must stay ≤2 A. The MOSFET has no current/thermal shutdown or valve feedback; a drain-source short may not blow a fuse. An independent actuator cutoff is required. Do not bridge optical domains with case metal, heatsinks or scope ground clips. Back-mounted C1–C5/C10/R13/R14 and source-star NT1 require assembly/clearance checks. Keep the draft unpowered pending the hardware acceptance list in the connector guide. Exact driver guarantees, loaded GPIO/opto timing, minimum 1 µs pulse, brownout, thermal and case fit remain open; the supervisor 10 µs assertion is typical, not a maximum. Measure loaded RUN with the existing main-switch and HCT loads on the carrier; the buffer alone does not establish its drive budget. Read actual GPIO3/JTAG eFuses without burns.</p><p class="hint">Compare target, feedforward and P/I/D with proposed duty. Check PWM fault, cycle-latched high time and identities separately. Synthetic valve current/opening are model estimates. Command 0% is not proof that a real valve has closed.</p></details><div id="idle-observation" role="status"><p class="hint">Waiting for idle observations.</p></div></div></section>`;
  root.querySelectorAll('[data-idle-key]').forEach(e=>e.onchange=()=>{t[e.dataset.idleGroup][e.dataset.idleKey]=e.type==='checkbox'?e.checked:Number(e.value);changed();});
  root.querySelector('#idle-algorithm').onchange=e=>{c.algorithm=e.target.value;changed();};
  root.querySelectorAll('[data-idle-array]').forEach(e=>e.onchange=()=>{c[e.dataset.idleArray][Number(e.dataset.idleIndex)]=Number(e.value);changed();});
 }
 function validate(root){
  for(const e of root.querySelectorAll('input[type="number"]'))if(e.value.trim()===''||!Number.isFinite(Number(e.value))||!e.validity.valid){e.reportValidity();throw Error('Idle control: enter a finite value within the displayed bounds.');}
 }
 function status(root,e){
  const node=root?.querySelector('#idle-observation');if(!node)return;const c=e.idle,p=e.timing?.idle_pwm||e.idle_pwm,v=e.idle_valve||e.last_run?.idle_valve;
  const rows=c?[['Controller state',c.state],['Eligibility reason',c.reason],['Effective target (RPM)',c.target_rpm],['Feedforward (%)',c.feedforward_pct],['P (%)',c.p_term],['I (%)',c.i_term],['D (%)',c.d_term],['Proposed duty (%)',c.duty_pct],['Controller flags',c.flags],['PID updates',c.pid_updates]]:[];
  if(p)rows.push(['PWM fault',p.fault??'unavailable'],['Cycle-latched command',p.sequence],['Pending command',p.pending_sequence],['Cycle-latched period (µs)',p.period_us],['Cycle-latched high time (µs)',p.high_us],['Virtual GPIO high',p.virtual_high],['Physical command high',p.physical_command_high],['Maximum dispatch lateness (µs)',p.max_lateness_us]);
  if(v)rows.push(['SYNTHETIC valve current (A)',v.current_a],['SYNTHETIC valve opening (%)',v.opening_pct],['Valve model mode',v.mode]);
  node.innerHTML=rows.map(([label,value])=>`<div class="keyline"><span>${esc(label)}</span><strong>${esc(typeof value==='number'?Number(value.toFixed(4)):value)}</strong></div>`).join('')+`<p class="hint">${esc(e.simulator?'Completed synthetic snapshot; check age above.':'Controller proposals and separately sampled dispatcher state; no electrical measurement.')}</p>`;
 }
 return {defaults,constants,attach,status,validate,algorithms:meta.algorithms};
})();
)ECU_ASSET";
inline constexpr char transient_js[]=R"ECU_ASSET(// Generated by scripts/generate_transient_ui.py
window.EcuTransientMetadata={"defaults":{"mode":"legacy_tps","apply":"multiply","sample_period_ms":20,"tps_threshold_pct_s":40,"map_threshold_kpa_s":40,"tps_min_change_pct":0.5,"map_min_change_kpa":0.5,"duration_ms":200,"max_enrichment_pct":100,"decel_fuel_pct":100,"rpm_taper_start":3000,"rpm_taper_end":6000,"cold_multiplier_pct":100,"cold_taper_start_c":0,"cold_taper_end_c":70,"tps_rates":[0,100,500,1500],"tps_added_pct":[0,10,30,50],"map_rates":[0,100,500,1500],"map_added_pct":[0,10,30,50]},"modes":["legacy_tps","off","tps_rate","map_rate"],"modeLabels":["Legacy TPS decay","Off","TPS rate table","MAP rate table"],"applies":["multiply","add_reference"],"applyLabels":["Multiply fuel","Add reference fuel"],"scalars":["sample_period_ms","tps_threshold_pct_s","map_threshold_kpa_s","tps_min_change_pct","map_min_change_kpa","duration_ms","max_enrichment_pct","decel_fuel_pct","rpm_taper_start","rpm_taper_end","cold_multiplier_pct","cold_taper_start_c","cold_taper_end_c"],"arrays":["tps_rates","tps_added_pct","map_rates","map_added_pct"],"units":{"sample_period_ms":"ms","tps_threshold_pct_s":"%/s","map_threshold_kpa_s":"kPa/s","tps_min_change_pct":"%","map_min_change_kpa":"kPa","duration_ms":"ms","max_enrichment_pct":"%","decel_fuel_pct":"%","rpm_taper_start":"RPM","rpm_taper_end":"RPM","cold_multiplier_pct":"%","cold_taper_start_c":"C","cold_taper_end_c":"C","tps_rates":"%/s","tps_added_pct":"%","map_rates":"kPa/s","map_added_pct":"%"},"limits":{"sample_period_ms":[5,100],"tps_threshold_pct_s":[0,2550],"map_threshold_kpa_s":[0,2550],"tps_min_change_pct":[0,10],"map_min_change_kpa":[0,10],"duration_ms":[0,2000],"max_enrichment_pct":[0,650],"decel_fuel_pct":[0,100],"rpm_taper_start":[50,8000],"rpm_taper_end":[50,8000],"cold_multiplier_pct":[100,255],"cold_taper_start_c":[-40,140],"cold_taper_end_c":[-40,140],"tps_rates":[0,2550],"tps_added_pct":[0,255],"map_rates":[0,2550],"map_added_pct":[0,255]}};
/* Metadata is generated by scripts/generate_transient_ui.py. */
window.EcuTransientEnrichment=(()=>{
 const m=window.EcuTransientMetadata,esc=v=>String(v??'').replace(/[&<>"']/g,c=>({'&':'&amp;','<':'&lt;','>':'&gt;','"':'&quot;',"'":'&#39;'}[c]));
 const labels={sample_period_ms:'Rate measurement window',tps_threshold_pct_s:'TPS rate trigger',map_threshold_kpa_s:'MAP rate trigger',tps_min_change_pct:'Minimum TPS movement per window',map_min_change_kpa:'Minimum MAP movement per window',duration_ms:'Event hold duration (0 disables events)',max_enrichment_pct:'Maximum extra fuel after tapers',decel_fuel_pct:'Fuel remaining during deceleration',rpm_taper_start:'RPM where extra fuel starts tapering',rpm_taper_end:'RPM where extra fuel reaches zero',cold_multiplier_pct:'Cold multiplier on extra fuel',cold_taper_start_c:'Coolant temperature for full cold multiplier',cold_taper_end_c:'Coolant temperature for neutral cold multiplier'};
 const legacy={accel_threshold_pct_s:['Legacy TPS trigger','%/s'],accel_gain:['Legacy TPS gain','s/%'],accel_decay_s:['Legacy decay time','s']};
 function defaults(){return structuredClone(m.defaults);}
 function constants(t){const c=t.transient_enrichment;return [{page:0,name:'ae_mode',value:m.modes.indexOf(c.mode),aeMode:true},{page:0,name:'ae_apply',value:m.applies.indexOf(c.apply),aeApply:true},...m.scalars.map(key=>({page:0,name:'ae_'+key,value:c[key],aeKey:key,unit:m.units[key]})),...m.arrays.map(key=>({page:0,name:'ae_'+key,value:c[key],aeKey:key,unit:m.units[key]}))];}
 function attach(root,t,changed){
  const c=t.transient_enrichment;
  function field(key,value,legacyField=false){const unit=legacyField?legacy[key][1]:m.units[key],label=legacyField?legacy[key][0]:labels[key],limit=legacyField?null:m.limits[key];return `<div class="field"><label for="ae-${key}">${esc(label)} (${esc(unit)})</label><input id="ae-${key}" data-ae-key="${key}" ${legacyField?'data-ae-legacy="1"':''} type="number" step="any" required value="${value}" ${limit?`min="${limit[0]}" max="${limit[1]}"`:''}></div>`;}
  root.innerHTML=`<section class="panel" style="margin-top:20px"><div class="panelhead"><h2>Transient fueling</h2><span class="tag">PROPOSED DOSE / OUTPUTS INHIBITED</span></div><div class="panelbody"><div class="formgrid"><div class="field"><label for="ae-mode">Input and algorithm</label><select id="ae-mode">${m.modes.map((v,i)=>`<option value="${v}" ${c.mode===v?'selected':''}>${m.modeLabels[i]}</option>`).join('')}</select></div><div class="field"><label for="ae-apply">Fuel application in rate-table modes</label><select id="ae-apply">${m.applies.map((v,i)=>`<option value="${v}" ${c.apply===v?'selected':''}>${m.applyLabels[i]}</option>`).join('')}</select></div></div><p class="hint" id="ae-editor-basis"></p><details><summary>Legacy TPS decay settings</summary><p class="hint">These three settings apply only to Legacy TPS decay. Older tunes retain this behavior and their saved values.</p><div class="formgrid" style="margin-top:12px">${Object.keys(legacy).map(k=>field(k,t.settings[k],true)).join('')}</div></details><details open><summary>Rate-table triggers, hold and tapers</summary><div class="formgrid" style="margin-top:12px">${m.scalars.map(k=>field(k,c[k])).join('')}</div><p class="hint">New modes use increasing sensor acquisition timestamps and a measurement window. Threshold and minimum movement checks are strict: the change must exceed the setting. Stops, cranking, faults, DFCO, acquisition gaps and reversed clocks clear their history. The next sample establishes a fresh baseline. A zero duration disables events; equal taper endpoints disable that taper. The requested correction is latched until expiry or a stronger event. Opposite movement cancels the previous phase.</p></details>${['tps','map'].map(key=>`<details ${key==='tps'?'open':''}><summary>${key.toUpperCase()} rate curve</summary><p class="hint">Increasing ${m.units[key+'_rates']} axes; values are extra fuel percent before RPM and coolant tapers.</p><div class="tablewrap"><table><thead><tr><th>Rate (${m.units[key+'_rates']})</th><th>Extra fuel (%)</th></tr></thead><tbody>${c[key+'_rates'].map((v,i)=>`<tr>${[key+'_rates',key+'_added_pct'].map(k=>`<td><input aria-label="${key.toUpperCase()} ${k.endsWith('rates')?'rate':'extra fuel'} ${i+1}" data-ae-array="${k}" data-ae-index="${i}" type="number" step="any" required value="${c[k][i]}"></td>`).join('')}</tr>`).join('')}</tbody></table></div></details>`).join('')}<div id="ae-observation" class="fine" style="margin-top:16px">No transient control observation.</div><details><summary>MAP/TPS wiring and debugging</summary><p class="hint">Use the existing protected J11 MAP and J12 TPS inputs, confirmed in kPa and percent. Keep each signal referenced to its connector pin1 ground and verify sensor pinouts. No extra driver or connector is required. Display smoothing does not filter this control path; the new rate window is explicit. Compare raw voltage, calibrated values, acquisition-window rates, threshold gates, phase and effective dose before changing a curve. Use the engine data recorder for short events. Sensor noise can trigger enrichment; fix wiring and calibration before increasing limits.</p><p class="hint">Deceleration is a total fuel percentage:100% is neutral,0% suppresses new injector starts while spark continues unless another cut applies. Active injector closing edges still finish normally. Deadtime is added once per opening and is never enriched. Final pulse/duty limits still inhibit the whole command. These are bench development settings, not a vehicle base tune.</p></details></div></section>`;
  const hint=()=>{root.querySelector('#ae-editor-basis').textContent=c.mode==='legacy_tps'?'Editor: legacy TPS-rate exponential decay. The new rate curves, hold, tapers and fuel-application selector are stored but unused in this mode.':c.mode==='off'?'Editor: transient corrections are disabled. Starting, warmup and other fuel corrections remain separate.':c.apply==='multiply'?'Editor: the tapered extra percentage scales the current effective fuel dose before injector deadtime. Deceleration always scales the dose by its total fuel percentage.':'Editor: the tapered extra percentage adds a per-cylinder, four-stroke reference dose at100kPa,25°C,100%VE and lambda1, independently of current MAP/VE/warmup. Cylinder trims scale the complete dose, then it is split by opening count and deadtime is added. Deceleration always multiplies.';};
  root.querySelector('#ae-mode').onchange=e=>{c.mode=e.target.value;hint();changed();};root.querySelector('#ae-apply').onchange=e=>{c.apply=e.target.value;hint();changed();};
  root.querySelectorAll('[data-ae-key]').forEach(i=>i.onchange=()=>{(i.dataset.aeLegacy?t.settings:c)[i.dataset.aeKey]=i.value.trim()?Number(i.value):NaN;changed();});
  root.querySelectorAll('[data-ae-array]').forEach(i=>i.onchange=()=>{c[i.dataset.aeArray][Number(i.dataset.aeIndex)]=i.value.trim()?Number(i.value):NaN;changed();});hint();
 }
 function validate(root){for(const i of root.querySelectorAll('input[type=number]'))if(!i.value.trim()||!Number.isFinite(Number(i.value)))throw Error('Transient fueling: enter a finite value in every numeric field.');}
 function status(root,e){const pane=root.querySelector('#ae-observation');if(!pane)return;const d=e?.transient_enrichment;if(!d?.available){pane.textContent='No transient control observation. Run a synthetic scenario or inspect the target sensor source.';return;}const value=v=>typeof v==='number'&&Number.isFinite(v)?v.toFixed(3):'unknown';const rows=[['Observed algorithm',m.modeLabels[d.mode_code]||d.mode],['Fuel application',d.apply],['Phase / reason',d.reason?.replaceAll('_',' ')],['Rate timebase',d.rate_clock?.replaceAll('_',' ')],['TPS rate (%/s)',value(d.tps_dot_pct_s)],['MAP rate (kPa/s)',value(d.map_dot_kpa_s)],['Measured window (ms)',value(d.window_ms)],['Latched correction (%)',value(d.correction_pct)],['Effective proposed fuel-dose multiplier',value(e.accel)],['Added reference fuel (mg/cylinder/cycle)',value(d.added_fuel_mg)],['Hold remaining at observation (ms)',value(d.remaining_ms)],['Flags',d.flags]];pane.innerHTML='<p class="hint">Control observation, separate from unsaved editor settings. '+esc(e.simulator?'SYNTHETIC / completed run':'Target controller proposal')+'. Check source age; this is not an electrical measurement.</p>'+rows.map(([label,v])=>`<div class="keyline"><span>${esc(label)}</span><strong>${esc(v)}</strong></div>`).join('');}
 return {defaults,constants,attach,validate,status,modes:m.modes,modeLabels:m.modeLabels,applies:m.applies,applyLabels:m.applyLabels};
})();
)ECU_ASSET";
inline constexpr char load_js[]=R"ECU_ASSET(// Generated by scripts/generate_load_ui.py
window.EcuLoadMetadata={"defaults":{"fuel_source":"map","spark_source":"map","lambda_source":"follow_fuel","trim_source":"follow_fuel","pressure":"map_100kpa","aux_role":"postcat_monitor","baro_source":"fixed","ve_axis":"map_kpa","spark_axis":"map_kpa","lambda_axis":"map_kpa","trim_axis":"map_kpa","afr":"target","fixed_baro_kpa":100,"afr_delay_s":10},"enums":{"fuel_source":["map","tps","imap_emap"],"spark_source":["map","tps","imap_emap"],"lambda_source":["map","tps","imap_emap","follow_fuel"],"trim_source":["map","tps","imap_emap","follow_fuel"],"pressure":["none","map_100kpa","map_baro"],"aux_role":["postcat_monitor","emap","baro"],"baro_source":["fixed","aux"],"ve_axis":["map_kpa","tps_pct","imap_emap_pct"],"spark_axis":["map_kpa","tps_pct","imap_emap_pct"],"lambda_axis":["map_kpa","tps_pct","imap_emap_pct"],"trim_axis":["map_kpa","tps_pct","imap_emap_pct"],"afr":["off","target","measured"]},"labels":{"fuel_source":["MAP kPa","TPS percent","IMAP / EMAP percent"],"spark_source":["MAP kPa","TPS percent","IMAP / EMAP percent"],"lambda_source":["MAP kPa","TPS percent","IMAP / EMAP percent","Follow primary fuel"],"trim_source":["MAP kPa","TPS percent","IMAP / EMAP percent","Follow primary fuel"],"pressure":["Off: 100 kPa reference","MAP / 100 kPa","MAP / baro"],"aux_role":["J16 postcat monitor","J16 exhaust absolute pressure","J16 barometric absolute pressure"],"baro_source":["Fixed manual kPa","Live calibrated J16"],"ve_axis":["MAP kPa","TPS percent","IMAP / EMAP percent"],"spark_axis":["MAP kPa","TPS percent","IMAP / EMAP percent"],"lambda_axis":["MAP kPa","TPS percent","IMAP / EMAP percent"],"trim_axis":["MAP kPa","TPS percent","IMAP / EMAP percent"],"afr":["Off:stoichiometric basis","Incorporate target lambda","Measured / target lambda"]},"enumFields":["fuel_source","spark_source","lambda_source","trim_source","pressure","aux_role","baro_source","ve_axis","spark_axis","lambda_axis","trim_axis","afr"],"scalars":["fixed_baro_kpa","afr_delay_s"],"units":{"fixed_baro_kpa":"kPa","afr_delay_s":"s"},"limits":{"fixed_baro_kpa":[50,110],"afr_delay_s":[0,120]},"values":["fuel_load","spark_load","lambda_load","trim_load","pressure_factor","baro_kpa","emap_kpa","aux_kpa","afr_factor"],"afrStates":["off","target_incorporation","running_delay","cranking_neutral","wideband_unavailable","measured_ratio","invalid_target","running_clock_unavailable"]};
/* Metadata is generated by scripts/generate_load_ui.py. */
window.EcuLoadModel=(()=>{
 const m=window.EcuLoadMetadata,esc=v=>String(v??'').replace(/[&<>"']/g,c=>({'&':'&amp;','<':'&lt;','>':'&gt;','"':'&quot;',"'":'&#39;'}[c]));
 const sourceNames=['map','tps','imap_emap'],axisNames=['map_kpa','tps_pct','imap_emap_pct'],units=['kPa','% TPS','% IMAP/EMAP'];
 const labels={fuel_source:'Primary fuel table input',spark_source:'Spark table input',lambda_source:'Lambda target table input',trim_source:'Cylinder trim table input',pressure:'Fuel pressure normalization',aux_role:'J16 input role',baro_source:'Barometric pressure source',afr:'AFR incorporation',fixed_baro_kpa:'Fixed absolute barometric pressure',afr_delay_s:'Measured-AFR running delay'};
 const groups={ve:['Fuel coefficient','fuel_source','ve_axis'],spark:['Spark','spark_source','spark_axis'],lambda:['Lambda target','lambda_source','lambda_axis'],trim:['All four cylinder trims','trim_source','trim_axis']};
 const reasons=['unavailable','ready','invalid_configuration','required_map_unavailable','required_tps_unavailable','required_emap_unavailable','required_baro_unavailable','known_map_above_na_limit'];
 const defaults=()=>structuredClone(m.defaults);
 const resolve=(c,key)=>c[key]==='follow_fuel'?c.fuel_source:c[key];
 const expectedAxis=(c,key)=>axisNames[sourceNames.indexOf(resolve(c,key))];
 function basis(t,kind){const g=groups[kind],i=axisNames.indexOf(t.load_model[g[2]]);return {unit:units[i]||'unknown',axis:axisNames[i],source:resolve(t.load_model,g[1]),matched:t.load_model[g[2]]===expectedAxis(t.load_model,g[1]),min:i===0?5:0,max:i===0?110:i===1?100:600};}
 function constants(t){const c=t.load_model;return [...m.enumFields,...m.scalars].map(k=>({page:0,name:'load_'+k,value:c[k],loadKey:k,loadEnum:!!m.enums[k],unit:m.units[k]||''}));}
 function enumText(k,value){return '"'+m.labels[k][m.enums[k].indexOf(value)]+'"';}
 function parseEnum(k,raw){const list=m.enums[k],quoted=m.labels[k].map(v=>'"'+v+'"');let i=quoted.indexOf(raw);if(i<0)i=list.map((_,n)=>String(n)).indexOf(raw);if(i<0)throw Error('Invalid load-model selection.');return list[i];}
 function validateTune(t){
  const c=t.load_model;if(!c||Object.keys(c).sort().join('|')!==Object.keys(m.defaults).sort().join('|'))throw Error('Invalid load-model shape.');
  for(const k of m.enumFields)if(!m.enums[k].includes(c[k]))throw Error('Unknown load-model selection.');
  for(const k of m.scalars)if(!Number.isFinite(c[k])||c[k]<m.limits[k][0]||c[k]>m.limits[k][1])throw Error('Load-model numeric value is outside its range.');
  for(const k of Object.keys(groups))if(!basis(t,k).matched)throw Error(groups[k][0]+': acknowledge the new table basis before saving.');
  const sources=[c.fuel_source,c.spark_source,...(c.afr!=='off'||t.settings.ego_enabled?[c.lambda_source]:[]),...(t.cylinder_trims.enabled?[c.trim_source]:[])].map(s=>s==='follow_fuel'?c.fuel_source:s);
  if(sources.includes('imap_emap')&&c.aux_role!=='emap')throw Error('IMAP / EMAP requires J16 assigned to calibrated absolute exhaust pressure.');
  if(c.pressure==='map_baro'&&c.baro_source==='aux'&&c.aux_role!=='baro')throw Error('Live barometric pressure requires J16 assigned to calibrated absolute barometric pressure.');
 }
 function attach(root,t,changed,redraw){
  const c=t.load_model;
  function select(k){return `<div class="field"><label for="load-${k}">${labels[k]}</label><select id="load-${k}">${m.enums[k].map((v,i)=>`<option value="${v}" ${c[k]===v?'selected':''}>${esc(m.labels[k][i])}</option>`).join('')}</select></div>`;}
  root.innerHTML=`<section class="panel" style="margin-top:20px"><div class="panelhead"><h2>Load sources & fuel model</h2><span class="tag">DEVELOPMENT / OUTPUTS INHIBITED</span></div><div class="panelbody"><div class="formgrid">${['fuel_source','spark_source','lambda_source','trim_source','pressure','aux_role','baro_source','afr'].map(select).join('')}${m.scalars.map(k=>`<div class="field"><label for="load-${k}">${labels[k]} (${m.units[k]})</label><input id="load-${k}" type="number" step="any" required min="${m.limits[k][0]}" max="${m.limits[k][1]}" value="${c[k]}"></div>`).join('')}</div><p class="hint">Table coordinates and pressure multiplication are independent. TPS with normalization Off uses a fixed100 kPa modeled reference; it needs a TPS-based fuel calibration. MAP / baro changes that reference with altitude. IMAP / EMAP means100 × manifold absolute pressure / exhaust absolute pressure. Default MAP tables are illustrative and do not become a TPS tune by changing the selector.</p><div id="load-bases"></div><details><summary>J16 pressure wiring and debugging</summary><p class="hint">J16 is the existing POSTCAT input on ADC channel5, with connector pin 1 ground, pin 2 protected 5 V and pin 3 signal. It is not an unused input. Disconnect the postcat signal before assigning an absolute-pressure sensor. Do not parallel sensors. In Sensor calibration, set the postcat channel to a measured linear/table conversion in kPa and confirm it. The protected input loads the sensor by about55 kΩ; verify calibration against a pressure reference. EMAP accepts20..500 kPa absolute and live baro50..110 kPa. Keep an exhaust-pressure transducer within its temperature rating using suitable remote tubing; no exhaust/thermal qualification has been performed.</p><p class="hint">J16 can supply one pressure signal. EMAP plus live baro requires another input path, which is not implemented. Fixed baro is a manual value. No pre-crank MAP baro capture is inferred from zero RPM. Known calibrated MAP above 110 kPa still faults every mode. If a pure TPS configuration does not require MAP, an unavailable MAP stays unknown and its pressure guard is unavailable.</p></details><details><summary>AFR, zero fuel and test interpretation</summary><p class="hint">Off uses a stoichiometric fuel basis. Target divides the base fuel by target lambda, preserving the previous behavior. Measured applies measured lambda / target only after the running delay, with a ready wideband and outside cranking; otherwise its factor is neutral1. A fresh stopped/cranking observation restarts that delay. EGO remains a separate bounded correction. Zero ordinary fuel suppresses deadtime-only openings. An added reference dose can still supply fuel; its effective dose ratio is unknown when the base is zero. These are modeled proposals, not measured air or injector delivery. Secondary fuel/spark tables, boost control and a separate baro correction curve remain open.</p></details><div id="load-observation" class="fine" style="margin-top:16px">No load-model control observation.</div></div></section>`;
  function drawBases(){root.querySelector('#load-bases').innerHTML=Object.entries(groups).map(([k,[label,source,axis]])=>`<details ${basis(t,k).matched?'':'open'}><summary>${label}: stored ${esc(units[axisNames.indexOf(c[axis])])}; selected ${esc(units[axisNames.indexOf(expectedAxis(c,source))])}${basis(t,k).matched?'':' / basis acknowledgement required'}</summary><p class="hint">Changing the source keeps all existing table values. There is no general MAP-to-TPS conversion. Review the complete calibration. Replacing an axis keeps its cell values and requires retuning.</p><label class="check"><input id="load-ack-${k}" type="checkbox"><span>I reviewed the ${label.toLowerCase()} values for the selected units.</span></label><div class="actions" style="margin-top:10px"><button class="small" data-load-basis="${k}" data-load-action="use">Use edited axes in selected units</button><button class="small ghost" data-load-basis="${k}" data-load-action="initialize">Replace load axes with illustrative defaults</button></div><p class="hint" id="load-error-${k}" role="status"></p></details>`).join('');
   root.querySelectorAll('[data-load-basis]').forEach(b=>b.onclick=()=>{const k=b.dataset.loadBasis;if(!root.querySelector('#load-ack-'+k).checked){root.querySelector('#load-error-'+k).textContent='Acknowledge the calibration review first.';return;}
    const axis=expectedAxis(c,groups[k][1]),maps=k==='trim'?t.cylinder_trims.fuel_maps:[t.maps[k]];
    if(b.dataset.loadAction==='initialize')for(const map of maps){const n=map.load.length;map.load=Array.from({length:n},(_,i)=>Number(((axis==='map_kpa'?10:0)+i*(axis==='map_kpa'?100:axis==='tps_pct'?100:600)/(n-1)).toFixed(6)));}
    c[groups[k][2]]=axis;changed();drawBases();redraw?.();
   });
  }
  for(const k of Object.keys(m.enums).filter(k=>!k.endsWith('_axis')))root.querySelector('#load-'+k).onchange=e=>{c[k]=e.target.value;changed();drawBases();redraw?.();};
  for(const k of m.scalars)root.querySelector('#load-'+k).onchange=e=>{c[k]=e.target.value.trim()?Number(e.target.value):NaN;changed();};drawBases();
 }
 function validate(root,t){for(const i of root.querySelectorAll('input[type=number]'))if(!i.value.trim()||!Number.isFinite(Number(i.value)))throw Error('Load model: enter a finite value in every numeric field.');validateTune(t);}
 function checkObservation(d,present=true){
  const u=(n,max)=>Number.isSafeInteger(n)&&n>=0&&n<=max,codeNames=['fuel_source','spark_source','lambda_source','trim_source','pressure','aux_role','baro_source','afr'];
  if(!d||typeof d!=='object'||Array.isArray(d)||typeof d.available!=='boolean'||d.available&&!present||!u(d.flags,65535)||!u(d.reason_code,7)||d.reason!==reasons[d.reason_code])throw Error('Invalid load-model observation.');
  const allowed=[...m.values,'available','flags','reason','reason_code','afr_state','afr_state_code','meaning',...codeNames,...codeNames.map(k=>k+'_code')];
  if(Object.keys(d).some(k=>!allowed.includes(k)))throw Error('Unknown load-model observation field.');
  for(const k of codeNames){const list=k.endsWith('_source')&&k!=='baro_source'?sourceNames:m.enums[k];if(!u(d[k+'_code'],list.length-1)||d[k]!==list[d[k+'_code']])throw Error('Invalid load-model source.');}
  if(m.values.some(k=>d.available?d[k]!==null&&(!Number.isFinite(d[k])||Math.abs(d[k])>3.4028234663852886e38):d[k]!==null))throw Error('Invalid load-model value.');
  const evaluated=d.available&&Number.isFinite(d.afr_factor),state=evaluated?(d.flags>>>13)&7:255;
  if(d.afr_state_code!==state||d.afr_state!==(evaluated?m.afrStates[state]:'not_evaluated')||evaluated&&Math.fround(d.afr_factor)<0||d.available&&(d.flags&1)&&(!Number.isFinite(d.fuel_load)||!Number.isFinite(d.spark_load)||!Number.isFinite(d.pressure_factor)||Math.fround(d.pressure_factor)<=0))throw Error('Invalid load-model arithmetic state.');
 }
 function status(root,e){const pane=root.querySelector('#load-observation'),d=e?.load_model;if(!pane)return;if(!d?.available){pane.textContent='No load-model control observation.';return;}const n=v=>Number.isFinite(v)?v.toFixed(4):'unknown';const rows=[['Observed reason',d.reason],...['fuel','spark','lambda','trim'].map(k=>[k+' coordinate ('+(units[d[k+'_source_code']]||'unknown')+')',n(d[k+'_load'])]),['Pressure normalization',d.pressure+' / '+n(d.pressure_factor)],['Barometric pressure (kPa)',n(d.baro_kpa)+(d.flags&128?' / manual':'')],['Exhaust pressure (kPa)',n(d.emap_kpa)],['AFR application',d.afr_state+' / '+n(d.afr_factor)],['MAP overpressure guard',d.flags&256?'available':'unavailable'],['Flags',d.flags]];pane.innerHTML='<p class="hint">Control observation, separate from editor settings. '+esc(e.simulator?'SYNTHETIC / completed run':'Target proposal')+'. Check the sample source and age.</p>'+rows.map(([k,v])=>`<div class="keyline"><span>${esc(k)}</span><strong>${esc(v)}</strong></div>`).join('');}
 return {defaults,constants,enumText,parseEnum,validateTune,validate,attach,basis,status,checkObservation,enums:m.enums};
})();
)ECU_ASSET";
inline constexpr char secondary_js[]=R"ECU_ASSET(// Generated by scripts/generate_secondary_ui.py
window.EcuSecondaryMetadata={"defaults":{"fuel":{"mode":"off","source":"map","axis":"map_kpa","cells":"absolute","condition":"rpm","threshold":3000,"debounce_ms":20,"input_channel":0,"active_high":true,"map":{"rpm":[80,200,400,600,800,1000,1200,1600,2000,2500,3000,3500,4000,5000,6000,8000],"load":[10,15,20,25,30,35,40,45,50,55,60,70,80,90,100,110],"cells":[85,85,85,85,85,85,85,85,85,85,85,85,85,85,85,85,85,85,85,85,85,85,85,85,85,85,85,85,85,85,85,85,85,85,85,85,85,85,85,85,85,85,85,85,85,85,85,85,85,85,85,85,85,85,85,85,85,85,85,85,85,85,85,85,85,85,85,85,85,85,85,85,85,85,85,85,85,85,85,85,85,85,85,85,85,85,85,85,85,85,85,85,85,85,85,85,85,85,85,85,85,85,85,85,85,85,85,85,85,85,85,85,85,85,85,85,85,85,85,85,85,85,85,85,85,85,85,85,85,85,85,85,85,85,85,85,85,85,85,85,85,85,85,85,85,85,85,85,85,85,85,85,85,85,85,85,85,85,85,85,85,85,85,85,85,85,85,85,85,85,85,85,85,85,85,85,85,85,85,85,85,85,85,85,85,85,85,85,85,85,85,85,85,85,85,85,85,85,85,85,85,85,85,85,85,85,85,85,85,85,85,85,85,85,85,85,85,85,85,85,85,85,85,85,85,85,85,85,85,85,85,85,85,85,85,85,85,85,85,85,85,85,85,85,85,85,85,85,85,85,85,85,85,85,85,85]}},"spark":{"mode":"off","source":"map","axis":"map_kpa","cells":"absolute","condition":"rpm","threshold":3000,"debounce_ms":20,"input_channel":1,"active_high":true,"map":{"rpm":[80,200,400,600,800,1000,1200,1600,2000,2500,3000,3500,4000,5000,6000,8000],"load":[10,15,20,25,30,35,40,45,50,55,60,70,80,90,100,110],"cells":[15,15,15,15,15,15,15,15,15,15,15,15,15,15,15,15,15,15,15,15,15,15,15,15,15,15,15,15,15,15,15,15,15,15,15,15,15,15,15,15,15,15,15,15,15,15,15,15,15,15,15,15,15,15,15,15,15,15,15,15,15,15,15,15,15,15,15,15,15,15,15,15,15,15,15,15,15,15,15,15,15,15,15,15,15,15,15,15,15,15,15,15,15,15,15,15,15,15,15,15,15,15,15,15,15,15,15,15,15,15,15,15,15,15,15,15,15,15,15,15,15,15,15,15,15,15,15,15,15,15,15,15,15,15,15,15,15,15,15,15,15,15,15,15,15,15,15,15,15,15,15,15,15,15,15,15,15,15,15,15,15,15,15,15,15,15,15,15,15,15,15,15,15,15,15,15,15,15,15,15,15,15,15,15,15,15,15,15,15,15,15,15,15,15,15,15,15,15,15,15,15,15,15,15,15,15,15,15,15,15,15,15,15,15,15,15,15,15,15,15,15,15,15,15,15,15,15,15,15,15,15,15,15,15,15,15,15,15,15,15,15,15,15,15,15,15,15,15,15,15,15,15,15,15,15,15]}}},"enums":{"mode":["off","multiply","add","conditional","input"],"source":["map","tps","imap_emap"],"axis":["map_kpa","tps_pct","imap_emap_pct"],"cells":["absolute","multiplier","adder"],"condition":["rpm","map_kpa","tps_pct","ethanol_pct"]},"labels":{"mode":["Off","Multiply percent","Add","Conditional switch","Qualified input switch"],"source":["MAP kPa","TPS percent","IMAP / EMAP percent"],"axis":["MAP kPa","TPS percent","IMAP / EMAP percent"],"cells":["Absolute table value","Multiplier percent","Additive table value"],"condition":["RPM","MAP kPa","TPS percent","Qualified ethanol percent"]},"enumFields":["mode","source","axis","cells","condition"],"scalars":["threshold","debounce_ms"],"values":["primary","primary_corrected","secondary","combined","coordinate","condition_value","input_age_ms","threshold","debounce_ms"],"valueLabels":["Primary","PrimaryCorrected","Secondary","Combined","Coordinate","ConditionValue","InputAgeMs","Threshold","DebounceMs"],"boolFields":["available","evaluated","active","clamped","pending","input_qualified","input_level","pending_level","input_valid","input_raw","active_high","valid"],"reasons":["disabled","multiply","add","condition_primary","condition_secondary","input_primary","input_secondary","input_initial_qualification","input_unavailable","input_stale","input_time_reversed","required_map_unavailable","required_tps_unavailable","required_emap_unavailable","required_ethanol_unavailable","cranking_spark_bypass","invalid_configuration","invalid_arithmetic"],"inputSources":["unavailable","target_protected_input","synthetic_input"],"axisUnits":{"map_kpa":"kPa","tps_pct":"% TPS","imap_emap_pct":"% IMAP/EMAP"},"conditionUnits":{"rpm":"RPM","map_kpa":"kPa","tps_pct":"% TPS","ethanol_pct":"% ethanol"},"cellUnits":{"fuel":{"absolute":"% coefficient","multiplier":"% multiplier","adder":"percentage_points"},"spark":{"absolute":"deg BTDC","multiplier":"% multiplier","adder":"deg delta"}}};
/* Shared metadata comes from scripts/generate_secondary_ui.py. */
window.EcuSecondaryTables=(()=>{
 const m=window.EcuSecondaryMetadata,kinds=['fuel','spark'],axes=['map_kpa','tps_pct','imap_emap_pct'],units=['kPa','% TPS','% IMAP/EMAP'];
 const esc=v=>String(v??'').replace(/[&<>"']/g,c=>({'&':'&amp;','<':'&lt;','>':'&gt;','"':'&quot;',"'":'&#39;'}[c]));
 const defaults=()=>structuredClone(m.defaults),expectedCells=mode=>mode==='multiply'?'multiplier':mode==='add'?'adder':'absolute';
 const range=(n,lo,hi)=>typeof n==='number'&&Number.isFinite(n)&&n>=lo&&n<=hi;
 function basis(t,kind){const r=t.secondary_tables[kind],i=axes.indexOf(r.axis);return {unit:units[i]||'unknown',axis:r.axis,matched:r.axis===axes[m.enums.source.indexOf(r.source)],min:i===0?5:0,max:i===0?110:i===1?100:600};}
 function cellUnit(kind,cells){return kind==='spark'&&cells!=='multiplier'?'deg':cells==='adder'?'percentage_points':'%';}
 function cellLimits(kind,cells){return kind==='fuel'||cells==='multiplier'?[0,255]:cells==='adder'?[-40,70]:[-5,40];}
 function constants(t){return kinds.flatMap(kind=>{const r=t.secondary_tables[kind];return [...m.enumFields.map(key=>({page:0,name:`secondary_${kind}_${key}`,value:r[key],secKind:kind,secKey:key,secEnum:true})),...m.scalars.map(key=>({page:0,name:`secondary_${kind}_${key}`,value:r[key],secKind:kind,secKey:key,unit:key==='debounce_ms'?'ms':m.conditionUnits[r.condition]})),{page:0,name:`secondary_${kind}_input_channel`,value:r.input_channel,secKind:kind,secKey:'input_channel'},{page:0,name:`secondary_${kind}_active_high`,value:r.active_high,secKind:kind,secKey:'active_high',secPolarity:true},...['rpm','load','cells'].map((field,i)=>({page:0,name:`secondary_${kind}_map${['Rpm','Load','Table'][i]}`,value:r.map[field],secKind:kind,secMap:true,field,unit:field==='rpm'?'RPM':field==='load'?m.axisUnits[r.axis]:m.cellUnits[kind][r.cells]}))];});}
 function enumText(key,value){return '"'+m.labels[key][m.enums[key].indexOf(value)]+'"';}
 function parseEnum(key,raw){const labels=m.labels[key].map(v=>'"'+v+'"');let i=labels.indexOf(raw);if(i<0)i=m.enums[key].map((_,n)=>String(n)).indexOf(raw);if(i<0)throw Error('Invalid secondary-table selection.');return m.enums[key][i];}
 function validateTune(t){
  if(!t.secondary_tables||Object.keys(t.secondary_tables).sort().join('|')!=='fuel|spark')throw Error('Both secondary tables are required.');
  for(const kind of kinds){const r=t.secondary_tables[kind];
   if(!r||Object.keys(r).sort().join('|')!==Object.keys(m.defaults[kind]).sort().join('|'))throw Error('Invalid secondary '+kind+' shape.');
   for(const key of m.enumFields)if(!m.enums[key].includes(r[key]))throw Error('Unknown secondary '+kind+' selection.');
   if(!Number.isInteger(r.input_channel)||r.input_channel<0||r.input_channel>1||typeof r.active_high!=='boolean'||!range(r.debounce_ms,0,500)||!range(r.threshold,0,r.condition==='rpm'?10000:r.condition==='map_kpa'?110:100))throw Error('Secondary '+kind+': invalid threshold, debounce or input selection.');
   if(!basis(t,kind).matched)throw Error('Secondary '+kind+': review the load-axis basis before saving.');
   if(r.mode!=='off'&&r.cells!==expectedCells(r.mode))throw Error('Secondary '+kind+': review the cell meaning before saving.');
   if(r.mode!=='off'&&r.source==='imap_emap'&&t.load_model.aux_role!=='emap')throw Error('Secondary pressure ratio requires J16 assigned to calibrated EMAP.');
   if(!r.map||Object.keys(r.map).sort().join('|')!=='cells|load|rpm'||!Array.isArray(r.map.rpm)||r.map.rpm.length!==16||!Array.isArray(r.map.load)||r.map.load.length!==16||!Array.isArray(r.map.cells)||r.map.cells.length!==256)throw Error('Secondary '+kind+': expected a complete16 x16 map.');
   const b=basis(t,kind),limits=cellLimits(kind,r.cells);
   for(const [key,lo,hi]of [['rpm',50,10000],['load',b.min,b.max]])for(let i=0;i<16;i++){const v=Math.fround(r.map[key][i]);if(!range(v,lo,hi)||i&&v<=Math.fround(r.map[key][i-1]))throw Error('Secondary '+kind+': axes must increase strictly in their declared units.');}
   if(r.map.cells.some(v=>!range(Math.fround(v),Math.fround(limits[0]),Math.fround(limits[1]))))throw Error('Secondary '+kind+': a cell is outside the stored meaning\'s range.');
  }
 }
 function attach(root,t,changed,editMap){
  function draw(){root.innerHTML=`<section class="panel" style="margin-top:20px"><div class="panelhead"><h2>Secondary fuel & spark tables</h2><span class="tag">OUTPUTS INHIBITED</span></div><div class="panelbody"><p class="hint">Each table has its own load source. Multiply/add combines tables; conditional and input modes replace the primary table. Lambda and cylinder-trim coordinates continue to follow their configured primary source. No continuous blend is implemented.</p>${kinds.map(kind=>{const r=t.secondary_tables[kind],b=basis(t,kind),want=expectedCells(r.mode),cellsOkay=r.mode==='off'||r.cells===want;return `<details open><summary>Secondary ${kind}: ${esc(r.mode)} / stored ${esc(cellUnit(kind,r.cells))}</summary><div class="formgrid secondary-fields" style="margin-top:12px">${['mode','source','condition'].map(key=>`<div class="field"><label for="sec-${kind}-${key}">${key==='mode'?'Table mode':key==='source'?'Secondary load source':'Switch condition'}</label><select id="sec-${kind}-${key}">${m.enums[key].map((value,n)=>`<option value="${value}" ${r[key]===value?'selected':''}>${esc(m.labels[key][n])}</option>`).join('')}</select></div>`).join('')}<div class="field"><label for="sec-${kind}-threshold">Strictly greater than (${esc(r.condition)})</label><input id="sec-${kind}-threshold" type="number" step="any" value="${r.threshold}"></div><div class="field"><label for="sec-${kind}-input_channel">Protected input channel</label><select id="sec-${kind}-input_channel"><option value="0" ${r.input_channel===0?'selected':''}>Input 0</option><option value="1" ${r.input_channel===1?'selected':''}>Input 1</option></select></div><div class="field"><label for="sec-${kind}-active_high">Input selection polarity</label><select id="sec-${kind}-active_high"><option value="true" ${r.active_high?'selected':''}>High / closed selects secondary</option><option value="false" ${!r.active_high?'selected':''}>Low / open selects secondary</option></select></div><div class="field"><label for="sec-${kind}-debounce_ms">Stable observation period (ms)</label><input id="sec-${kind}-debounce_ms" type="number" min="0" max="500" step="any" value="${r.debounce_ms}"></div></div><p class="hint ${b.matched&&cellsOkay?'':'warn'}">Stored rows: ${esc(b.unit)}. Stored cell meaning: ${esc(r.cells)} (${esc(cellUnit(kind,r.cells))}). ${b.matched?'Source basis matches.':'Source basis review required.'} ${cellsOkay?'Cell meaning matches or mode is Off.':'Cell meaning review required.'}</p><label class="check"><input id="sec-${kind}-ack" type="checkbox"><span>I reviewed this secondary map for the selected load source and mode.</span></label><div class="actions" style="margin-top:10px"><button class="small" data-sec-review="${kind}" data-action="axes">Use edited load axes in selected units</button><button class="small ghost" data-sec-review="${kind}" data-action="initialize">Replace load axes with illustrative defaults</button><button class="small" data-sec-review="${kind}" data-action="cells">Use reviewed cells for selected mode</button><button class="small ghost" data-sec-review="${kind}" data-action="neutral">Fill neutral multiplier/additive cells</button><button class="small" data-sec-map="${kind}">Edit secondary ${kind} map</button></div><p class="hint" id="sec-${kind}-error" role="status"></p></details>`;}).join('')}<p class="hint">Multiply/add operates after the primary soft spark retard. Switched spark applies retard to the selected secondary base. Cranking bypasses secondary spark. Final angle and injector-capacity guards still apply. Enabled secondary tables require their selected sensors even while the primary table remains selected.</p><p class="hint warn">Input mode uses the SW2-J4-DRAFT1 accessory on the target. Saving an Input rule reserves J4 SDA/SCL and address0x20 for this circuit. An absent, invalid or stale accessory inhibits Input-dependent control. The circuit and harness require bench qualification. Ethanol has no target producer. Host test stimuli are synthetic. PAIR and RESET remain service buttons; cam and pressure inputs retain their roles.</p><details id="switch-accessory-guide"><summary>Protected switch wiring and troubleshooting</summary><p class="hint">Use a short internal harness: J4 pin1 GND, pin2 3V3, pin3 SDA/GPIO41, pin4 SCL/GPIO42. Leave pin5 SAFE_N completely unconnected. Connect only the specified SW2 accessory. The marker and loopback check register/pin behavior; they do not identify an arbitrary device at0x20.</p><p class="hint">Each external dry contact connects SW0 or SW1 to its dedicated ground return. Closed contact reads high, open contact reads low. Choose selection polarity per rule. Use contacts rated for dry circuits. An open wire looks like an open contact; a short to return looks like a closed contact. This circuit cannot diagnose wire continuity.</p><p class="hint">Start with both rules Off: no I²C register traffic is requested. After connecting the unpowered assembly and confirming rails, select Input, channel, polarity and stable observation period. Watch acquisition status, then each rule’s raw/qualified level and age. Readback failure remains invalid until a completed control observation consumes the fault; recovery needs a new sample and qualification period. A clock/state fault requires an ECU restart. Fix the cause first.</p><p class="hint warn">This draft is for inhibited bench development. Do not combine module USB power with carrier3V3. Supply loading, reset behavior, electrical faults, bus timing and enclosure fit still need physical tests.</p></details><div id="switch-accessory-status" class="fine">No target acquisition measurement.</div><div id="secondary-observation" class="fine">No secondary-table control observation.</div></div></section>`;
   for(const kind of kinds){const r=t.secondary_tables[kind];for(const key of ['mode','source','condition','input_channel','active_high'])root.querySelector(`#sec-${kind}-${key}`).onchange=e=>{r[key]=key==='input_channel'?Number(e.target.value):key==='active_high'?e.target.value==='true':e.target.value;changed();draw();};for(const key of ['threshold','debounce_ms'])root.querySelector(`#sec-${kind}-${key}`).onchange=e=>{r[key]=e.target.value.trim()?Number(e.target.value):NaN;changed();};}
   root.querySelectorAll('[data-sec-map]').forEach(button=>button.onclick=()=>editMap(button.dataset.secMap));
   root.querySelectorAll('[data-sec-review]').forEach(button=>button.onclick=()=>{const kind=button.dataset.secReview,r=t.secondary_tables[kind],error=root.querySelector(`#sec-${kind}-error`);if(!root.querySelector(`#sec-${kind}-ack`).checked){error.textContent='Acknowledge the calibration review first.';return;}
    const action=button.dataset.action;if(action==='axes'||action==='initialize'){const axis=axes[m.enums.source.indexOf(r.source)];if(action==='initialize')r.map.load=Array.from({length:16},(_,i)=>Number(((axis==='map_kpa'?10:0)+i*(axis==='map_kpa'?100:axis==='tps_pct'?100:600)/15).toFixed(6)));r.axis=axis;}
    else{if(r.mode==='off'){error.textContent='Select a mode before changing the cell meaning.';return;}const cells=expectedCells(r.mode);if(action==='neutral'){if(cells==='absolute'){error.textContent='A switched absolute map needs calibration; there is no general neutral value.';return;}r.map.cells.fill(cells==='multiplier'?100:0);}r.cells=cells;}changed();draw();editMap(kind);
   });
  }draw();
 }
 function validate(root,t){for(const input of root.querySelectorAll('input[type=number]'))if(!input.value.trim()||!Number.isFinite(Number(input.value)))throw Error('Secondary tables: enter finite values in every numeric field.');validateTune(t);}
 function checkObservation(d,kind,present=true){
  const integer=(v,max)=>Number.isSafeInteger(v)&&v>=0&&v<=max;
  if(!d||typeof d!=='object'||Array.isArray(d))throw Error('Invalid secondary observation.');
  const codes={mode:m.enums.mode,source:m.enums.source,axis:m.enums.axis,cells:m.enums.cells,condition:m.enums.condition,reason:m.reasons,input_source:m.inputSources};
  const allowed=[...m.values,...m.boolFields,...Object.keys(codes),...Object.keys(codes).map(k=>k+'_code'),'input_channel','flags','cell_unit','coordinate_unit','input_observed_us'];
  if(Object.keys(d).sort().join('|')!==allowed.sort().join('|')||m.boolFields.some(k=>typeof d[k]!=='boolean')||d.available&&!present||!integer(d.input_channel,1))throw Error('Invalid secondary observation fields.');
  for(const [key,values]of Object.entries(codes))if(!integer(d[key+'_code'],values.length-1)||d[key]!==values[d[key+'_code']])throw Error('Invalid secondary code.');
  let flags=d.input_channel*65536+d.axis_code*1048576;for(let i=0;i<m.boolFields.length;i++)if(d[m.boolFields[i]])flags+=2**i;
  if(d.flags!==flags||d.cell_unit!==cellUnit(kind,d.cells)||d.coordinate_unit!==units[d.axis_code])throw Error('Invalid secondary flags/units.');
  for(const key of m.values)if(d.available?d[key]!==null&&(!Number.isFinite(d[key])||Math.abs(d[key])>3.4028234663852886e38):d[key]!==null)throw Error('Invalid secondary numeric value.');
  const inputTime=d.mode==='input'&&d.input_source_code!==0;
  if(inputTime?typeof d.input_observed_us!=='string'||!/^(0|[1-9][0-9]{0,19})$/.test(d.input_observed_us)||BigInt(d.input_observed_us)>18446744073709551615n:d.input_observed_us!==null)throw Error('Invalid secondary input time.');
  if(!d.available&&(m.boolFields.some(k=>d[k]!==Boolean(k==='active_high'))||Object.keys(codes).some(k=>d[k+'_code']!==0)||d.input_channel))throw Error('Unavailable secondary state is not canonical.');
  if(d.available&&(!Number.isFinite(d.threshold)||!Number.isFinite(d.debounce_ms)||!range(Math.fround(d.threshold),0,d.condition==='rpm'?10000:d.condition==='map_kpa'?110:100)||!range(Math.fround(d.debounce_ms),0,500)))throw Error('Invalid secondary metadata.');
  if(d.evaluated&&(!d.valid||!['primary','primary_corrected','combined'].every(k=>Number.isFinite(d[k]))||d.active&&!Number.isFinite(d.secondary))||d.valid&&d.axis_code!==d.source_code||d.input_qualified&&(!inputTime||!d.input_valid||!Number.isFinite(d.input_age_ms)||!range(Math.fround(d.input_age_ms),0,20)))throw Error('Invalid secondary evaluation state.');
 }
 function status(root,e){
  const hardware=root.querySelector('#switch-accessory-status'),s=e?.switch_accessory;
  if(hardware){
   const target=s?.source==='target_j4_i2c'&&e?.simulator===false,host=s?.source==='host_no_target_i2c'&&e?.simulator===true;
   const rows=target?[
    ['Phase / requested channels',s.phase+' / mask '+s.requested_mask],
    ['Current / last acquisition fault',s.fault+' / '+s.last_fault],
    ['Source sample',s.raw_known?(s.fresh?'fresh raw sample':'stale or invalid raw sample'):'unknown'],
    ['Acquisition / control qualification',s.ready?'readback accepted; check each rule below':'unavailable; Input rules inhibit control'],
    ['Observed / completed (GP us)',s.observed_us+' / '+s.read_completed_us],
    ['Fault awaiting control observation',s.fault_pending?'yes, ID '+s.fault_id:'no'],
    ['Reads / failures / consumed faults',s.reads+' / '+s.failures+' / '+s.consumed_faults],
    ['Last / maximum operation / budget (us)',s.last_duration_us+' / '+s.max_duration_us+' / '+s.budget_us],
    ['I²C ownership / SDK result',(s.bus_allocated?'allocated':'released')+' / '+s.sdk_error]
   ]:host?[['Hardware source','unknown; host does not measure J4'],['Host control inputs','synthetic stimuli only']]:[['Hardware source','unknown; acquisition diagnostics unavailable'],['Control source','unknown; inspect the control observation below']];
   hardware.innerHTML='<p class="hint">'+(target?'Target acquisition diagnostics. Digital readback is separate from electrical and physical qualification.':'No target hardware measurement.')+'</p>'+rows.map(([k,v])=>`<div class="keyline"><span>${esc(k)}</span><strong>${esc(v)}</strong></div>`).join('');
  }
  const pane=root.querySelector('#secondary-observation');if(!pane)return;const all=e?.secondary_tables;if(!all){pane.textContent='No secondary-table observation.';return;}const number=v=>Number.isFinite(v)?v.toFixed(4):'unknown';pane.innerHTML='<p class="hint">Control observation, separate from editor values. '+(e.simulator?'SYNTHETIC control observation':'Target proposal')+'. Check source and sample age.</p>'+kinds.map(kind=>{const d=all[kind];if(!d?.available)return `<p>${kind}: no observation</p>`;return `<h3>Secondary ${kind}</h3>`+[['Selection',d.reason+(d.pending?' / transition pending':'')],['Source and stored cells',d.source+' / '+d.cells+' ('+d.cell_unit+')'],['Primary / secondary / combined',number(d.primary)+' / '+number(d.secondary)+' / '+number(d.combined)],['Coordinate ('+d.coordinate_unit+')',number(d.coordinate)],['Condition',d.condition+' '+number(d.condition_value)+' > '+number(d.threshold)],['Input source',d.input_source],['Raw / qualified level',(d.input_valid?String(d.input_raw):'unknown')+' / '+(d.input_qualified?String(d.input_level):'unknown')],['Input age / observed time',number(d.input_age_ms)+' ms / '+(d.input_observed_us??'unknown')],['Evaluation',d.evaluated?'computed'+(d.clamped?' / clamped':''):'not computed']].map(([key,value])=>`<div class="keyline"><span>${esc(key)}</span><strong>${esc(value)}</strong></div>`).join('');}).join('');}
 return {defaults,basis,cellUnit,cellLimits,constants,enumText,parseEnum,validateTune,validate,attach,status,checkObservation,enums:m.enums,values:m.values,valueLabels:m.valueLabels,boolFields:m.boolFields};
})();
)ECU_ASSET";
inline constexpr char flex_js[]=R"ECU_ASSET(// Generated by scripts/generate_flex_ui.py
window.EcuFlexMetadata={"defaults":{"input_confirmed":false,"capture":{"low_hz":50,"high_hz":150,"fault_hz":170,"tolerance_hz":1,"stale_ms":250,"filter_ms":0,"cycles":8},"correction":{"enabled":false,"temperature_enabled":false,"ethanol_bins":[0,20,40,60,80,100],"fuel_pct":[100,100,100,100,100,100],"spark_deg":[0,0,0,0,0,0],"temperature_c":[-40,0,20,40,80,125],"temperature_pct":[100,100,100,100,100,100]}},"captureFloats":["low_hz","high_hz","fault_hz","tolerance_hz","stale_ms","filter_ms"],"arrays":["ethanol_bins","fuel_pct","spark_deg","temperature_c","temperature_pct"],"booleans":["enabled","temperature_enabled","input_confirmed"],"limits":{"low_hz":[10,180],"high_hz":[20,200],"fault_hz":[25,500],"tolerance_hz":[0,2],"stale_ms":[250,2000],"filter_ms":[0,5000],"cycles":[2,32],"ethanol_bins":[0,100],"fuel_pct":[0,255],"spark_deg":[-40,40],"temperature_c":[-40,125],"temperature_pct":[0,255]},"labels":{"enabled":"Apply flex fuel and spark corrections","temperature_enabled":"Apply fuel-temperature correction","input_confirmed":"Protected GPIO38 wiring and reset behavior checked","low_hz":"E0 frequency","high_hz":"E100 frequency","fault_hz":"Sensor fault threshold","tolerance_hz":"Frequency tolerance","stale_ms":"Completed sample expiry","filter_ms":"Measurement filter time constant","cycles":"Complete cycles per window","ethanol_bins":"Ethanol bins","fuel_pct":"Fuel correction","spark_deg":"Spark addition","temperature_c":"Fuel-temperature bins","temperature_pct":"Fuel-temperature correction"},"units":{"low_hz":"Hz","high_hz":"Hz","fault_hz":"Hz","tolerance_hz":"Hz","stale_ms":"ms","filter_ms":"ms","cycles":"cycles","ethanol_bins":"% ethanol","fuel_pct":"%","spark_deg":"deg delta","temperature_c":"C","temperature_pct":"%"},"values":["frequency_hz","low_pulse_us","ethanol_pct","fuel_temp_c","unfiltered_ethanol_pct","unfiltered_fuel_temp_c","sample_age_ms","fuel_pct","spark_add_deg","temperature_pct"],"flags":["required","configuration_match","value_qualified","raw_capture_qualified","control_ok","capture_valid","sample_value_valid","pending_fault","frequency_clamped","temperature_clamped","input_confirmed","corrections_enabled","corrections_valid","spark_bypassed","spark_clamped","zero_factor","available"],"codes":["source_code","reason_code","capture_reason_code","last_fault_code","correction_reason_code","window_cycles","configuration_revision"],"times":["sample_us","window_start_us","last_edge_us","raw_edges","fault_generation","acknowledged_generation","config_epoch"],"sources":["unavailable","target_capture","synthetic_edges","synthetic_value"],"reasons":["disabled","acquiring","ready","invalid_configuration","unavailable","repeated_level","time_reversed","edge_gap","short_edge_interval","frequency_out_of_range","sensor_fault_frequency","low_pulse_width_out_of_range","capture_overflow","stale","future_edge","source_changed","configuration_changed","capture_configuration_mismatch","protected_input_unconfirmed","malformed_capture_sample","raw_capture_required","synthetic_value_only","capture_clock_fault"],"logFields":[["FlexFrequencyHz","Hz","frequency_hz"],["FlexLowPulseUs","us","low_pulse_us"],["FlexEthanolPct","% ethanol","ethanol_pct"],["FlexFuelTempC","C","fuel_temp_c"],["FlexUnfilteredEthanolPct","% ethanol","unfiltered_ethanol_pct"],["FlexUnfilteredFuelTempC","C","unfiltered_fuel_temp_c"],["FlexSampleAgeMs","ms","sample_age_ms"],["FlexFuelPct","%","fuel_pct"],["FlexSparkAddDeg","deg delta","spark_add_deg"],["FlexTemperaturePct","%","temperature_pct"],["FlexSourceCode","code","source_code"],["FlexReasonCode","code","reason_code"],["FlexCaptureReasonCode","code","capture_reason_code"],["FlexLastFaultCode","code","last_fault_code"],["FlexCorrectionReasonCode","code","correction_reason_code"],["FlexWindowCycles","code","window_cycles"],["FlexConfigurationRevision","code","configuration_revision"],["FlexSampleUs","us","sample_us"],["FlexWindowStartUs","us","window_start_us"],["FlexLastEdgeUs","us","last_edge_us"],["FlexRawEdges","count","raw_edges"],["FlexFaultGeneration","count","fault_generation"],["FlexAcknowledgedGeneration","count","acknowledged_generation"],["FlexConfigEpoch","count","config_epoch"],["FlexRequired","bool","required"],["FlexConfigurationMatch","bool","configuration_match"],["FlexValueQualified","bool","value_qualified"],["FlexRawCaptureQualified","bool","raw_capture_qualified"],["FlexControlOk","bool","control_ok"],["FlexCaptureValid","bool","capture_valid"],["FlexSampleValueValid","bool","sample_value_valid"],["FlexPendingFault","bool","pending_fault"],["FlexFrequencyClamped","bool","frequency_clamped"],["FlexTemperatureClamped","bool","temperature_clamped"],["FlexInputConfirmed","bool","input_confirmed"],["FlexCorrectionsEnabled","bool","corrections_enabled"],["FlexCorrectionsValid","bool","corrections_valid"],["FlexSparkBypassed","bool","spark_bypassed"],["FlexSparkClamped","bool","spark_clamped"],["FlexZeroFactor","bool","zero_factor"],["FlexAvailable","bool","available"]]};
'use strict';
window.EcuFlexFuel=(()=>{
 const m=window.EcuFlexMetadata,esc=v=>String(v??'').replace(/[&<>"']/g,c=>({'&':'&amp;','<':'&lt;','>':'&gt;','"':'&quot;',"'":'&#39;'}[c]));
 const defaults=()=>structuredClone(m.defaults),group=k=>k==='input_confirmed'?null:m.captureFloats.includes(k)||k==='cycles'?'capture':'correction';
 const get=(c,k)=>group(k)?c[group(k)][k]:c[k],set=(c,k,v)=>{if(group(k))c[group(k)][k]=v;else c[k]=v;};
 const range=(v,a,b)=>typeof v==='number'&&Number.isFinite(v)&&v>=a&&v<=b;
 function validateTune(t){
  const c=t.flex_fuel;if(!c||m.booleans.some(k=>typeof get(c,k)!=='boolean'))throw Error('Invalid flex flags.');
  if(c.correction.temperature_enabled&&!c.correction.enabled)throw Error('Fuel-temperature correction requires flex corrections enabled.');
  for(const k of [...m.captureFloats,'cycles']){if(typeof get(c,k)!=='number')throw Error('Flex calibration requires numeric values.');const v=Math.fround(get(c,k));if(!range(v,...m.limits[k])||k==='cycles'&&!Number.isInteger(get(c,k)))throw Error('Flex '+m.labels[k]+': value outside bounds.');}
  const cap=c.capture;if(Math.fround(cap.high_hz)<Math.fround(cap.low_hz)+10||Math.fround(cap.fault_hz)<Math.fround(cap.high_hz)+5||Math.fround(cap.stale_ms)<2000/(Math.fround(cap.low_hz)-Math.fround(cap.tolerance_hz)))throw Error('Flex frequency endpoints, fault threshold or expiry are inconsistent.');
  for(const k of m.arrays){const a=get(c,k);if(!Array.isArray(a)||a.length!==6||a.some(v=>typeof v!=='number'||!range(Math.fround(v),...m.limits[k]))||['ethanol_bins','temperature_c'].includes(k)&&a.some((v,n)=>n&&Math.fround(v)<=Math.fround(a[n-1])))throw Error('Flex '+m.labels[k]+': six bounded values and increasing bins are required.');}
  if(Math.fround(c.correction.ethanol_bins[0])!==0||Math.fround(c.correction.ethanol_bins[5])!==100||Math.fround(c.correction.temperature_c[0])!==-40||Math.fround(c.correction.temperature_c[5])!==125)throw Error('Flex curve endpoints must cover E0..E100 and -40..125 C.');
 }
 function constants(t){return [...m.booleans,...m.captureFloats,'cycles',...m.arrays].map(k=>({page:0,name:'flex_'+k,value:get(t.flex_fuel,k),flexKey:k,flag:m.booleans.includes(k),unit:m.units[k]||''}));}
 function apply(t,item,v){set(t.flex_fuel,item.flexKey,v);}
 function attach(root,t,changed){
  const c=t.flex_fuel;
  const control=k=>`<div class="field"><label for="flex-${k}">${esc(m.labels[k])}${m.units[k]?' ('+esc(m.units[k])+')':''}</label><input id="flex-${k}" data-flex="${k}" type="${m.booleans.includes(k)?'checkbox':'number'}" ${m.booleans.includes(k)?(get(c,k)?'checked':''):`step="${k==='cycles'?1:'any'}" min="${m.limits[k][0]}" max="${m.limits[k][1]}" value="${get(c,k)}"`}></div>`;
  root.innerHTML=`<section class="panel"><div class="panelhead"><h2>Flex fuel and fuel temperature</h2><span class="tag">DEVELOPMENT</span></div><div class="panelbody"><p class="hint">A frequency and low-pulse-width sensor supplies ethanol percentage and fuel temperature. Enabled corrections or an ethanol table switch require a qualified sample. Missing, stale or faulty data inhibits fuel and spark proposals.</p><p class="warn">The current carrier has no released flex input. Protected wiring, reset behavior and physical capture still need bench qualification. Checking the confirmation below records a configuration decision; it does not establish hardware qualification.</p><div class="formgrid">${m.booleans.map(control).join('')}</div><details><summary>Sensor calibration and acquisition</summary><div class="formgrid">${[...m.captureFloats,'cycles'].map(control).join('')}</div><p class="hint">Default frequency: E0 at 50 Hz, E100 at 150 Hz; fault at 170 Hz. Temperature uses low pulses of 1..5 ms for -40..125 C. Expiry applies to the original completed capture window. Smoothing does not refresh its timestamp.</p></details><div class="tablewrap"><table><caption>Ethanol correction curves</caption><tbody>${['ethanol_bins','fuel_pct','spark_deg'].map(k=>`<tr><th>${esc(m.labels[k])} (${esc(m.units[k])})</th>${get(c,k).map((v,n)=>`<td><input aria-label="Flex ${esc(m.labels[k])} ${n+1}" data-flex-array="${k}" data-index="${n}" type="number" step="any" value="${v}" style="width:76px"></td>`).join('')}</tr>`).join('')}</tbody></table></div><div class="tablewrap"><table><caption>Fuel-temperature correction curve</caption><tbody>${['temperature_c','temperature_pct'].map(k=>`<tr><th>${esc(m.labels[k])} (${esc(m.units[k])})</th>${get(c,k).map((v,n)=>`<td><input aria-label="Flex ${esc(m.labels[k])} ${n+1}" data-flex-array="${k}" data-index="${n}" type="number" step="any" value="${v}" style="width:76px"></td>`).join('')}</tr>`).join('')}</tbody></table></div><p class="hint">100% fuel and temperature factors are neutral; 0 degrees is neutral spark addition. These are illustrative curves. Factors apply before the acceleration reference adder. A zero factor suppresses all fuel, including opening deadtime. Cranking uses its fixed spark angle.</p><div id="flex-observation"><p class="hint">No flex observation.</p></div></div></section>`;
  for(const i of root.querySelectorAll('[data-flex],[data-flex-array]'))i.onchange=()=>{const v=i.type==='checkbox'?i.checked:i.value.trim()?Number(i.value):NaN;if(i.dataset.flex)set(c,i.dataset.flex,v);else get(c,i.dataset.flexArray)[Number(i.dataset.index)]=v;changed();};
 }
 function validate(root,t){for(const i of root.querySelectorAll('input[type=number]'))if(!i.value.trim()||!Number.isFinite(Number(i.value)))throw Error('Flex calibration requires a finite value in every field.');validateTune(t);}
 function checkObservation(d,present=true){
  const integer=(v,max)=>Number.isSafeInteger(v)&&v>=0&&v<=max;
  const names=['source','reason','capture_reason','last_fault','correction_reason'],allowed=[...names,...m.values,...m.flags,...m.codes,...m.times,'capture_calibration'];
  if(d&&Object.hasOwn(d,'read_age_ms'))allowed.push('read_age_ms');
  if(!d||typeof d!=='object'||Array.isArray(d)||Object.keys(d).sort().join('|')!==allowed.sort().join('|')||m.flags.some(k=>typeof d[k]!=='boolean')||d.available&&!present)throw Error('Invalid flex observation fields.');
  for(const key of names){const values=key==='source'?m.sources:m.reasons;if(!integer(d[key+'_code'],values.length-1)||d[key]!==values[d[key+'_code']])throw Error('Invalid flex diagnostic code.');}
  if(!integer(d.window_cycles,32)||!integer(d.configuration_revision,4294967295)||m.values.some(k=>d[k]!==null&&(!Number.isFinite(d[k])||Math.abs(d[k])>3.4028234663852886e38)))throw Error('Invalid flex diagnostic value.');
  for(const k of m.times)if(typeof d[k]!=='string'||!/^(0|[1-9][0-9]{0,19})$/.test(d[k])||BigInt(d[k])>18446744073709551615n)throw Error('Invalid flex timestamp or counter.');
  const c=d.capture_calibration;if(!c||Object.keys(c).sort().join('|')!==[...m.captureFloats,'cycles'].sort().join('|')||m.captureFloats.some(k=>!Number.isFinite(c[k]))||!integer(c.cycles,32))throw Error('Invalid flex capture calibration.');
  if(d.available)validateTune({flex_fuel:{input_confirmed:false,capture:c,correction:structuredClone(m.defaults.correction)}});
  if(d.read_age_ms!==undefined&&d.read_age_ms!==null&&(!Number.isInteger(d.read_age_ms)||!range(d.read_age_ms,0,4294967294)))throw Error('Invalid flex read age.');
  if(d.required&&d.control_ok&&(!d.value_qualified||d.corrections_enabled&&!d.corrections_valid))throw Error('Invalid flex control qualification.');
  if(d.capture_valid&&(!d.sample_value_valid||![1,2].includes(d.source_code))||d.raw_capture_qualified&&(!d.capture_valid||!d.value_qualified||!d.configuration_match||d.pending_fault||d.reason_code!==2)||d.value_qualified&&(!d.sample_value_valid||!range(d.ethanol_pct,0,100))||d.required&&!d.control_ok&&d.corrections_enabled&&d.corrections_valid||d.corrections_enabled&&d.corrections_valid&&!d.raw_capture_qualified)throw Error('Inconsistent flex qualification.');
  if(d.corrections_valid&&(!range(d.fuel_pct,0,255)||!range(d.spark_add_deg,-40,40)||!range(d.temperature_pct,0,255))||d.zero_factor!==Boolean(d.corrections_enabled&&d.corrections_valid&&(d.fuel_pct===0||d.temperature_pct===0)))throw Error('Invalid flex correction factors.');
  if(d.value_qualified&&(!d.configuration_match||d.pending_fault||d.fault_generation!==d.acknowledged_generation||d.config_epoch==='0'||!d.configuration_revision)||d.raw_capture_qualified&&(d.capture_reason_code!==2||d.window_cycles!==c.cycles||BigInt(d.window_start_us)>=BigInt(d.sample_us)||BigInt(d.sample_us)>BigInt(d.last_edge_us)||!range(d.frequency_hz,1,500)||!range(d.low_pulse_us,998,5002)||!range(d.fuel_temp_c,-40,125)))throw Error('Invalid flex sample qualification.');
  if(!d.available&&(m.flags.some(k=>d[k])||m.codes.some(k=>d[k])||m.times.some(k=>d[k]!=='0')||m.values.some(k=>d[k]!==null)||Object.values(c).some(v=>v!==0)))throw Error('Unavailable flex observation is not canonical.');
  if(d.corrections_enabled&&!d.required||d.value_qualified&&(d.source_code===0||d.source_code===1&&!d.input_confirmed)||d.raw_capture_qualified!==Boolean(d.value_qualified&&[1,2].includes(d.source_code))||d.source_code===3&&d.value_qualified&&(d.reason_code!==21||d.capture_reason_code!==4))throw Error('Inconsistent flex source and quality flags.');
  if(d.source_code===3&&(d.capture_valid||d.raw_capture_qualified||d.window_cycles||['frequency_hz','low_pulse_us','fuel_temp_c','unfiltered_ethanol_pct','unfiltered_fuel_temp_c'].some(k=>d[k]!==null)))throw Error('Synthetic scalar is not a raw flex capture.');
 }
 function logValues(s){const d=s.flex_fuel,known=d?.available;return m.logFields.map(([,unit,k])=>known?(unit==='bool'?(d[k]?1:0):m.values.includes(k)?Number.isFinite(d[k])?Number(Math.fround(d[k]).toPrecision(9)):'NaN':d[k]??'NaN'):unit==='bool'||unit==='code'?0:'NaN');}
 function captureText(d,simulator){
  if(simulator!==false)return 'Host simulator: no target GPIO38 capture is measured.';
  if(!d)return 'Target capture diagnostics unavailable.';
  const unknown='Target capture diagnostics are unknown or inconsistent.';
  const flags=['built','available','both_edges','has_hardware_fifo','required','confirmed','binding','active','armed','pending_fault','terminal','retry_holdoff'];
  const times=['query_us','context','fault_generation','acknowledged_generation','armed_after_us','last_observed_us','last_suppression_us','rejected_publications','rejected_acks','acks','minimum_command_publication'];
  const u64=v=>typeof v==='string'&&/^(0|[1-9][0-9]{0,19})$/.test(v)&&BigInt(v)<=18446744073709551615n;
  const uint=(v,max)=>Number.isSafeInteger(v)&&v>=0&&v<=max;
  if(d.schema_version!==1||flags.some(k=>typeof d[k]!=='boolean')||times.some(k=>!u64(d[k]))||d.gpio!==38||d.capture_group!==0||d.capture_channel!==2||!d.both_edges||d.has_hardware_fifo||!uint(d.clock_uncertainty_us,6)||!uint(d.queued,64)||d.queue_capacity!==64||!uint(d.external_epoch,4294967295)||!uint(d.requested_tune_revision,4294967295)||!uint(d.requested_sensor_revision,4294967295)||typeof d.driver_error!=='string'||typeof d.last_fault!=='string'||!['none','clock','queue_overflow','repeated_level','short_interval','callback_rate','context_changed','invalid_context','sequence_exhausted'].includes(d.last_fault))return unknown;
  if(d.data_source!==(d.built?'target_mcpwm_flex':'target_capture_not_built')||d.available&&(!d.built||d.driver_error!=='ESP_OK')||d.active&&(!d.available||!d.binding||!d.required||!d.confirmed)||d.armed&&(!d.active||d.pending_fault||d.terminal)||BigInt(d.acknowledged_generation)>BigInt(d.fault_generation))return unknown;
  const p=d.publication;
  if(!p||['present','current','qualified','ack_eligible','sample_valid','pending_fault'].some(k=>typeof p[k]!=='boolean')||['sequence','context','ingress_generation','capture_generation','acknowledged_generation','armed_after_us','published_us','sample_us','valid_until_us'].some(k=>!u64(p[k]))||!['unavailable','target_capture'].includes(p.source)||!uint(p.producer_tune_revision,4294967295)||!m.reasons.includes(p.reason)||!m.reasons.includes(p.capture_reason))return unknown;
  if(p.current&&!p.present||p.qualified&&(!p.current||p.source!=='target_capture')||p.ack_eligible&&(!p.current||p.qualified))return unknown;
  if(!d.built)return 'This firmware profile has no target flex capture. Required flex data inhibits control.';
  if(!d.available)return 'GPIO38 capture unavailable: '+d.driver_error+'. Required flex data inhibits control.';
  if(!d.required)return 'GPIO38 capture disabled because the tune has no required flex input. Pending notifications are retained.';
  if(p.qualified){
   try{validateTune({flex_fuel:{input_confirmed:false,capture:p.producer_calibration,correction:structuredClone(m.defaults.correction)}});}catch{return unknown;}
   if([...m.captureFloats,'cycles'].some(k=>p.producer_calibration[k]!==d.requested_calibration?.[k]))return unknown;
   if(BigInt(p.sequence)<BigInt(d.minimum_command_publication)||p.reason!=='ready'||p.capture_reason!=='ready'||!p.sample_valid||p.pending_fault||p.capture_generation!==p.acknowledged_generation||d.fault_generation!==d.acknowledged_generation||d.context==='0'||!d.requested_tune_revision||!d.requested_sensor_revision||!d.clock_uncertainty_us||!d.armed||!d.confirmed||d.pending_fault||d.terminal||p.sequence==='0'||p.context!==d.context||p.ingress_generation!==d.fault_generation||p.armed_after_us!==d.armed_after_us||p.producer_tune_revision!==d.requested_tune_revision||BigInt(p.sample_us)<=BigInt(d.armed_after_us)||BigInt(p.sample_us)>BigInt(p.published_us)||BigInt(p.published_us)>BigInt(d.query_us)||BigInt(d.query_us)>BigInt(p.valid_until_us)||BigInt(p.valid_until_us)-BigInt(p.sample_us)!==BigInt(Math.round(p.producer_calibration.stale_ms*1000)))return unknown;
   if(BigInt(d.query_us)-BigInt(p.published_us)>50000n)return 'GPIO38 capture publication is stale. Current control qualification is unknown.';
   return 'GPIO38 raw capture publication is current. Sample '+p.sample_us+' us; expires '+p.valid_until_us+' us. Physical timing and input circuitry remain unqualified.';
  }
  return 'GPIO38 capture unqualified: '+(!d.confirmed?'protected input unconfirmed':d.pending_fault?'pending '+d.last_fault:p.pending_fault?'pending '+p.reason:d.armed?'acquiring complete windows':'disarmed or waiting for recovery')+'. Queue '+d.queued+'/64. Required flex data inhibits control.';
 }
 function offline(root){const p=root?.querySelector('#flex-capture');if(p)p.textContent='Target capture status offline; current qualification is unknown.';const o=root?.querySelector('#flex-observation');if(o)o.textContent='Flex diagnostics offline.';}
 function status(root,e){let capture=root.querySelector('#flex-capture');if(!capture){const host=root.querySelector('#flex-observation');if(host){capture=document.createElement('div');capture.id='flex-capture';capture.className='hint';host.before(capture);}}if(capture){capture.textContent=captureText(e?.flex_capture,e?.simulator);if(e?.flex_capture){const details=document.createElement('details'),summary=document.createElement('summary'),pre=document.createElement('pre');summary.textContent='Capture counters, context and producer provenance';pre.style.cssText='white-space:pre-wrap;overflow-wrap:anywhere;font-size:11px';pre.textContent=JSON.stringify(e.flex_capture,null,2);details.append(summary,pre);capture.append(details);}}const pane=root.querySelector('#flex-observation');if(!pane)return;const d=e?.flex_fuel;if(!d?.available){pane.textContent='No completed flex evaluation.';return;}const number=v=>Number.isFinite(v)?v.toFixed(3):'unknown';
  pane.innerHTML='<h3>Flex control observation</h3><p class="hint">'+esc(d.source)+(e.simulator?' / completed synthetic run':' / target proposal')+'</p>'+[
   ['Qualification',d.raw_capture_qualified?'raw capture qualified':d.value_qualified?'synthetic percentage only':'unqualified'],['Reason / capture / last fault',d.reason+' / '+d.capture_reason+' / '+d.last_fault],['Required / control allowed',String(d.required)+' / '+String(d.control_ok)],['Frequency / low pulse',number(d.frequency_hz)+' Hz / '+number(d.low_pulse_us)+' us'],['Ethanol / fuel temperature',number(d.ethanol_pct)+'% / '+number(d.fuel_temp_c)+' C'],['Fuel / temperature / spark',number(d.fuel_pct)+'% / '+number(d.temperature_pct)+'% / '+number(d.spark_add_deg)+' deg'],['Control sample age',number(d.sample_age_ms)+' ms'],['Sample / last edge (us)',d.sample_us+' / '+d.last_edge_us],['Fault pending / generation',String(d.pending_fault)+' / '+d.fault_generation],['Spark / fuel state',(d.spark_bypassed?'cranking spark bypass':d.spark_clamped?'spark clamped':'spark correction path')+(d.zero_factor?' / zero fuel factor':'')]
  ].map(([k,v])=>`<div class="keyline"><span>${esc(k)}</span><strong>${esc(v)}</strong></div>`).join('');
 }
 return {defaults,constants,apply,attach,validate,validateTune,checkObservation,captureText,offline,status,logValues,logFields:m.logFields};
})();
)ECU_ASSET";
inline constexpr char tuning_js[]=R"ECU_ASSET(/* Read-only tuning transport observations. USB bus presence is not an app link. */
'use strict';
window.EcuTuningDiagnostics=(()=>{
 let generation=0,timer;
 const esc=value=>String(value??'unknown').replace(/[&<>"']/g,c=>({'&':'&amp;','<':'&lt;','>':'&gt;','"':'&quot;',"'":'&#39;'}[c]));
 function rows(entries){return entries.map(([label,value])=>`<div class="keyline"><span>${esc(label)}</span><strong>${esc(value)}</strong></div>`).join('');}
 function render(data){
  const s=data.session,w=data.wire;
  const entries=[['Transport',data.transport],['Controller identity',data.identity],['Serial protocol',data.serial_protocol],['Service available',data.available?'yes':'no'],['Status',data.reason],['USB bus present',data.host_present===null?'not measured':data.host_present?'yes':'no'],['RX driver drops',data.driver_rx_drop_count??'unknown']];
  if(s)entries.push(['Write state',s.state],['Staged edits',s.dirty?'yes':'no'],['Session origin revision',s.origin_revision],['Expected backend revision',s.base_revision],['Observed active revision',s.observed_active_revision||'unavailable'],['Last command code','0x'+Number(s.last_code).toString(16).padStart(2,'0')],['Successful whole-tune burns',s.burns],['Rejected commands',s.rejected]);
  if(w)entries.push(['CRC errors',w.crc_errors],['Partial-frame timeouts',w.timeouts],['Framing errors',w.framing_errors],['Reply queue failures',w.tx_errors]);
  if(data.session_count!==undefined)entries.push(['Host development sessions',data.session_count]);
  return rows(entries)+`<p class="hint">${esc(data.host_presence_meaning)}</p><p class="hint">${esc(data.commit_behavior)}</p><p class="warn">${esc(data.application_support)}</p><p class="hint">${esc(data.qualification)}</p>`;
 }
 function attach(root,{api,file,toast}){
  const mine=++generation;clearTimeout(timer);let latest;
  root.innerHTML='<section class="panel" style="margin-top:20px"><div class="panelhead"><h2>Tuning connection</h2><button id="engine-tuning-export" class="small ghost">Export diagnostics</button></div><div id="engine-tuning-status" class="panelbody"><p class="hint">Loading tuning diagnostics.</p></div></section>';
  root.querySelector('button').onclick=()=>{if(latest)file('ecu-tuning-diagnostics.json',JSON.stringify(latest,null,2)+'\n','application/json');else toast('No tuning observation yet.',true);};
  async function poll(){
   if(mine!==generation||!root.isConnected)return;
   try{const data=await api('/api/engine/tuning');if(mine!==generation||!root.isConnected)return;latest=data;root.querySelector('#engine-tuning-status').innerHTML=render(data);}
   catch(error){if(mine===generation&&root.isConnected)root.querySelector('#engine-tuning-status').textContent='Tuning diagnostics unavailable: '+error.message;}
   finally{if(mine===generation&&root.isConnected)timer=setTimeout(poll,1000);}
  }
  poll();
 }
 return {attach};
})();
)ECU_ASSET";
inline constexpr char manual[]=R"ECU_ASSET({"revision":"A3-120","pdf_filename":"esp32-ecu-a3-build-calibration-debug-manual.pdf","pages":[{"page":1,"title":"Connect. Measure. Calibrate.","text":"ESP32-S3 / A3-120 / BUILD & SERVICE MANUAL\nConnect. Measure. Calibrate.\nSensor installation, connection diagnosis and ECU Studio configuration\n120 × 120 mm through-hole carrier • Plug-in ESP32-S3 DevKitC-1 • Revision A3-120 / 30 October 2026\nEngineering prototype and bench monitor. All actuator commands remain OFF. This package does not implement a\ncomplete replacement engine ECU and has not been tested on a car. CAD checks and software tests do not establish\nsurge immunity, EMC, splash resistance, emissions compliance or mechanical fit.\nRead in this order\n01\nIdentify the board revision, connector orientation and power arrangement.\n02\nAssemble and test the unpowered board, then qualify the power rails on a current-limited bench supply.\n03\nUse the individual sensor chapters and identical web guides. Enter the real sensor curves, then verify independent\nreference points.\n04\nFit the insulating tray, shield bonds and splash gasket. Check the printed fit and controlled splash resistance before\nchoosing any installation location."},{"page":2,"title":"What this design supports","text":"01 / SCOPE\nWhat this design supports\n Implemented\nOutside this release\nSix conditioned 0-5 V analog inputs, 12-bit SPI ADC, diagnostic\nconversion and filtering.\nFuel/ignition scheduling, fuel maps, tune commissioning, knock\ncontrol and engine operation.\nTwo conditioned 5 V Hall inputs, missing-tooth crank bench\ndecoder and cam edge counts.\nRaw VR sensors, full 720° phase decoding, every OEM trigger\npattern.\n500 kbit/s listen-only CAN frame counts.\nOEM CAN messages, dashboard, immobilizer, automatic\ntransmission or air-conditioning integration.\nExternal wideband-controller analog input and buffered\npost-catalyst measurement.\nRaw wideband drive/heater control, catalyst efficiency diagnostics\nand OBD emissions readiness.\nDesign provisions for surge clamping, reverse polarity, filtering,\nground plane and shield return.\nVerified ISO automotive transient/EMC qualification or universal\ncompatibility.\nUniversal carrier, vehicle-specific interface\n01\nThere is no universal OEM ECU connector or sensor pinout. Use a documented adapter harness with verified cavity\nnumbers for the specific vehicle.\n02\nA naturally aspirated engine with a catalytic converter can still require electronic throttle, immobilizer and network\nfunctions absent here. Keep the original ECU in service until an actual replacement system is separately engineered\nand qualified.\n03\nDo not share sensor signals with another ECU until input loading, grounding and failure behavior have been\nreviewed. Do not remove or emulate catalyst monitoring.\nBasic bench kit\n01\nCurrent-limited regulated 12 V supply, suitable 1 A external fuse and an accessible disconnect.\n02\nDigital multimeter, magnifier, soldering iron and appropriate leaded soldering tools. Use a properly referenced or\nisolated oscilloscope for digital edges and noise.\n03\n3.3 V UART adapter; do not use 5 V TTL, RS-232 levels or an adapter power lead.\n04\nA trusted low-voltage signal/reference source and sensor-specific mechanical/reference tools. Never use a test lamp\non a signal input."},{"page":3,"title":"Build and inspect the carrier","text":"02 / BOARD ASSEMBLY\nBuild and inspect the carrier\n01\nUse hardware/a3-compact, not the larger A2 board. The copper outline is 120 × 120 mm, six copper layers, 1.6 mm\nnominal FR-4. Check the final ERC/DRC and audit reports before ordering.\n02\nAll carrier component joints are plated through-hole. Fit ordinary axial resistors upright on the indicated 2.54 mm\npitch; R150 stays horizontal. Observe the vertical diode polarity drawing, not just the direction of a bent lead.\n03\nFit low components first, then capacitors, direct-solder DIP ICs, TO-220 devices and connectors. IC sockets are not\nrequired. Leave DNP optional pull-ups absent unless the specific sensor needs them.\n04\nFit the two 1 × 22 female headers for the specified 44-pin ESP32-S3 DevKitC-1 v1.1. Use a known straight header\njig while soldering. Do not substitute a similar-looking 30/38-pin ESP32 or assume every S3 board has the same\nspacing.\n05\nU1 is a purchased assembled Pololu D36V6F5 module. U3 is a purchased DevKit. These modules contain small\nfactory-soldered parts; no bare S3 module or fine-pitch IC must be hand-soldered to the carrier.\n06\nCheck IC notches, electrolytic polarity, diode bands, transistor pin order and live TO-220 tabs against the BOM and\nfootprints. VNP35N07-E tabs are drain, not ground.\n07\nInspect every joint, bridge and solder splash. Trim solder tails to at most 3 mm below the PCB, especially around\nH4. The printed H4 support includes reliefs matching R35 and D210.\n08\nWith power disconnected, check for unintended rail shorts. Capacitors can make a continuity buzzer sound briefly;\ninvestigate sustained low resistance rather than relying on the buzzer alone.\nThe 120 mm layout is dense. A 3D model may omit an unavailable manufacturer model; the BOM, assembly drawing\nand native footprint pads define the build. DNP resistors are intentionally empty. Never infer that a pad is unused\nsimply because a 3D body is absent.\nEMI provisions are an assembly requirement\n01\nRetain the two continuous inner ground planes and the input filter/clamps. Keep sensor returns separate from the\nactuator power-return wiring.\n02\nUse twisted/shielded signal wiring as appropriate to the sensor. Keep it away from ignition coils, alternator wiring\nand relay/motor power.\n03\nFit the conductive enclosure lining and short internal shield bonds, then cover the lining with the supplied dielectric\ntray and lid insulator. A plastic box alone is not an RF shield."},{"page":4,"title":"Find the connector before wiring","text":"02A / PLACEMENT REFERENCE\nFind the connector before wiring\nConnector locations from the native PCB, viewed from the top. Filled dots identify pin 1. Dimensions in the table are measured from the\ntop-left PCB edge. The separate assembly.svg shows all component references and pads.\nPCB location (mm)\nConnection\nBottom row, left to right\nJ11 MAP / J12 TPS / J13 CLT / J14 IAT / J15 wideband / J16 buffered rear oxygen / J17\ncrank / J18 cam\nRight edge, top to bottom\nJ9 injector low sides / J10 smart-coil logic / J8 relay coils\nTop left / top right\nJ1 logic power / J19 power return\nLeft lower side\nJ7 CAN and H5 shield lug\nInside board\nJ2 UART at 61,58 / J3 interlock at 45,52.5 / J4 expansion at 57,73.5 / J20 shield at 98,97"},{"page":5,"title":"Check power before sensors","text":"03 / FIRST POWER\nCheck power before sensors\n01\nPin 1 is externally fused key-on 12 V; pin 2 is ground. Use the specified external 1 A source fuse.\n02\nFor first bench checks, unplug every sensor and actuator, keep J3 open, use a 12 V current-limited supply, and\ncheck polarity before enabling it.\n03\nMeasure TP2 VIN_PROT, TP3 5 V, TP4 3V3, then each sensor pin 2. TP2 is after the reverse diode and before the\ninput filter.\n04\nRepeated resets can be undervoltage/current limit, a short, wrong part orientation, regulator instability or watchdog\ntimeout. Disconnect external loads one at a time.\nPoint\nMeaning\nExpected bench observation\nTP1\nGND\nReference for board checks.\nTP2\nVIN_PROT\nInput after reverse diode, before input filter. At a 12 V source it is lower than the\nsource by the diode drop.\nTP3\n+5V\nNear nominal 5 V; verify under the intended sensor load.\nTP4\n+3V3\nNear nominal 3.3 V; measure U6 VREF accurately for calibration.\nTP5\nSAFE_N\nNear 3V3 when released; low during supervisor/watchdog reset.\nTP6\nRUN_5V\nLow with J3 open and configuration monitor firmware.\nIf a rail is wrong\n01\nDisconnect external harnesses and remove the DevKit, then locate the fault from the input toward the load. Check\npart value/orientation, the reverse diode and buck module pinout.\n02\nIf 5 V collapses only with a sensor plugged in, check its actual pin order and current draw. The sensor rail PTC is\nshared, slow and temperature-dependent, not a precision electronic current limiter.\n03\nIf 3V3 resets or overheats during Wi-Fi, inspect regulator dissipation, supply limits, capacitor/ESR requirements and\ncurrent peaks. Software compilation does not verify power integrity.\n04\nScope rails, SAFE_N and WDI together for repeating resets. Do not bypass the watchdog or supervisor. The\nmonitor must keep servicing supervision while the web service runs.\nJ1 powers the ECU logic. Injector, smart-coil and relay power is external, fused and relay-switched. Do not connect an\nengine or real actuator harness during these checks."},{"page":6,"title":"Open ECU Studio","text":"04 / WEB SERVICE\nOpen ECU Studio\n01\nFlash the compact_a3_web firmware using PlatformIO. Remove the DevKit from the carrier before powering its USB\nconnector. Disconnect USB before reseating it in the unpowered carrier.\n02\nKeep J3 open and actuator harnesses disconnected. Attach J2 UART using 3.3 V logic at 115200 baud, 8-N-1, with\nno adapter power wire.\n03\nPower the carrier on a dry bench with the lid open. The service starts its own WPA2 AP, ECU-Service-XXXX. A new\nrandom password is printed in the UART boot log.\n04\nJoin that AP and open http://192.168.4.1. No internet connection is needed. The AP is refused if J3 is closed at\nservice startup. The conductive lining may block radio reception with the lid closed.\n05\nFor a desktop preview, run python3 tools/web_server.py and open http://127.0.0.1:8765. The simulator is labelled\nNO HARDWARE and uses synthetic ADC values.\nScreenshot: the actual offline UI running against the host simulator. Example numbers shown are not a vehicle calibration.\nSave and preserve settings\n01\nExport a JSON backup before editing. Import stages a complete validated profile in the editor; it does not apply until\nsaved.\n02\nSave validates all channels and commits NVS before changing the live conversion. Check the saved revision and\nstatus message.\n03\nA stale revision is rejected instead of overwriting another session. Export edits, reload the latest profile and reapply\nthe intended change.\n04\nUnreadable or invalid saved storage activates defaults and blocks saving. Inspect UART and recover deliberately;\nfirmware does not erase NVS automatically."},{"page":7,"title":"Configure a measured transfer curve","text":"05 / CALIBRATION\nConfigure a measured transfer curve\n01\nVoltage mode shows the reconstructed connector voltage; it does not require a sensor transfer curve.\n02\nLinear mode uses two measured input voltages and two physical values. Set the actual units and validate a third\nreference point.\n03\nTable mode interpolates between 2-16 ascending voltage/value pairs. Values outside the table range are faults, not\nextrapolated measurements.\n04\nNTC beta mode is for CLT/IAT only and requires the physical pull-up. It uses the measured sensor supply and\ncompensates the 55 kohm divider load. A voltage table is preferable when the real curve is available.\n05\nFiltering is for readout smoothing, not a substitute for fixing wiring/noise. Electrical fault checks use the\ninstantaneous input.\n06\nA saved sensor profile changes diagnostic readout only. Engine scheduling, DBW, injector tuning, catalyst\ndiagnostics and OEM protocols are not implemented.\n07\nTrigger geometry is applied to the bench decoder when configuration is saved. Crank synchronization is 360\ndegrees only.\nA practical calibration sequence\n01\nChoose the sensor connector, verify supply/ground and compare displayed connector voltage with a trusted meter.\nCorrect wiring before changing a curve.\n02\nMeasure the actual ADC reference and enter it under Device & profile. A reference error changes every\nreconstructed voltage, including battery and sensor supply.\n03\nChoose voltage, two-point linear, voltage table or supported NTC beta. Enter physical units consistently. Use the\nreal manufacturer curve or independently measured references, never the illustrative simulator curve.\n04\nSet an input fault window appropriate to that specific sensor. The default window is a starting point, not a diagnosis\nof every open/short. A legitimate endpoint can be zero volts on some interfaces.\n05\nChoose only as much readout filtering as necessary. Inspect raw voltage and the oscilloscope signal while checking\nwiring noise.\n06\nSave, verify several independent points across the intended range and only then mark the calibration confirmed.\nRecord the sensor part number, curve source, pull-up and reference tools.\nMode\nFields and behavior\nVoltage\nReconstructs connector volts: ADC / 4095 × measured VREF / 0.6.\nLinear\nV0/Y0 and V1/Y1; ascending voltage endpoints. Physical values can increase or decrease. Outside the endpoints\nis a fault.\nTable\n2-16 ascending voltage/value pairs. Piecewise linear interpolation. No extrapolation beyond the table.\nNTC beta\nCLT/IAT only. R0, reference temperature, beta and actual physical pull-up. Uses measured sensor supply and 55\nkohm load compensation.\nFault/filter\nFault checks use instantaneous voltage. The display filter smooths readout, not engine control."},{"page":8,"title":"Sensor connector pin reference","text":"06 / ORIENTATION\nSensor connector pin reference\nJ11-J18 use the same PCB-side three-pin assignment. This does not establish the sensor-side wire colors or pin order.\nThe mating view may be mirrored.\nConnector\nSignal / channel\nPin 1\nPin 2\nPin 3\nJ11\nMAP / manifold pressure / ADC 0\nGND\nSENSOR_5V\nMAP\nJ12\nTPS / throttle position / ADC 1\nGND\nSENSOR_5V\nTPS\nJ13\nCoolant temperature / ADC 2\nGND\nSENSOR_5V\nCLT\nJ14\nIntake-air temperature / ADC 3\nGND\nSENSOR_5V\nIAT\nJ15\nWideband controller output / ADC 4\nGND\nSENSOR_5V\nLAMBDA_WB\nJ16\nBuffered post-catalyst signal / ADC 5\nGND\nSENSOR_5V\nPOSTCAT_BUF\nJ17\nCrank Hall / GPIO8\nGND\nSENSOR_5V\nCRANK_RAW\nJ18\nCam Hall / GPIO9\nGND\nSENSOR_5V\nCAM_RAW\nBefore connecting any sensor\n01\nBoard pin numbers refer to the PCB top view; pin 1 is the square pad. The mating plug view can be mirrored. Verify\nthe actual harness with continuity tests.\n02\nDisconnect power before resistance/continuity tests. Do not measure resistance on a live vehicle bus or use a\nmegohmmeter on electronics.\n03\nKeep J3 open and all actuator harnesses disconnected during sensor commissioning. This firmware keeps ARM off.\n04\nUse the actual sensor or controller manufacturer pinout, transfer curve, mounting torque and air gap. There is no\nuniversal vehicle-side pinout.\n05\nMeasure signal voltage against that sensor connector pin 1, not an arbitrary chassis bolt. Never use a test lamp on a\nsensor or MCU pin.\nPassive two-wire CLT/IAT NTCs use pins 1 and 3 only. Wideband-controller analog outputs use pins 1 and 3; pin 2\ndoes not power a heater/controller. Raw VR and raw LSU sensors are unsupported without the appropriate external\ninterface."},{"page":9,"title":"MAP / manifold pressure","text":"07.1 / J11\nMAP / manifold pressure\n PIN 1\nPIN 2\nPIN 3\n1 GND\n2 SENSOR_5V\n3 MAP\nMounting & routing\n01\nRetain the OEM pressure port or use a suitable sealed manifold-pressure takeoff after the throttle. Keep the hose\nshort and secure, and follow the sensor maker's fluid/orientation limits.\n02\nRoute away from hot exhaust and ignition wiring. Leak-check any added hose before running an engine.\nConnect & verify\n01\nConfirm the sensor uses 5 V and identify its actual supply, ground and signal wires from its datasheet.\n02\nWith power off, check each harness conductor end-to-end and for unintended shorts, with both ends unplugged.\n03\nPower the board, check pin 2 near 5 V, then connect the sensor and measure pin 3 versus pin 1.\n04\nUse a regulated hand vacuum/pressure source within the sensor rating, compare the web voltage with a meter, then\nenter the manufacturer transfer curve or measured reference points.\nExpected behavior\n01\nKey-on / engine-off pressure should agree with a trusted local absolute-pressure reference after calibration. It is not\nalways 100 kPa.\n02\nA steady applied pressure should produce a steady voltage and calibrated value.\nFault tracing\n01\nFlat near 0 V: inspect power, ground, signal short and sensor pin order.\n02\nFlat high: inspect a short to supply, wrong curve, or a saturated sensor.\n03\nPressure wrong but voltage agrees with the meter: check absolute versus gauge units, curve and pressure\nreference.\n04\nNoisy or slow: inspect hose leaks/restriction, ground offset, shield routing and configured filtering.\nR20 22k series, R21 33k to ground, C20 10nF; U6 channel 0."},{"page":10,"title":"TPS / throttle position","text":"07.2 / J12\nTPS / throttle position\n PIN 1\nPIN 2\nPIN 3\n1 GND\n2 SENSOR_5V\n3 TPS\nMounting & routing\n01\nUse the OEM TPS mounting and its correct shaft coupling. A single analog input does not replace an electronic\nthrottle system or its redundant safety channels.\n02\nTurn the throttle only with the vehicle made safe; do not force an electronic throttle plate or alter mechanical stops.\nConnect & verify\n01\nIdentify whether the TPS is a 3-wire potentiometer or another sensor. Do not connect throttle-motor wires to J12.\n02\nVerify pin 2 supply and pin 1 ground, then observe signal voltage while moving the permitted mechanism slowly.\n03\nRecord closed and fully open reference voltages, enter those as 0% and 100%, and mark calibration confirmed only\nafter checking the whole travel.\nExpected behavior\n01\nThe voltage should sweep smoothly without dropouts. Some sensors have a decreasing transfer curve; configure\nthe corresponding endpoint values.\nFault tracing\n01\nJumps at one position: inspect sensor track/coupling or a broken harness conductor.\n02\nDirection reversed: swap calibration endpoint values, not supply and ground wires.\n03\nDoes not reach 0%/100%: recheck mechanical travel and measured endpoints.\n04\nTwo TPS tracks or a throttle motor are present: this hardware does not implement OEM DBW control.\nR22 22k series, R23 33k to ground, C21 10nF; U6 channel 1."},{"page":11,"title":"Coolant temperature","text":"07.3 / J13\nCoolant temperature\n PIN 1\nPIN 2\nPIN 3\n1 GND\n2 SENSOR_5V\n3 CLT\nMounting & routing\n01\nUse the OEM coolant sensor and mounting boss, with the engine cold and cooling system depressurized. Follow the\nspecified seal and torque.\n02\nKeep the original vehicle sensor if required by other systems; verify loading before sharing any signal.\nConnect & verify\n01\nFor a passive two-wire NTC, use pins 1 and 3 only. Leave pin 2 empty in the mating housing.\n02\nFit R32 only if this is a passive NTC requiring the board pull-up. Check its actual resistance; the design value is 2.49\nkohm.\n03\nMeasure sensor resistance while disconnected and compare at known temperatures with its datasheet. Prefer\nseveral reference points.\n04\nEnter beta parameters or a voltage table. In NTC mode, confirm the physical pull-up is fitted; the UI cannot install a\nresistor.\nExpected behavior\n01\nA common NTC resistance falls as temperature rises, and its signal voltage falls with this pull-up topology.\n02\nThe conversion accounts for the board's 55 kohm divider load and measured sensor supply.\nFault tracing\n01\nNear 0 V: sensor/loom short to ground or very low resistance.\n02\nHigh signal / open-model fault: unplugged sensor, broken ground/signal or missing/wrong pull-up.\n03\nPlausible voltage but wrong temperature: wrong NTC curve, pull-up value, supply reading or units.\n04\nDo not assume a floating/unexcited input will read maximum voltage: R32 is DNP by default.\nR24 22k series, R25 33k to ground, C22 10nF; U6 channel 2.\nR32 is DNP by default. Fit it only after confirming the actual sensor topology and resistor value."},{"page":12,"title":"Intake-air temperature","text":"07.4 / J14\nIntake-air temperature\n PIN 1\nPIN 2\nPIN 3\n1 GND\n2 SENSOR_5V\n3 IAT\nMounting & routing\n01\nUse a suitable intake-air boss and the sensor maker's orientation. Avoid placing the sensing element against the\nintake wall or at an unrepresentative heat source.\n02\nFollow the original mechanical arrangement; secure any aftermarket sensor so it cannot enter the intake.\nConnect & verify\n01\nA passive two-wire NTC connects to pins 1 and 3; pin 2 remains empty.\n02\nR33 is the optional board pull-up, normally 2.49 kohm. Confirm it is physically fitted before using NTC conversion.\n03\nCompare disconnected resistance and stabilized readings with a reference thermometer at several temperatures.\nEnter the actual sensor curve.\nExpected behavior\n01\nAfter a long cold soak, intake and coolant temperature should be reasonably consistent with their actual\nsurroundings. Heat soak can produce real differences.\nFault tracing\n01\nUse the same open/short/pull-up checks as CLT, but inspect intake heat soak and airflow before blaming calibration.\n02\nFast spikes suggest intermittent wires or electrical interference. A slow heat-soak drift may be physical.\nR26 22k series, R27 33k to ground, C23 10nF; U6 channel 3.\nR33 is DNP by default. Fit it only after confirming the actual sensor topology and resistor value."},{"page":13,"title":"Wideband controller output","text":"07.5 / J15\nWideband controller output\n PIN 1\nPIN 2\nPIN 3\n1 GND\n2 SENSOR_5V\n3 LAMBDA_WB\nMounting & routing\n01\nInstall the exhaust sensor according to the sensor/controller maker's rules for bung angle, temperature and\ncondensation. The ECU board does not heat or drive a raw wideband sensor.\n02\nMount the external controller away from hot exhaust and splash paths; use its specified fused power and grounds.\nConnect & verify\n01\nConnect controller analog signal to pin 3 and its specified analog reference to pin 1.\n02\nLeave pin 2 unpopulated; the board sensor supply must not power the controller or heater.\n03\nEnter the controller's actual 0-5 V mapping and units. Lambda and AFR are not interchangeable without the correct\nfuel stoichiometry.\n04\nUse the controller's documented analog-output test mode or a known voltage source before interpreting exhaust\nreadings.\nExpected behavior\n01\nWeb voltage and a meter should agree; converted lambda should agree with the controller when both use the same\nmapping and ground reference.\nFault tracing\n01\nController display correct but ECU wrong: inspect mapping, analog-reference offset and output mode.\n02\nFixed fault voltage: read the external controller's error codes before treating it as mixture.\n03\nNo output until heated: verify controller state and heater supply.\n04\nA raw LSU sensor cannot be connected directly; do not invent a direct 5-wire/6-wire pin mapping.\nR28 22k series, R29 33k to ground, C24 10nF; U6 channel 4."},{"page":14,"title":"Buffered post-catalyst signal","text":"07.6 / J16\nBuffered post-catalyst signal\n PIN 1\nPIN 2\nPIN 3\n1 GND\n2 SENSOR_5V\n3 POSTCAT_BUF\nMounting & routing\n01\nRetain the catalyst and rear oxygen sensor in their proper locations. This input is for measurement, not catalyst\nemulation or bypass.\n02\nUse a suitable external high-input-impedance conditioner/buffer where needed. The board input presents about 55\nkohm to the sensor signal.\nConnect & verify\n01\nConnect only the buffer's conditioned 0-5 V output to pin 3 and its analog reference to pin 1. Leave pin 2 empty\nunless the buffer specifically permits this supply within the shared current budget.\n02\nDo not connect heater wires, a raw wideband sensor, or assume every raw narrowband output can tolerate this\nload.\n03\nCompare the buffer output with a meter; enter its transfer curve or retain voltage display.\nExpected behavior\n01\nVoltage is the directly supported diagnostic. This firmware does not implement catalyst-efficiency monitoring,\nemissions readiness or OEM rear-sensor diagnostics.\nFault tracing\n01\nSignal changes when shared with OEM ECU: stop and review input loading and the buffer interface.\n02\nZero or clipped output: inspect buffer supply/reference and output limits.\n03\nA stable rear reading alone does not prove catalyst health.\nR30 22k series, R31 33k to ground, C25 10nF; U6 channel 5."},{"page":15,"title":"Crank Hall input","text":"08.1 / J17\nCrank Hall input\n PIN 1\nPIN 2\nPIN 3\n1 GND\n2 SENSOR_5V\n3 CRANK_RAW\nMounting & routing\n01\nUse the original rigid bracket/target-wheel relationship and the exact manufacturer air gap, polarity, supply rating\nand torque. There is no universal trigger gap.\n02\nThis input accepts a compatible 5 V Hall interface. A two-wire variable-reluctance sensor needs an external\nconditioner.\nConnect & verify\n01\nVerify supply and ground before connecting. Determine whether the Hall output is push-pull or open-collector.\n02\nFor an open-collector output without another suitable pull-up, fit the specified optional pull-up and verify the\ncurrent/voltage requirements.\n03\nUse an oscilloscope to compare connector pin 3 with the conditioned MCU input. A multimeter can miss missing\npulses and noise.\n04\nWith ignition/injection disabled, turn the target safely or use an isolated bench signal generator. Do not connect a\ngenerator in parallel with an energized sensor.\nExpected behavior\n01\nOnly rising edges are captured. Both signal paths use two Schmitt inversions, preserving the input polarity.\n02\nCrank sync requires the selected missing-tooth geometry and repeated valid gaps. Cam is counted but full\n720-degree phase decoding is not implemented.\nFault tracing\n01\nNo edges: inspect supply, missing pull-up, wrong sensor type, target gap, signal/ground pin order and U7\nconditioning.\n02\nEdges but no sync: inspect total slots/missing teeth, speed range, signal quality and electrical noise. A simple\nsquare wave is not a valid missing-tooth wheel.\n03\nFalse RPM / overflow: inspect ringing, shield/return routing, gap and pull-up; power-cycle after a latched capture\noverflow.\nR40 33k series, C30 100pF, optional R41 2.2k pull-up; U7 -> GPIO8."},{"page":16,"title":"Cam Hall input","text":"08.2 / J18\nCam Hall input\n PIN 1\nPIN 2\nPIN 3\n1 GND\n2 SENSOR_5V\n3 CAM_RAW\nMounting & routing\n01\nUse the original rigid bracket/target-wheel relationship and the exact manufacturer air gap, polarity, supply rating\nand torque. There is no universal trigger gap.\n02\nThis input accepts a compatible 5 V Hall interface. A two-wire variable-reluctance sensor needs an external\nconditioner.\nConnect & verify\n01\nVerify supply and ground before connecting. Determine whether the Hall output is push-pull or open-collector.\n02\nFor an open-collector output without another suitable pull-up, fit the specified optional pull-up and verify the\ncurrent/voltage requirements.\n03\nUse an oscilloscope to compare connector pin 3 with the conditioned MCU input. A multimeter can miss missing\npulses and noise.\n04\nWith ignition/injection disabled, turn the target safely or use an isolated bench signal generator. Do not connect a\ngenerator in parallel with an energized sensor.\nExpected behavior\n01\nOnly rising edges are captured. Both signal paths use two Schmitt inversions, preserving the input polarity.\n02\nCrank sync requires the selected missing-tooth geometry and repeated valid gaps. Cam is counted but full\n720-degree phase decoding is not implemented.\nFault tracing\n01\nNo edges: inspect supply, missing pull-up, wrong sensor type, target gap, signal/ground pin order and U7\nconditioning.\n02\nEdges but no sync: inspect total slots/missing teeth, speed range, signal quality and electrical noise. A simple\nsquare wave is not a valid missing-tooth wheel.\n03\nFalse RPM / overflow: inspect ringing, shield/return routing, gap and pull-up; power-cycle after a latched capture\noverflow.\nR42 33k series, C31 100pF, optional R43 2.2k pull-up; U7 -> GPIO9."},{"page":17,"title":"Power, data and output connections","text":"09.1 / SERVICE INTERFACES\nPower, data and output connections\nJ1 / Logic power\n01\nPin 1 is externally fused key-on 12 V; pin 2 is ground. Use the specified external 1 A source fuse.\n02\nFor first bench checks, unplug every sensor and actuator, keep J3 open, use a 12 V current-limited supply, and\ncheck polarity before enabling it.\n03\nMeasure TP2 VIN_PROT, TP3 5 V, TP4 3V3, then each sensor pin 2. TP2 is after the reverse diode and before the\ninput filter.\n04\nRepeated resets can be undervoltage/current limit, a short, wrong part orientation, regulator instability or watchdog\ntimeout. Disconnect external loads one at a time.\nJ2 / UART / boot / reset\n01\nPins: 1 ground, 2 ECU TX -> adapter RX, 3 ECU RX <- adapter TX, 4 EN, 5 BOOT_N. Use 3.3 V logic, 115200\nbaud, 8-N-1.\n02\nDo not connect an adapter power wire or a powered DevKit USB cable while the carrier supplies the module. For\nUSB programming, remove the module from the carrier.\n03\nIf silent, check supply and EN, cross TX/RX correctly, verify the A3 build and chosen serial port, then capture the\nboot log. The existing console tag can still say ecu_a0.\n04\nFor ROM download mode, hold BOOT_N low during an EN reset, then release it. Do not short EN or BOOT_N to 12\nV."},{"page":18,"title":"Power, data and output connections","text":"09.2 / SERVICE INTERFACES\nPower, data and output connections\nJ3 / Physical interlock\n01\nPin 1 is 3V3 and pin 2 is INTERLOCK. Open is the normal state during commissioning.\n02\nlock=0 with the contact open is expected. Closing it can allow hardware run gating; do not close it with vehicle\nactuators connected.\n03\nThe configuration firmware keeps ARM=0 regardless. Never bypass SAFE_N to make a fault disappear.\nJ4 / Internal expansion\n01\nPins: ground / 3V3 / SDA / SCL / SAFE_N. This is an internal 3.3 V service bus, not a 12 V sensor connector.\n02\nCheck pull-ups and idle SDA/SCL near 3V3. A stuck-low line suggests a short, wrong device voltage or a device\nholding the bus.\n03\nNo generic external I2C scanner or expansion actuator control is implemented by this release."},{"page":19,"title":"Power, data and output connections","text":"09.3 / SERVICE INTERFACES\nPower, data and output connections\nJ7 / JP1 / JP2 / CAN and termination\n01\nJ7: CANH / CANL / ground / CHASSIS. Keep the pair twisted and verify the network bitrate. Firmware reception is\n500 kbit/s listen-only; no OEM decoding is provided.\n02\nJP1 open leaves MCP2562 in standby, so ordinary frames will not be received. Close it only on the appropriate\nsupervised bus for normal transceiver reception. Firmware remains listen-only.\n03\nJP2 adds onboard 120 ohm termination when closed. Leave it open on an already terminated vehicle network.\n04\nWith the complete network unpowered, two 120 ohm end terminations normally measure about 60 ohm between\nCANH and CANL. A removed/unpowered interface alone need not read 60 ohm.\n05\nNo frames: inspect JP1, bitrate, polarity, grounds, bus activity and termination. A standalone two-node listen-only\nbench cannot supply missing ACKs for a lone transmitter.\nJ8 / External relay coils\n01\nPins: MAIN low side / PUMP low side / FAN low side / ground. External fused relay supplies and correctly oriented\nflyback diodes are required.\n02\nTarget coil current is at most 150 mA per channel, pending physical tests. Do not connect a fan motor or pump\nmotor directly.\n03\nThe configuration firmware commands all channels OFF. An inactive relay is expected, not a reason to bypass the\ninhibit.\n04\nWith a coil connected to a safe test supply, OFF low-side voltage can be near the external supply, not zero.\nDriver/tab is electrically live. Actuation tests require a separate qualified dummy-load procedure."},{"page":20,"title":"Power, data and output connections","text":"09.4 / SERVICE INTERFACES\nPower, data and output connections\nJ9 / J19 / Injector outputs and power return\n01\nJ9 pins 1-4 are injector low sides 1-4; pins 5-8 are ground. J19 both pins are the dedicated power return.\n02\nOnly saturated high-impedance PFI injectors are in scope; 1.2 A/channel is a design target pending tests. No GDI or\npeak-and-hold driver is provided.\n03\nActuator 12 V is external, fused and relay switched. Never use the sensor ground harness as the injector current\nreturn.\n04\nAll outputs remain OFF in this firmware. Check resistance/continuity only disconnected; do not pulse a fueled engine\nto troubleshoot wiring.\n05\nA high OFF output with an externally powered load is normal. Persistent current with ARM off indicates wrong\nwiring, a shorted driver or a board fault: disconnect power.\nJ10 / Smart-coil logic only\n01\nPins 1-4 are active-high 5 V smart-coil commands; pin 5 is ground. They are not ignition-coil primary outputs.\n02\nUse only a compatible low-current logic input (design target at most 4 mA). Coil power and power-ground wiring\nremain external.\n03\nThe configuration firmware keeps dwell commands OFF. Do not use a test lamp, an ordinary LED without its\nresistor, or a coil primary as a logic test load.\n04\nChanging or interrupting dwell on a real coil can produce a spark. Keep real ignition hardware disconnected during\nbench configuration."},{"page":21,"title":"Power, data and output connections","text":"09.5 / SERVICE INTERFACES\nPower, data and output connections\nJ20 / H5 / Shield and enclosure bond\n01\nJ20 pins and plated lug H5 are CHASSIS, not normal sensor/actuator current returns. Bond them to the internal\nlining using the assembly guide.\n02\nCheck lining/braid continuity with power off. The CHASSIS-to-GND 1 Mohm bleed and 4.7 nF RF capacitor are\nintentional, not a hard DC ground link.\n03\nKeep all bonds inside the water seal and route any external reference conductor through a sealed gland. Do not drill\nan unsealed shield-stud hole.\nTP1-TP6 / Test points\n01\nTP1 ground; TP2 VIN_PROT; TP3 5 V; TP4 3V3; TP5 SAFE_N; TP6 RUN_5V.\n02\nWith J3 open and monitor firmware, RUN_5V should be low even when supplies are healthy. SAFE_N is an\nopen-drain supervised net, normally pulled near 3V3 when released.\n03\nIf SAFE_N repeatedly drops, scope it with the supply rails and WDI. Do not defeat the MAX1232 or 3V3 supervisor.\n04\nUse a properly referenced or isolated scope arrangement; do not clip an earth-referenced scope ground to an\narbitrary live output."},{"page":22,"title":"Trace a fault from the connector inward","text":"10 / LIVE DIAGNOSIS\nTrace a fault from the connector inward\nScreenshot: host simulator with a deliberately shorted MAP input. Fault-injection controls are absent from the embedded firmware.\n01\nStart with battery and sensor-rail measurements. If several channels fail together, inspect shared power/ground\nbefore adjusting every curve.\n02\nCompare pin 3 versus pin 1 at the connector with the web connector voltage. If those agree, inspect curve, units and\nreference settings.\n03\nIf connector voltage is correct but ADC is wrong, check the named 22k/33k input divider, clamp polarity, filter\ncapacitor, U6 reference and SPI connections. Do not inject an automotive battery voltage as a signal test.\n04\nIf all ADC channels are stuck at zero/full scale, inspect U6 power/reference, chip select, MOSI/MISO/clock, solder\nbridges and the live ADC transfer status. A successful SPI transaction alone cannot prove sensor integrity.\n05\nFor missing crank/cam counts, scope both raw and conditioned signals. Review pull-ups, Hall-versus-VR type,\ntarget geometry and air gap before blaming software.\n06\nCapture overflow is latched until power cycle. Find the signal/queue cause first; clearing a latch does not repair the\nsource.\n07\nExport the diagnostic report with timestamp, profile revision and browser event history. Event history starts when\nthat browser session starts. The export is not a persistent ECU flight recorder.\n08\nIf the page disconnects, readings become stale. Check the AP, board supply and UART, then reconnect. Never use\na frozen browser number as a live measurement."},{"page":23,"title":"Install the board and shield","text":"11 / PRINTED ENCLOSURE\nInstall the board and shield\nPCB: 120 × 120 mm. Printed base: 138 × 150 × 44 mm. Lid: 142 × 154 mm. Nominal assembled height: 47 mm. Cable glands add to the\nrear envelope.\n01\nPrint base, lid, insulating tray, lid insulator and insert coupon. Use a material/process suitable for the measured\ninstallation temperature, chemicals and vibration. Do not assume a printed case is suitable beside an exhaust or\nunderhood heat source.\n02\nTest the coupon with the actual short M3 heat-set inserts before fitting them to the case. Four PCB supports take M3\nshort inserts; eight lid bosses and two internal shield bonds use the same insert type.\n03\nInstall the internal base shield-bond insert and lining before the PCB blocks tool access. Keep the side-wall bond\nblind: do not drill through the outer wall.\n04\nApply conductive lining following the templates. Keep it below and clear of the water-seal land. Bond seams with a\nsuitable conductive method and use short broad internal bonds. The gasket is not an electrical bond.\n05\nFit the insulating tray over the lining. Clear the support roots and internal bond boss. Ensure conductive foil cannot\ntouch solder tails, module pins, live transistor tabs or terminals.\n06\nInstall the PCB at box origin 9,9 mm and Z=9 mm. Hole centers are (13,13), (125,13), (13,125), (125,125) mm from\nthe base origin. Use four M3 × 6 screws and 0.8 mm nylon washers.\n07\nTrim all solder tails to at most 3 mm below the PCB. H4 has specific relief pockets for R35 and D210; align the board\ncorrectly and confirm the tail clearances by dry fitting.\n08\nDry fit all mating plugs, wire bends and strain relief with the unpowered board. Do not force a cable against the lid, a\nlive transistor tab or the gasket. The CAD component envelope does not qualify the finished harness.\n09\nFit the removable lid lining bond and its dielectric cover. Leave a flexible internal bond loop that cannot snag, touch\nelectronics or cross the gasket."},{"page":24,"title":"Seal the lid and cable entries","text":"12 / SPLASH RESISTANCE\nSeal the lid and cable entries\n01\nCut one continuous ring from 2.0 mm soft closed-cell silicone sheet with the supplied 1:1 template. The ring is 3 mm\nwide; the groove is 3.4 mm wide and 1.5 mm deep. Do not print the reference gasket in ordinary rigid filament.\n02\nInspect the sealing land, groove, case walls and layers for pores, strings and damage. Establish a compatible\nsealing/post-processing method if the printing process leaves porous walls.\n03\nSeat the ring without stretches, twists, gaps or adhesive lumps. The nominal geometry compresses a 2 mm sheet to\n1.5 mm (25%); check the actual chosen material and print dimensions.\n04\nFit four suitable M16 cable glands, or gasketed blanking plugs for unused holes. Their panel flange must fit the 24\nmm diameter envelope. Use the manufacturer sealing washers and cable-jacket diameter range.\n05\nA single-hole gland seals against a round cable jacket, not a bundle of loose individual wires. Use appropriately\njacketed multi-core harness groups and sealed external branches. The JST connectors are inside the box and are\nnot sealed external bulkhead connectors.\n06\nProvide harness strain relief and a drip loop. Place cable entries away from direct splash and pooling. The rear entry\ncenters are X=27,55,83,111 mm and Z=27 mm.\n07\nClose the lid with its drip skirt outside the base wall. Use eight M3 × 8 screws with 0.8 mm washers, tighten evenly\nand inspect continuous gasket seating. Screw holes lie outside the nominal water-seal line.\n08\nTest the empty assembled case with absorbent paper before installing electronics. Start with controlled light\nsplashes in the intended orientations, inspect every seam and gland, dry completely, and correct leaks before\nrepeating. No IP rating or pressure-wash/submersion capability is claimed.\nSplash resistance, printed fit, insert strength, vibration, thermal behavior and shielding performance require physical\ntests. The CAD checks prove nominal solid/mesh integrity and specified clearances only. Keep all service work dry;\nopening the lid removes the splash barrier.\nHardware list\n01\n4 × M3 × 6 PCB screws and 0.8 mm nylon washers; 8 × M3 × 8 lid screws and 0.8 mm flat washers.\n02\n14 × ruthex RX-M3Sx4.0 short inserts: 4 PCB, 8 lid, 2 internal shield bonds. Check the actual insert datasheet and\nprinted coupon.\n03\n2 × M3 × 5 bond screws with suitable ring terminals/star washers; H5 uses a separate M3 bolt/nut and short braid.\n04\n2 mm closed-cell silicone gasket sheet, conductive lining/bond materials, four matched M16 glands or sealed\nblanks."},{"page":25,"title":"Record the evidence for this build","text":"13 / ACCEPTANCE RECORD\nRecord the evidence for this build\nComplete this record for the actual board, harness and sensors. Blank fields mean not checked. A browser screenshot does not replace a\nmeasurement.\nItem\nRecord / result\nBoard serial, PCB revision and assembly date\n________________________________________________\nFirmware environment / hash and profile revision\n________________________________________________\n12 V source, fuse and current-limit setting\n________________________________________________\nTP2 / TP3 / TP4 and measured U6 VREF\n________________________________________________\nEach sensor part number, actual pinout and curve source\n________________________________________________\nCLT/IAT pull-up values and independent temperature points\n________________________________________________\nMAP pressure reference / TPS travel reference points\n________________________________________________\nExternal wideband controller and analog-output mapping\n________________________________________________\nCrank/cam waveform, wheel pattern and air gap source\n________________________________________________\nCAN network state / termination / bitrate\n________________________________________________\nPrinted material, gland/cable sizes and gasket material\n________________________________________________\nDry fit, tail clearance, strain relief and bond continuity\n________________________________________________\nEmpty-box splash test observations / orientation\n________________________________________________\nOutstanding faults and qualification work\n________________________________________________\nSeparate qualification still needed\n01\nMeasure reverse-polarity, supply transients/load dump, cranking brownout, regulator stability and thermal margins\nwith suitable controlled equipment.\n02\nQualify sensor fault stress, clamp currents, output current/clamp/thermal behavior and hardware inhibition on\nappropriate dummy loads.\n03\nCheck EMC/immunity, grounding, harness interaction, vibration and environmental performance.\n04\nAn actual vehicle ECU replacement needs a reviewed vehicle harness, complete engine control implementation and\ncalibration, safety analysis and applicable emissions/legal assessment."},{"page":26,"title":"Files and manufacturer references","text":"14 / REFERENCES\nFiles and manufacturer references\nThe same structured guide content appears in the browser and in this manual. Keep the PDF, firmware, hardware and\nprofile schema from the same release.\nhardware/a3-compact/esp32-ecu.kicad_pcb and .kicad_sch: native design\nhardware/a3-compact/bom.csv and connector-pinout.csv: assembly and pin contract\nenclosure/a3/: STEP, STL, native FreeCAD, gasket/lining templates and dimensions\nconfig/interface-guide.json: source of sensor mounting, checks and fault tracing\nconfig/defaults.json: uncalibrated profile; schema version 1\ndocs/web-configuration.md: service setup, persistence and recovery\nreports/web/: UI screenshots and automated software test results\nreports/a3/: electrical CAD checks and dimensional audit\nGuide source SHA-256: e7a8ad098e3a92081bf15585b5727021d456e7c5d4296063b2cbd840c57205ad\nPrimary references\nEspressif S3 DevKitC v1.1 pins and power methods\nhttps://docs.espressif.com/projects/esp-dev-kits/en/latest/esp32s3/esp32-s3-devkitc-1/user_guide_v1.1.html\nMicrochip MCP3208 ADC\nhttps://www.microchip.com/en-us/product/mcp3208\nMicrochip MCP2562 CAN transceiver\nhttps://ww1.microchip.com/downloads/en/DeviceDoc/25167A.pdf\nBosch LSU 4.9 requires a dedicated controller\nhttps://www.bosch-motorsport.com/products/sensors/lambda/lambda-sensor-mini-lsu-4-9/\nKvaser CAN termination checks\nhttps://kvaser.com/developer-blog/how-to-test-your-can-termination-works-correctly/\nST protected low-side driver\nhttps://www.st.com/resource/en/datasheet/vnp35n07-e.pdf\nAlways obtain the exact sensor/connector/module datasheets and the vehicle wiring diagram. These references explain component\ninterfaces; they do not establish this prototype as vehicle-qualified."}]})ECU_ASSET";
}
